## drivers/staging/android/ion_4.9/Kconfig
```kconfig
menuconfig ION
	bool "Ion Memory Manager"
	depends on HAVE_MEMBLOCK && HAS_DMA && MMU
	select GENERIC_ALLOCATOR
	select DMA_SHARED_BUFFER
	default y if ARCH_TCC897X || ARCH_TCC898X || ARCH_TCC899X ||ARCH_TCC570X || ARCH_TCC802X || ARCH_TCC803X || ARCH_TCC901X || ARCH_TCC805X
	---help---
	  Chose this option to enable the ION Memory Manager,
	  used by Android to efficiently allocate buffers
	  from userspace that can be shared between drivers.
	  If you're not using Android its probably safe to
	  say N here.

config ION_TEST
	tristate "Ion Test Device"
	depends on ION
	help
	  Choose this option to create a device that can be used to test the
	  kernel and device side ION functions.

config ION_DUMMY
	bool "Dummy Ion driver"
	depends on ION
	help
	  Provides a dummy ION driver that registers the
	  /dev/ion device and some basic heaps. This can
	  be used for testing the ION infrastructure if
	  one doesn't have access to hardware drivers that
	  use ION.

config ION_TEGRA
	tristate "Ion for Tegra"
	depends on ARCH_TEGRA && ION
	help
	  Choose this option if you wish to use ion on an nVidia Tegra.

config ION_POOL_CACHE_POLICY
	bool "Ion set page pool cache policy"
	depends on ION && X86
	default y if X86
	help
	  Choose this option if need to explicity set cache policy of the
	  pages in the page pool.

config ION_HISI
	tristate "Hisilicon ION driver"
	depends on ARCH_HISI && ION
	help
	  Choose this option if you wish to use ion on an HISI target.

config ION_TCC
	tristate "Ion for TCC"
	depends on ION
	default y
	help
	  Choose this option if you wish to use ion on a Telechips board.
```

## drivers/staging/typec/Kconfig
```kconfig
menu "USB Power Delivery and Type-C drivers"

if TYPEC_TCPM

source "drivers/staging/typec/fusb302/Kconfig"

endif

endmenu
```

## drivers/tee/optee/Kconfig
```kconfig
# OP-TEE Trusted Execution Environment Configuration
config OPTEE
	tristate "OP-TEE"
	default y
	help
	  This implements the OP-TEE Trusted Execution Environment (TEE)
	  driver.

config OPTEE_BENCHMARK
	bool "OP-TEE Benchmark (EXPERIMENTAL)"
	depends on OPTEE
	help
	  This enables benchmarking feature in the OP-TEE Trusted
	  Execution Environment (TEE) driver.
```

## drivers/thermal/tcc/Kconfig
```kconfig
config TCC_THERMAL
	depends on OF
	bool "Temperature sensor on Telechips SoCs"
	help
	  If you say yes here you get support for Telechips SoC.

config ARM_TCC_MP_CPUFREQ
	bool "Telechips Thermal driver driving by MP condition."
	depends on TCC_THERMAL
	default n
	help
	  If you say yes here you get support for MP thermal policy.

config TCC_THERMAL_IRQ
	bool "Telechips Thermal driver IRQ check."
	depends on TCC_THERMAL
	default n
	help
	  If you say yes here you get support for Thermal driver IRQ handler.
```

## drivers/usb/dwc_otg/Kconfig
```kconfig
#
# Synopsys DWC OTG Controller Drivers
#       for Telechips System-on-Chips
#

comment "Telechips DWC OTG Controller Drivers"
	depends on ARCH_TCC897X || ARCH_TCC898X || ARCH_TCC802X || ARCH_TCC570X || ARCH_TCC899X || ARCH_TCC803X || ARCH_TCC901X

config TCC_DWC_OTG
	tristate "Telechips DWC OTG support"
	---help---
	  Telechips USB OTG Controller driver.
	  Synopsys DesignWare Hi-Speed USB On-The-Go (OTG) Core used on the Telechips SoC.
	select USB_OTG
	select USB_GADGET
	select TCC_DWC_OTG_PHY

#---------------------------------------------------------------
# DWC_OTG Dual-role Initial Mode
#---------------------------------------------------------------
choice
	prompt "OTG Dual-role Initial Mode"
	depends on TCC_DWC_OTG
	default TCC_DWC_OTG_DUAL_FIRST_DEV
	help
	  Select Telechips OTG Dual-role initial mode, Host or Device mode.

config TCC_DWC_OTG_DUAL_FIRST_HOST
	bool "Host mode"
	help
	  OTG Dual-role initial mode : Host mode

config TCC_DWC_OTG_DUAL_FIRST_DEV
	bool "Device mode"
	help
	  OTG Dual-role initial mode : Device mode
endchoice

config TCC_DWC_OTG_HOST_MUX
	depends on TCC_DWC_OTG && (ARCH_TCC898X || ARCH_TCC802X || ARCH_TCC899X || ARCH_TCC803X || ARCH_TCC901X)
	select USB_EHCI_HCD_PLATFORM
	select USB_OHCI_HCD_PLATFORM
	select TCC_EHCI_PHY
	bool "OTG Host Mux mode"
	help
	  Telechips DWC OTG Device driver & EHCI Host driver.

#---------------------------------------------------------------
# Misc
#---------------------------------------------------------------
config TCC_DWC_OTG_DEBUG
	depends on TCC_DWC_OTG
	bool "Enable debugging messages"
	default n
	help
	  This enables Telechips DWC OTG debugging.

config DBG_SPINLOCK
	depends on TCC_DWC_OTG
	bool "Enable spinlock debugging messages"
	default n
	help
	  This enables Telechips DWC OTG spinlock debugging.

config TCC_DWC_HS_ELECT_TST
	depends on TCC_DWC_OTG
	bool "On-The-Go(OTG) Protocol and Electrical Tester(PET)"
	default n
	help
	  Enable "On-The-Go(OTG) Protocol and Electrical Tester(PET)"
	  A test unit which is capable of performing the test specified in
	  Section 6(USB On-The-Go and Embedded Host Automated Compliance Plan).

config TCC_DWC_IRQ_AFFINITY
	depends on TCC_DWC_OTG && (ARCH_TCC897X || ARCH_TCC570X || ARCH_TCC803X)
	int "Set the irq affinity of the dwc_otg"
	default 0
	help
	  Set the irq affinity of the dwc_otg

config DWC_INCOMP_ISOC
	bool "Enable handling incompleted isoc interrupt"
	default y
	help
		To handle incompleted isoc interrupt
```

## drivers/usb/isp1763/Kconfig
```kconfig
# SPDX-License-Identifier: GPL-2.0

config USB_ISP1763
	tristate "ST ISP 1763 support"
	depends on USB
	help
	  Say Y or M here if your system as an ISP1763 USB host controller
	  or an ISP1763 USB dual-role controller.

	  This driver does not support isochronous transfers or OTG.
	  This USB controller is usually attached to a non-DMA-Master
	  capable bus.

	  To compile this driver as a module, choose M here: the
	  module will be called isp1763.
```
