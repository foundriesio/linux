## drivers/media/platform/tccvin/Kconfig
```kconfig
# drivers/media/platform/tccvin/Kconfig
#
# Copyright (c) 2010 Telechips Co., Ltd.
#	http://www.telechips.com/
# Jay <B150095@telechips.com>
#
# Licensed under GPL

config VIDEO_TCCVIN
	bool "Telechips Video-Input Path Driver"
	select VIDEOBUF_GEN
	select VIDEOBUF_DMA_SG
	select VIDEOBUF_VMALLOC
	select V4L2_FWNODE
	depends on VIDEO_DEV
	default n

config OVERLAY_PGL
	bool "Overlay Video-Input with Parking Guide Line"
	depends on VIDEO_TCCVIN
	default n

config VIDEO_TCCVIN_SWITCHMANAGER
	bool "Telechips Video-Input SwitchManager Driver"
	depends on VIDEO_TCCVIN
	default n

config VIDEO_TCCVIN_PRESET_VIDEOSOURCE
	bool "Videosource is pre-set on bootloader"
	depends on VIDEO_TCCVIN_SWITCHMANAGER
	default n

config VIDEO_TCCVIN_SAFE_ASSURE
	bool "Support Safe Assure Function for Video-Input Path"
	depends on ARCH_TCC803X && VIDEO_TCCVIN
	default n
```

## drivers/media/platform/tccvin2/Kconfig
```kconfig
# drivers/media/platform/tccvin/Kconfig
#
# Copyright (c) 2020-2020 Telechips Co., Ltd.
#	http://www.telechips.com/
# Jay <B150095@telechips.com>
#
# Licensed under GPL

config VIDEO_TCCVIN2
	bool "Telechips Video-Input Path Driver V2"
	depends on VIDEO_V4L2 && VIDEO_V4L2_SUBDEV_API && OF
	default n
	select VIDEOBUF2_VMALLOC
	select V4L2_FWNODE
	---help---
	Support v4l2 capture interface

	Note that the driver is supported on the following chipsets.
	- tcc803x
	- tcc805x

config OVERLAY_PGL
	bool "Overlay Video-Input with Parking Guide Line"
	depends on VIDEO_TCCVIN2
	default n
	---help---
	Support overlay function of static pgl on the camera preview

	Note that the driver is supported on the following conditions.
	- The pgl image is loaded on bootloader step.
	- The related device node is updated to overlay.

config VIDEO_TCCVIN2_DIAG
	bool "Video-Input Path Diagnostics"
	depends on VIDEO_TCCVIN2
	default n
	---help---
	Support Video-Input Path Diagnostics

	Note that the following diagnostics functions are supported.
	- cif port pinctrl checking.
	- cif port mapping checking.
```

## drivers/media/platform/tccvout/Kconfig
```kconfig
# Telechips VOUT (Vidoe OUTput) Driver Configuration
#----------------------------------------------------------------

#
# Debuggind Option
#
config TCC_VOUT_DEBUG
	bool "Telechips VOUT debugging"
	default n
	help
	  This is an option for use by developers; most people should
	  say N here.  This enables vout driver debugging.

config TCC_VOUT_DBG_INFO
	bool "Telechips VOUT debugging for info"
	depends on TCC_VOUT_DEBUG
	default n
	help
	  This is an option for use by developers; most people should
	  say N here.  This enables vout driver debugging.

config TCC_VOUT_DBG_BUF
	bool "Telechips VOUT debugging for buffer"
	depends on TCC_VOUT_DEBUG
	default n
	help
	  This is an option for use by developers; most people should
	  say N here.  This enables vout driver debugging.

config TCC_VOUT_DBG_INT
	bool "Telechips VOUT debugging for interrupt"
	depends on TCC_VOUT_DEBUG
	default n
	help
	  This is an option for use by developers; most people should
	  say N here.  This enables vout driver debugging.

#
# Vsync Option
#
config VOUT_USE_VSYNC_INT
	bool "Use vsync interrupt"
	default n

config VOUT_DISPLAY_LASTFRAME
	bool "Use last frame interface"
	default n

#
# Subtitle plane support
#
config VOUT_USE_SUB_PLANE
	bool "Use HW subtitle plane"
	default n
	help
	  It's used to support HW subtitle plane

#
# Keep video layer
#
config VOUT_KEEP_VIDEO_LAYER
	bool "Keep HW video layer when running camera driver"
	depends on (TCC_VIOCMG)
	default n
	help
	  It's used to keep video layer when running camera driver.
```

## drivers/media/platform/videosource/Kconfig
```kconfig
# drivers/media/platform/videosource/Kconfig
#
# Copyright (c) 2010 Telechips Co., Ltd.
#	http://www.telechips.com/
# Jay <B150095@telechips.com>
#
# Licensed under GPL

config VIDEO_VIDEOSOURCE
	bool "Video Source"
	default n

config MIPI_CSI_2
	bool "Support MIPI CSI-2"
	depends on ARCH_TCC803X || ARCH_TCC805X
	default y
```

## drivers/media/platform/videosource/videodecoder/Kconfig
```kconfig
# drivers/media/platform/videosource/videodecoder/Kconfig
#
# Copyright (c) 2010-2011 Telechips Co., Ltd.
#	http://www.telechips.com/
# Jay <B150095@telechips.com>
#
# Licensed under GPL

config VIDEO_VIDEOSOURCE_VIDEODECODER_ADV7182
	bool "Analog Devices - ADV7182"
	depends on VIDEO_VIDEOSOURCE

config VIDEO_VIDEOSOURCE_VIDEODECODER_DM5886
	bool "Davicom - DM5886"
	depends on VIDEO_VIDEOSOURCE

config VIDEO_VIDEOSOURCE_VIDEODECODER_ISL79988
	bool "Intersil - ISL79988"
	depends on VIDEO_VIDEOSOURCE

config VIDEO_VIDEOSOURCE_VIDEODECODER_DS90UB964
	bool "TI - DS90UB964"
	depends on VIDEO_VIDEOSOURCE

config VIDEO_VIDEOSOURCE_VIDEODECODER_MAX9286
	bool "MAXIM - MAX9286"
	depends on VIDEO_VIDEOSOURCE

config MIPI_OUTPUT_TYPE_LINE_CONCAT
	bool "MIPI-CSI2 output type - LINE CONCAT"
	depends on VIDEO_VIDEOSOURCE_VIDEODECODER_DS90UB964 || VIDEO_VIDEOSOURCE_VIDEODECODER_MAX9286
```

## drivers/media/platform/videosource2/Kconfig
```kconfig
# drivers/media/platform/videosource/Kconfig
#
# Copyright (c) 2010 Telechips Co., Ltd.
#	http://www.telechips.com/
# Jay <B150095@telechips.com>
#
# Licensed under GPL

config VIDEO_VIDEOSOURCE2
	bool "Video Source V2"
	default n

config MAX96712_USE_2_INPUT
	bool "Use 2 input of max96712"
	depends on VIDEO_VIDEOSOURCE2
	default n
	---help---
	MAX96712 has 4 input ports and default setting is for 4ch FHD input.

	If only 2 input ports are used, enable this configuration.
```

## drivers/misc/arm/Kconfig
```kconfig
config EXTSYS_CTRL
	tristate "Arm External System control driver"
	help
	  Say y here to enable support for external system control
	  driver for the Arm Corstone-700 platform
```

## drivers/misc/hdcp/Kconfig
```kconfig
#
# HDCP Configuration
#

config HDCP_DWC_DP
	bool "HDCP for DesignWare Cores DisplayPort"
	depends on TCC_DP_DRIVER_V1_4
	default y
	help
	  Say Y here if you want to support the /dev/hdcp device.
	  The /dev/hdcp device is used to control Synopsys HDCP IP.
	  It supports HDCP1.3.
	  When in doubt, say "Y".

config HDCP_DWC_HLD
	bool "Host Library Driver for DesignWare Cores"
	depends on HDCP_DWC_DP
	default y
	help
	  Say Y here if you want to support the /dev/hl_dev device.
	  The /dev/hl_dev device is used to support Host Library API.
	  It supports HDCP2.2.
	  When in doubt, say "Y".
```

## drivers/misc/tcc/Kconfig
```kconfig
config TCC_SDR
	tristate "Telechips DAI Radio Mode Driver"
	depends on (ARCH_TCC897X || ARCH_TCC570X || ARCH_TCC802X || ARCH_TCC803X || ARCH_TCC899X || ARCH_TCC901X)
	default n
	help
		Telechips DAI Radio Mode Driver

config TCC_SCALER
	tristate "Telechips scaler driver"
	depends on ARCH_TCC
	default y
	help
		Telechips scaler driver

config TCC_WMIXER
	tristate "Telechips WMixer driver"
	depends on ARCH_TCC
	default y
	help
		Telechips WMixer driver

config TCC_ATTACH
	tristate "Telechips Attach driver"
	depends on ARCH_TCC
	default n
	help
		Telechips Attach driver

config TCC_VIQE_MADI
	tristate "Telechips Viqe-Madi driver"
	depends on (ARCH_TCC899X || ARCH_TCC901X)
	default y
	help
		Telechips Viqe-Madi driver

config SCALER_TEST
	tristate "Telechips test scaler driver"
	depends on ARCH_TCC
	default n
	help
		Telechips testscaler driver

config GPIO_TCC_SAMPLE
        default n
        bool "TCC gpio sample driver"
        help
		Telechips gpio sample driver.

source "drivers/misc/tcc/tcc_dsp/Kconfig"
```

## drivers/misc/tcc/tcc_dsp/Kconfig
```kconfig
config TCC_DSP
	bool "Telechips DSP Processor"
	depends on (ARCH_TCC897X || ARCH_TCC570X || ARCH_TCC802X)
	default n
	help
		if processor is TCC897x, TCC570x or TCC802x, it use CA7SP
```

## drivers/net/can/spi/mcp25xxfd/Kconfig
```kconfig
# SPDX-License-Identifier: GPL-2.0-only

menuconfig CAN_MCP25XXFD
	tristate "Microchip MCP25xxFD SPI CAN controllers"
	depends on HAS_DMA
	help
	  Driver for the Microchip MCP25XXFD SPI FD-CAN controller family.

if CAN_MCP25XXFD

config CAN_MCP25XXFD_DEBUG_FS
	bool "Enable debugfs for MCP25xxFD SPI driver"
	depends on DEBUG_FS
	help
	  Choose Y to enable RX/TX and FIFO statistics.

endif
```

## drivers/net/ethernet/tcc_gmac/Kconfig
```kconfig
#
#Telechips
#
config TCC_GMAC
	tristate "Telechips 10/100/1000 Ethernet Driver"
	depends on ARCH_TCC893X || ARCH_TCC896X || ARCH_TCC897X || \
		ARCH_TCC898X || ARCH_TCC570X || \
		ARCH_TCC802X || ARCH_TCC899X || \
		ARCH_TCC803X || ARCH_TCC901X || \
		ARCH_TCC805X 
	select CRC32
	select MII
	---help---
	  Support for Telechips 10/100/1000 Ethernet Driver

config TCC_GMAC_DA
    bool "Rx has priority over Tx"
    depends on TCC_GMAC
    default y

config TCC_GMAC_FQTSS_SUPPORT
    bool "Support FQTSS(IEEE 802.1Qav)"
	help
    	Support Forwaring and Queuing Enhancements for
	Time-Sensitive Streams(IEEE 802.1Qav)
    depends on TCC_GMAC
    default n

config TCC_GMAC_PTP
    bool "Support PTP(IEEE 1588-2008)"
	select PPS
	select NETWORK_PHY_TIMESTAMPING
	select PTP_1588_CLOCK
	help
    	Support Precision Time Protocol(IEEE 1588-2008)
    depends on TCC_GMAC
    default n

config TCC8990_MPW2_SOCKET
	bool "USE TCC8990 MPW2 SOCKET TYPE BOARD."
    depends on TCC_GMAC
    default n
```

## drivers/pinctrl/tcc/Kconfig
```kconfig
if ARCH_TCC
config PINCTRL_TCC
	bool
	select PINMUX
	select PINCONF
	select GPIOLIB_IRQCHIP
endif
```

## drivers/soc/fsl/Kconfig
```kconfig
#
# Freescale SoC drivers

config SOC_BUS_VF610
          tristate "SoC bus device for the Freescale Vybrid platform"
          depends on SOC_VF610 && NVMEM && NVMEM_VF610_OCOTP
          select SOC_BUS
          help
            Include support for the SoC bus on the Freescale Vybrid platform
            providing some sysfs information about the module variant.
```

## drivers/soc/tcc/Kconfig
```kconfig
# SPDX-License-Identifier: GPL-2.0-or-later
#
# Copyright (C) Telechips Inc.

menuconfig SOC_TCC
	bool "Telechips SOC drivers support"

if SOC_TCC

config TCC_ECID_SUPPORT
	bool "TCC ECID(CPU ID) SUPPORT"
        default n
	help
	  Support for the TCCXXXX demo board, Say Y here if you use ECID

config PMAP
	bool "PMAP (Physical memory MAP) helper driver"
	default y
	help
	  Say Y here if you want to use PMAP driver for Telechips SoCs.

if PMAP

config PMAP_TO_CMA
	bool "CMA allocation for PMAP (Physical memory MAP)"
	depends on DMA_CMA
	default n
	help
	  Say Y here to enable CMA allocation for pmap.

config PMAP_SECURED
	bool "Secured PMAP (Physical memory MAP) support"
	default y
	help
	  Say N here to ignore "telechips,pmap-secured" property.

config PMAP_DEBUG
	bool "PMAP (Physical memory MAP) debug message"
	depends on DEBUG_KERNEL
	default n
	help
	  Turns on debug messages in PMAP helper driver.

config PMAP_SUBCORE
	bool "Reserve PMAP memory for subcore kernel"
	depends on ARCH_TCC803X || ARCH_TCC805X
	default n
	help
	  Say Y here to reserve memory for subcore kernel.

endif # PMAP

config PLATFORM_AVN
	bool "Telechips Automotive Platform"
	default n

config PLATFORM_STB
	bool "Telechips Consumer(STB) Platform"
	default n

config TCC_MICOM
	bool "Telechips Support MICOM"
	default n
	depends on (ARCH_TCC802X)

config TCC_CORE_RESET
	bool "Telechips Core Reset Feature for TCC803x"
	depends on ARCH_TCC803X
	default n
	help
	  Select this option to enable core reset feature on TCC803x platform.

config TCC_BOOTSTAGE
	bool "Telechips bootstage helper driver"
	depends on PROC_FS && (ARCH_TCC805X || ARCH_TCC803X)
	default y
	help
	  Select this option to enable Telechips bootstage helper driver.
	  Telehips bootstage helper driver creates and manages the `bootstage`
	  procfs which provides the interface for printing out the timestamps
	  for each bootstage.

	  To use this option, Trusted Firmware must provide SiP service for
	  passing boot time information per each bootstage.

	  If unsure, say N.

config PM_TCC805X
	bool "Power management driver for TCC805x"
	depends on ARCH_TCC805X
	default y
	help
	  Select this option to enable TCC805x power management driver.

	  TCC805x power management driver controls Dialog Smiconductor PMIC
	  attached on TCC805x SoC based platform on some power events (e.g.
	  suspend, resume) accordingly including some software workarounds
	  for the PMICs if needed.

	  If unsure, say Y.

if PM_TCC805X

config PM_TCC805X_DA9062_SW_WORKAROUND
	bool "Enable software workaround for DA9062 PMIC"
	depends on REGULATOR_DA9062
	default y
	help
	  Select this option to add some software workaround code for DA9062
	  PMIC on TCC805x SoC based platformm, into TCC805x PM driver. By
	  enabling this, (1) CORE0p8 power off timing is delayed for 16.4
	  msec and (2) SYS_EN IRQ is unmasked to get wake-up signal, as the
	  workaround.

	  While only some versions of DA9062 PMICs need this workaround, the
	  others will not be affected by this option. So disable this for
	  such case.

	  If unsure, say Y.

config PM_TCC805X_DA9131_SW_WORKAROUND
	bool "Enable software workaround for DA9131 PMIC"
	depends on REGULATOR_DA9121
	default y
	help
	  Select this option to add some software workaround code for DA9131
	  PMIC on TCC805x SoC based platformm, into TCC805x PM driver. By
	  enabling this, (1) voltage slew rate is adjusted correctly and (2)
	  GPIO1/2 pull-up/pull-down is enabled, as the workaround.

	  While only some versions of DA9131 PMICs need this workaround, the
	  others will not be affected by this option. So disable this for
	  such case.

	  If unsure, say Y.

endif # PM_TCC805X

endif # SOC_TCC
```

## drivers/staging/android/Kconfig
```kconfig
menu "Android"

if ANDROID

config ASHMEM
	bool "Enable the Anonymous Shared Memory Subsystem"
	default n
	depends on SHMEM
	---help---
	  The ashmem subsystem is a new shared memory allocator, similar to
	  POSIX SHM but with different behavior and sporting a simpler
	  file-based API.

	  It is, in theory, a good memory allocator for low-memory devices,
	  because it can discard shared memory units when under memory pressure.

config ANDROID_VSOC
	tristate "Android Virtual SoC support"
	default n
	depends on PCI_MSI
	---help---
	  This option adds support for the Virtual SoC driver needed to boot
	  a 'cuttlefish' Android image inside QEmu. The driver interacts with
	  a QEmu ivshmem device. If built as a module, it will be called vsoc.

config ION_4_9
	bool "Use ion driver of kernel 4.9"
	default n # if ARCH_TCC805X && ANDROID

config ION_4_14
	bool "Use ion driver of kernel 4.14"
	default y if !ION_4_9

if ION_4_9
source "drivers/staging/android/ion_4.9/Kconfig"
endif

if ION_4_14
source "drivers/staging/android/ion/Kconfig"
endif
source "drivers/staging/android/fiq_debugger/Kconfig"

endif # if ANDROID

config LINUX_ANDROID
        bool "Linux Android Drivers"
        ---help---
          Enable support for various drivers of the Android platform needed on the Linux platform

if LINUX_ANDROID
config ION_4_14
	bool "Use ion driver of kernel 4.14"
	default y

if ION_4_14
source "drivers/staging/android/ion/Kconfig"
endif

endif # if LINUX_ANDROID

endmenu
```
