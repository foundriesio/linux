## drivers/gpu/drm/hisilicon/Kconfig
```kconfig
config DRM_HISI
	tristate "DRM Support for Hisilicon SoCs Platform"
	depends on DRM
	select DRM_KMS_HELPER
	select DRM_GEM_CMA_HELPER
	select DRM_KMS_CMA_HELPER
	help
	  Choose this option if you have a hisilicon chipsets(hi6220).
	  If M is selected the module will be called hisi-drm.

config DRM_HISI_FBDEV
	bool "Enable hisilicon legacy fbdev support"
	depends on DRM_HISI
	default y
	help
	  Choose this option if you have a need for the legacy fbdev support.
	  Note that this support also provides the Linux console on top of
	  the hisi modesetting driver.
```

## drivers/gpu/drm/hisilicon/kirin/Kconfig
```kconfig
config DRM_HISI_KIRIN
	tristate "DRM Support for Hisilicon Kirin series SoCs Platform"
	depends on DRM && OF && ARM64
	select DRM_KMS_HELPER
	select DRM_GEM_CMA_HELPER
	select DRM_KMS_CMA_HELPER
	select DRM_MIPI_DSI
	select DRM_PANEL
	help
	  Choose this option if you have a hisilicon Kirin chipsets(hi6220).
	  If M is selected the module will be called kirin-drm.

config DRM_HISI_KIRIN960
	tristate "DRM Support for Hisilicon Kirin960 series SoCs Platform"
	depends on DRM && OF && ARM64
	select DRM_KMS_HELPER
	select DRM_GEM_CMA_HELPER
	select DRM_KMS_CMA_HELPER
	select DRM_MIPI_DSI
	select DRM_PANEL
	help
	  Choose this option if you have a hisilicon Kirin chipsets(kirin960).
	  If M is selected the module will be called kirin-drm.
```

## drivers/gpu/drm/mali/Kconfig
```kconfig
config DRM_MALI
   bool "MALI DRM module"
   depends on DRM && MALI400_GPU
   select DRM_GEM_CMA_HELPER
   help
     MALI DRM module
```

## drivers/gpu/drm/tcc/Kconfig
```kconfig
config DRM_TCC
	tristate "DRM Support for Telechips SoC Series"
	depends on OF && DRM && ARCH_TCC
	select DRM_KMS_HELPER
	select VIDEOMODE_HELPERS
	help
	  Choose this option if you have a Telechips SoC chipset.
	  If M is selected the module will be called tccdrm.

if DRM_TCC

config DRM_TCC_CTRL_CHROMAKEY
  bool "DRM controls chromakey on planes"
  depends on ARCH_TCC805X
  default n
  help
    If this config is select then TCCDRM can controls chroma-key of WMIX.

comment "CRTCs"

config DRM_TCC_LCD
	bool "LCD"
	select DRM_TCC_DPI
	help
	  Choose this option if you want to use LCD/LVDS I/F for DRM.

config DRM_TCC_VIC_MAX
  int "Maximum Video Identification Code supported by TCC DRM"
  default 1025

config DRM_TCC_LCD_VIC
	int "Video Identification Code for LCD"
  depends on DRM_TCC_LCD
  default 1024
  range 1 DRM_TCC_VIC_MAX
	help
	  Video Identification Code for First-Display

config DRM_TCC_KEEP_LOGO
        bool "DRM TCC KEEP LOGO"
        default y if ARCH_TCC805X && !ANDROID
        default n if !ARCH_TCC805X || ANDROID
        help
          If this config is selected to y, DRM driver skips process that fills its plane with block color when it is binded.

config DRM_TCC_EXT
        bool "TCC Extended LCD type"
        help
          Choose this option if you want to use Extended LCD for DRM.

config DRM_TCC_EXT_VIC
	int "Video Identification Code for EXT"
  depends on DRM_TCC_EXT
  default 1024
  range 1 DRM_TCC_VIC_MAX
	help
	  Video Identification Code for Ext-Display

config DRM_TCC_THIRD
        bool "TCC third display type"
	depends on (ARCH_TCC803X || ARCH_TCC805X)
        help
          Choose this option if you want to use third display for DRM.

config DRM_TCC_THIRD_VIC
	int "Video Identification Code for THIRD"
  depends on DRM_TCC_THIRD
  default 1025
  range 1 DRM_TCC_VIC_MAX
	help
	  Video Identification Code for Third-Display

config DRM_TCC_FOURTH
        bool "TCC fourth display type"
	depends on (ARCH_TCC803X || ARCH_TCC805X)
        help
          Choose this option if you want to use third display for DRM.

config DRM_TCC_FOURTH_VIC
	int "Video Identification Code for FOURTH"
  depends on DRM_TCC_FOURTH
  default 1024
  range 1 DRM_TCC_VIC_MAX
	help
	  Video Identification Code for fourth-Display


config DRM_TCC_SCREEN_SHARE
	bool "TCC Screen shared display type"
	depends on DRM_TCC && TCC_SCREEN_SHARE
	help
		Choose this option if you want to use Screen shared function.

config DRM_TCC_SCREEN_SHARE_VIC
	int "Video Identification Code for FOURTH"
	depends on DRM_TCC_SCREEN_SHARE
	default 1024
	range 1 DRM_TCC_VIC_MAX
	help
		Video Identification Code for Screen share Display

comment "Encoders and Bridges"

config DRM_TCC_DPI
	bool "Parallel output"
	select DRM_PANEL
	help
	  This enables support for TCC parallel output.

config DRM_TCC_DPI_PROC
	bool "Proc F/S for debug"
  default n
	depends on DRM_TCC_DPI
	help
	  This provides proc F/S to debug DPI

endif

#
# Debugging messages
#
menuconfig DRM_DRV_DEBUG
        bool "DRM Debugging messages (DEVELOPMENT)"
        depends on DRM_TCC
        help
          Choose this option if you want to use debugging messages (DEVELOPMENT).
          You can choice various debugging messages.
          Kernel debugging level is 'KERN_DEBUG <7>'. (use "dmesg -n 8")

if DRM_DRV_DEBUG

config DRM_UT_CORE
        bool "DRM core messages"
        help
          Choose this option if you want to enable DRM core debugging messages.
          Kernel debugging level is 'KERN_DEBUG <7>'. (use "dmesg -n 8")

config DRM_UT_DRIVER
        bool "DRM driver messages"
        help
          Choose this option if you want to enable DRM driver debugging messages.
          Kernel debugging level is 'KERN_DEBUG <7>'. (use "dmesg -n 8")

config DRM_UT_KMS
        bool "DRM KMS messages"
        help
          Choose this option if you want to enable DRM KMS debugging messages.
          Kernel debugging level is 'KERN_DEBUG <7>'. (use "dmesg -n 8")

config DRM_UT_PRIME
        bool "DRM PRIME messages"
        help
          Choose this option if you want to enable DRM PRIME debugging messages.
          Kernel debugging level is 'KERN_DEBUG <7>'. (use "dmesg -n 8")

endif
```

## drivers/gpu/imgtec/Kconfig
```kconfig
config POWERVR_ADF_FBDEV
	tristate "ADF driver for fbdev-only systems"
	depends on ADF
	depends on FB
	help
	  Driver for systems with only fbdev video drivers.

	  Say Y here if your SoC has a pre-existing fbdev driver, but
	  no native ADF driver. This driver will wrap the fbdev driver
	  to provide minimal compatibility with ADF.
	  
config POWERVR_DC_FBDEV
        bool "DC_FBDEV driver for Telechips Linux fbdev"
        default n

source "drivers/gpu/imgtec/pvrsrvkm/Kconfig"

#source "drivers/gpu/imgtec/tc/Kconfig"

#source "drivers/gpu/imgtec/mt8173/Kconfig"

#source "drivers/gpu/imgtec/sunxi/Kconfig"

#source "drivers/gpu/imgtec/rk3368/Kconfig"

source "drivers/gpu/imgtec/tcc_9xtp/Kconfig"
```

## drivers/gpu/imgtec/rk3368/Kconfig
```kconfig
config POWERVR_RK3368
	bool "PowerVR ROCKCHIP support"
	default y
	depends on POWERVR_ROGUE
	depends on ARCH_ROCKCHIP
```

## drivers/gpu/imgtec/sunxi/Kconfig
```kconfig
config POWERVR_SUNXI
	bool "PowerVR SUNXI support"
	default y
	depends on POWERVR_ROGUE
	depends on ARCH_SUN9I
```

## drivers/gpu/imgtec/tcc_9xtp/Kconfig
```kconfig
config POWERVR_TCC9XTP
	bool "PowerVR Telechips support"
	default y
	depends on POWERVR_ROGUE
	depends on ARCH_TCC
```

## drivers/gpu/vivante/gc/Kconfig
```kconfig
menuconfig GC_GPU
	tristate "Vivante-GC support"
	default y
	depends on (ARCH_TCC897X || ARCH_TCC898X || ARCH_TCC570X || ARCH_TCC802X)
	---help---
	  Device driver for the VIVANTE GC GPU

if GC_GPU
config SUPPORT_DIRECT_ROTATION
	default n
	bool "Only Support direct rotation"
	help
		Only for direct rotation function

config SUPPORT_2D_COMPRESSION
    default y
	depends on (ARCH_TCC898X && !SUPPORT_DIRECT_ROTATION)
	bool "Support 2D Compression"
	help
		2D FBC for DEC100

config ADDITIONAL_TS_BUFFER_LINES
    int "Additional lines in framebuffer (4096x2160 => 16, 3840x2160 => 12)"
	    depends on (SUPPORT_2D_COMPRESSION)
	    default 16
	    help
	       Select additional lines for ts-buffer in framebuffer.
endif
```

## drivers/i-dxb/Kconfig
```kconfig
#
# iDxB configuration
#

menu "iDxB support"

comment "iDxB support"

config iDxB_SUPPORT
	bool "iDxB support"

source "drivers/i-dxb/silabs/Kconfig"

source "drivers/i-dxb/availink/Kconfig"

endmenu
```

## drivers/i-dxb/availink/Kconfig
```kconfig
# 
# SiLabs devices
#

comment "Availink Tuner devices"
	depends on iDxB_SUPPORT

source "drivers/i-dxb/availink/avl62x1/Kconfig"
```

## drivers/i-dxb/availink/Kconfig.bak
```kconfig
# 
# SiLabs devices
#

comment "Availink Tuner devices"
	depends on iDxB_SUPPORT

source "drivers/i-dxb/availink/AVL62x1/Kconfig"
```

## drivers/i-dxb/availink/avl62x1/Kconfig
```kconfig
# 
# AVL62X1 configurations
#

config iDxB_AVAILINK_AVL62X1
	tristate "AVL62X1 support"
	depends on iDxB_SUPPORT
```

## drivers/i-dxb/maxlinear/Kconfig
```kconfig
# 
# SiLabs devices
#

comment "Maxlinear Tuner devices"
	depends on iDxB_SUPPORT

source "drivers/i-dxb/maxlinear/mxl532c/Kconfig"
```

## drivers/i-dxb/maxlinear/mxl532c/Kconfig
```kconfig
# 
# MXL532C configurations
#

config iDxB_MAXLINEAR_MXL532C
	tristate "mxl532c support"
	depends on iDxB_SUPPORT
```

## drivers/i-dxb/silabs/Kconfig
```kconfig
# 
# SiLabs devices
#

comment "SiLabs devices"
	depends on iDxB_SUPPORT

source "drivers/i-dxb/silabs/si2166/Kconfig"
```

## drivers/i-dxb/silabs/si2166/Kconfig
```kconfig
# 
# SI2166 configurations
#
menu "SI2166 support"
comment "SI2166 support"

config iDxB_SILABS_SI2166_Device
	tristate "SI2166 support as device"
	depends on iDxB_SUPPORT

config iDxB_SILABS_SI2166_LinuxFE
	tristate "SI2166 support as LinuxFE"
	depends on iDxB_SUPPORT

endmenu
```

## drivers/ictc/Kconfig
```kconfig
config ICTC
	bool "ICTC driver"
	depends on ARCH_TCC803X=y || ARCH_TCC805X=y
	default n
	help
	    Telechips ICTC driver
	    ICTC stands for input capture time counter.
	    It receives PDM signal as input and generates
	    interrupts related to the signal to give a chance
	    to do something.
```

## drivers/input/tc_touch_share/Kconfig
```kconfig
menuconfig TCC_TOUCH_SHARE
	bool "Telechips Touch Share"
	default n
	help
		The Share Touch between Main-core and Sub-core.
		When this option is activated, the RECEIVE and BRIDGE menus are created
		you must select the CONFIG suitable for the core
		Main-Core - TCC_TOUCH_BRIDGE / Sub-Core - TCC_TOUCH_RECEIVE

if TCC_TOUCH_SHARE

choice
	prompt "Telechips Touch Share Driver Select"
	default TCC_TOUCH_RECEIVE if (TCC805X_CA53Q || TCC803X_CA7S)
	default TCC_TOUCH_BRIDGE
	help
		This options touch share driver select.

		TCC Touch Bridge shares touch data to other core.
		Touch Receive receives touch data from Touch Bridge
		and generates touch event.

config TCC_TOUCH_BRIDGE
	bool "TCC Touch Bridge Driver"
	depends on TCC_MULTI_MAILBOX
	help
		This driver acts as an input handler
		It sends touch data to the Sub-core through the mbox.
		In order for this driver to work, the touch driver must be registered.
		Because it operates Mbox communication and touch data,
		It has a dependency on the touch driver and tcc multi mailbox driver

config TCC_TOUCH_RECEIVE
	bool "TCC Touch Receiver Driver"
	depends on TCC_MULTI_MAILBOX
	help
		This driver generates touch data of Main-core.
		When the driver is registered, the input device and sysfs are created.
		Controls the transmission of touches based on the state of the sysfs.
		The name of sysfs is touch_state.

endchoice

endif
```

## drivers/input/tcc_early_touch/Kconfig
```kconfig
config TCC_TOUCH_BRIDGE
	tristate "TCC Touch Bridge Driver for TCC803x A53"
	default n
	depends on TCC_MULTI_MAILBOX
	help
		TCC Touch Bridge only supports TCC803x A53.
```

## drivers/mailbox/Kconfig
```kconfig
menuconfig MAILBOX
	bool "Mailbox Hardware Support"
	help
	  Mailbox is a framework to control hardware communication between
	  on-chip processors through queued messages and interrupt driven
	  signals. Say Y if your platform supports hardware mailboxes.

if MAILBOX
config ARM_MHU_MBOX
	tristate "ARM Message Handling Unit (MHU) Mailbox"
	help
	  This driver provides support for inter-processor communication
	  (IPC) between two processors in a SoC.
	  For example, System Control Processor(SCP) with Cortex-M3
	  processor and Application Processors(AP) on few ARM platforms.
	  SCP controls most of the power management on the AP.

config PL320_MBOX
	bool "ARM PL320 Mailbox"
	depends on ARM_AMBA
	help
	  An implementation of the ARM PL320 Interprocessor Communication
	  Mailbox (IPCM), tailored for the Calxeda Highbank. It is used to
	  send short messages between Highbank's A9 cores and the EnergyCore
	  Management Engine, primarily for cpufreq. Say Y here if you want
	  to use the PL320 IPCM support.

endif
```

## drivers/media/platform/tcc-hdmirx/Kconfig
```kconfig
config VIDEO_TCCXX_HDMI_RX
	tristate "Telechips HDMI/MHL RX driver"
	select VIDEOBUF_GEN
	select VIDEOBUF_DMA_SG
	select VIDEOBUF_VMALLOC
	depends on VIDEO_DEV && (ARCH_TCC899X || ARCH_TCC901X)
	help
	  V4L2 HDMI IN Receiver driver support for TCCXXX.
	
config VIDEO_HDMI_RX_MODULE
	tristate "RX Module support"
	depends on VIDEO_TCCXX_HDMI_RX
	help
	   HDMI RX Receiver support

source drivers/media/platform/tcc-hdmirx/module/Kconfig










































 
```

## drivers/media/platform/tcc-hdmirx/module/Kconfig
```kconfig
config VIDEO_HDMI_RX_MODULE_EP9553T
	tristate "Explore EP9553T"
	depends on VIDEO_HDMI_RX_MODULE
	help
	   EP9553T for only Telechips.












































 
```

## drivers/media/platform/tcc-isp/Kconfig
```kconfig
# drivers/media/platform/tcc-isp/Kconfig
#
# Copyright (c) 2020-2020 Telechips Co., Ltd.
#	http://www.telechips.com/
#
# Licensed under GPL

config TCC_ISP
	bool "Telechips ISP driver"
	default y
        depends on ARCH_TCC805X && VIDEO_TCCVIN2
	---help---
	  Support for ISP

# only for TCC805X ES(TCS CV8050C-618)
config TCC_ISP_USE_IOMMU
	bool "FOR 805X ES, Set IOMMU to access I2C controller 7 from ISP"
	default n
	depends on ARCH_TCC805X && VIDEO_TCCVIN2
	---help---
	  This must be set on the TCC805X ES
```

## drivers/media/platform/tcc-mipi-csi2/Kconfig
```kconfig
# drivers/media/platform/tcc-mipi-csi2/Kconfig
#
# Copyright (c) 2020-2020 Telechips Co., Ltd.
#	http://www.telechips.com/
#
# Licensed under GPL

config TCC_MIPI_CSI2
	bool "Telechips MIPI CSI-2 driver"
	default y
        depends on ARCH_TCC803X || ARCH_TCC805X
        depends on VIDEO_TCCVIN2
	---help---
	  This is a V4L2 driver for TCC803X and TCC805X SoC MIPI-CSI2
	  receiver devices.

	  Say Y here to enable MIPI-CSI2 receiver.
	  The driver will be called tcc-mipi-csi2
```
