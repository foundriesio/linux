## drivers/video/fbdev/tcc-fb/vioc/Kconfig
```kconfig
config TCC_VIOC_CONTROLLER
	bool "Telechips TCC support VIOC controller"
	depends on FB && ARCH_TCC
	default y

	help
	  TCC VIOC controller 

	  If unsure, say N.

config VIOC_10BIT
	bool"support 10bit format support in VIOC"
	depends on ((TCC_VIOC_CONTROLLER)&&(ARCH_TCC898X || ARCH_TCC899X || ARCH_TCC901X))
	default y
	help
		This is support LCD CVBS display

config VIOC_MAP_DECOMP
	bool "VIOC MAP Decompressor support for HEVC"
	depends on (ARCH_TCC803X || ARCH_TCC899X || ARCH_TCC898X || ARCH_TCC896X || ARCH_TCC901X)
	default y

	help
	  TCC VIOC MAP CONVERTER Block. 
	  Decompress  HEVC compressed data.

	  If unsure, say N.

if VIOC_MAP_DECOMP
config MC_WORKAROUND
	bool"MC Work-Around until CS chip"
    depends on (ARCH_TCC899X || ARCH_TCC901X)
    default y
    help
        MC Work-Around until CS chip
endif

config VIOC_DTRC_DECOMP
	bool "VIOC DTRC Decompressor support for VP9"
	depends on (ARCH_TCC898X)
	default y
	help
		TCC VIOC DTRC CONVERTER Block / Decompress VP9 compressed data.
		If unsure, say N.

config VIOC_AFBCDEC
    bool "Enable AFBC decoder"
    depends on (ARCH_TCC803X || ARCH_TCC899X || ARCH_TCC901X) && MALI_MIDGARD
    default n
    help
        TCC AFBC Decoder

config VIOC_PIXEL_MAPPER
    bool "Support VIOC PIXEL MAPPER(3D LUT)"
    depends on (ARCH_TCC899X || ARCH_TCC901X)
    default y
    help
        This is 3D LUT block in VIOC.

config VIOC_2D_FILTER
    bool "Support VIOC 2D FILTER"
    depends on (ARCH_TCC899X || ARCH_TCC901X)
    default y
    help
        This is 2D Filter block in VIOC.

config VIOC_CHROMA_INTERPOLATOR
    bool "Support VIOC Chroma Interpolator"
    depends on (ARCH_TCC899X || ARCH_TCC901X)
    default y
    help
        This is Chroma Interpolator block in VIOC.


config VIOC_SAR
    bool "Support SAR (SD deblocker)"
    depends on (ARCH_TCC899X || ARCH_TCC901X)
    default n
    help
        This is Image Deblocker block in VIOC.
```

## drivers/video/logo/Kconfig
```kconfig
#
# Logo configuration
#

menuconfig LOGO
	bool "Bootup logo"
	depends on FB || SGI_NEWPORT_CONSOLE
	help
	  Enable and select frame buffer bootup logos.

if LOGO

config FB_LOGO_EXTRA
	bool
	depends on FB=y
	default y if SPU_BASE

config LOGO_LINUX_MONO
	bool "Standard black and white Linux logo"
	default y

config LOGO_LINUX_VGA16
	bool "Standard 16-color Linux logo"
	default y

config LOGO_LINUX_CLUT224
	bool "Standard 224-color Linux logo"
	default y

config LOGO_TCC_1280X720_CLUT224
	bool "Telechips 224-color consumer 1280x720 logo"
	depends on ANDROID
	default n

config LOGO_TCC_1920X720_CLUT224
	bool "Telechips 224-color ivi 1920x720 logo"
	default n

config LOGO_TCC_1920X1080_CLUT224
	bool "Telechips 224-color consumer 1920x1080 logo"
	depends on ANDROID
	default n

config LOGO_PRESERVE_WITHOUT_FB_INIT
       bool "Preserve boot logo from bootloader"
       default n

config LOGO_BLACKFIN_VGA16
	bool "16-colour Blackfin Processor Linux logo"
	depends on BLACKFIN
	default y

config LOGO_BLACKFIN_CLUT224
	bool "224-colour Blackfin Processor Linux logo"
	depends on BLACKFIN
	default y

config LOGO_DEC_CLUT224
	bool "224-color Digital Equipment Corporation Linux logo"
	depends on MACH_DECSTATION || ALPHA
	default y

config LOGO_MAC_CLUT224
	bool "224-color Macintosh Linux logo"
	depends on MAC
	default y

config LOGO_PARISC_CLUT224
	bool "224-color PA-RISC Linux logo"
	depends on PARISC
	default y

config LOGO_SGI_CLUT224
	bool "224-color SGI Linux logo"
	depends on SGI_IP22 || SGI_IP27 || SGI_IP32
	default y

config LOGO_SUN_CLUT224
	bool "224-color Sun Linux logo"
	depends on SPARC
	default y

config LOGO_SUPERH_MONO
	bool "Black and white SuperH Linux logo"
	depends on SUPERH
	default y

config LOGO_SUPERH_VGA16
	bool "16-color SuperH Linux logo"
	depends on SUPERH
	default y

config LOGO_SUPERH_CLUT224
	bool "224-color SuperH Linux logo"
	depends on SUPERH
	default y

config LOGO_M32R_CLUT224
	bool "224-color M32R Linux logo"
	depends on M32R
	default y

endif # LOGO
```

## sound/soc/mvf/Kconfig
```kconfig
menuconfig SND_MVF_SOC
	tristate "SoC Audio for Freescale Faraday CPUs"
	depends on ARCH_MVF && IMX_HAVE_PLATFORM_MVF_SAI
	select SND_PCM
	default y
	help
	  Say Y or M if you want to add support for codecs attached to
	  the Faraday SAI interface.


if SND_MVF_SOC

config SND_MVF_AC97
	tristate "Vybrid SAI Software AC97"
	select AC97_BUS
	select SND_AC97_CODEC
	select SND_SOC_AC97_BUS

config SND_MVF_SOC_TWR
	tristate

config SND_SOC_MVF_SGTL5000
	tristate "SoC Audio support for Faraday boards with sgtl5000"
	depends on I2C
	select SND_SOC_SGTL5000
	select SND_MVF_SOC_TWR
	default y
	help
	  Say Y if you want to add support for SoC audio on an Farday board with
	  a sgtl5000 codec.

config SND_SOC_MVF_COLIBRI_VF61
	tristate "SoC AC97 Audio support for Colibri VF61"
	depends on MACH_COLIBRI_VF61
	select SND_MVF_AC97
	select SND_SOC_WM9712
	help
	  Say Y if you want to add support for SoC audio on Toradex
	  Colibri VF61 module.

endif
```

## sound/soc/tcc/Kconfig
```kconfig
menu "SoC Audio for Telechips CPUs"

comment "SoC Audio options for TCC CPUs:"

config SND_SOC_TCC
	tristate "ASoC for Telechips"
	select SND_SOC_TCC_AUDIO_CHMUX if ARCH_TCC898X != n
	select SND_SOC_TCC_AUDIO_CHMUX if ARCH_TCC899X != n
	select SND_SOC_TCC_AUDIO_CHMUX if ARCH_TCC803X != n
	depends on ARCH_TCC && SND_SOC
	default y
	help
		Telechips I2S, SPDIF, CDIF Driver

config SND_SOC_TCC_AUDIO_CHMUX
	tristate
	depends on SND_SOC_TCC
	help
		Telechips ASoC CHMUX Driver

config SND_SOC_TCC_CARD
	tristate "ASoC CARD for Telechips"
	depends on SND_SOC_TCC
	default y
	help
		Telechips ASoC Card Driver

source "sound/soc/tcc/asrc/Kconfig"

config SND_SOC_TCC_ASRC_M2M_PCM
	tristate "SRC PCM Driver for Telechips"
	depends on SND_SOC_TCC
	default n

source "sound/soc/tcc/virtual/Kconfig"

endmenu
```

## sound/soc/tcc/amd/Kconfig
```kconfig
#'

config TCC_MULTI_MAILBOX_AUDIO
	tristate "Telechips Mailbox Audio Client for T-Sound"
	depends on TCC_MULTI_MAILBOX
	default n

config TCC_MULTI_MAILBOX_AUDIO_R5
	tristate "Telechips Mailbox Audio Client for T-Sound(R5)"
	depends on TCC_MULTI_MAILBOX_AUDIO
	default n
```

## sound/soc/tcc/asrc/Kconfig
```kconfig
#'

config SND_SOC_TCC_ASRC
	tristate "Telechips ASRC Driver"
	depends on (ARCH_TCC802X || ARCH_TCC803X || ARCH_TCC805X)
	default n
	help
		Telechips ASRC Driver

config SND_SOC_TCC_ASRC_CARD
	tristate "Telechips ASRC ALSA Card Driver"
	depends on (SND_SOC_TCC_ASRC)
	default y
	help
		Telechips ASRC ALSA CARD Driver
```

## sound/soc/tcc/virtual/Kconfig
```kconfig
config SND_SOC_TCC_VIR_AUDIO
	tristate "Virtual ASoC & SRC PCM Driver for Telechips AMP System"
	depends on SND_SOC_TCC
	default n
	help
		Telechips AMP System Virtual ASoC Card Driver
```

## sound/soc/tcc_tcc897x/Kconfig
```kconfig
config SND_TCC_AUDIO_DSP
	tristate "SW Audio DSP for the Telechips TCC chip"
	depends on ARCH_TCC && SND_SOC
	help
	  Say Y if you want to add support for SW Audio DSP function on Telechips

config SND_SOC_TCC
	tristate "SoC Audio for the Telechips TCC chip"
	depends on ARCH_TCC && SND_SOC
	help
	  Say Y or M if you want to add support for codecs attached to
	  the TCC I2S interface. You will also need
	  to select the audio interfaces to support below.
	  
config SND_SOC_TCC_BOARD_WM8731
	bool "WM8731"
	select SND_SOC_WM8731
	depends on SND_SOC_TCC
	help
	  Say Y if you want to add support for SoC audio on Telechips
	  TCC (WM8731).

config SND_SOC_TCC_BOARD_WM8581
	bool "WM8581"
	select SND_SOC_WM8581
	depends on SND_SOC_TCC 
	help
	  Say Y if you want to add support for SoC audio on Telechips
	  TCC (WM8581).

config SND_SOC_TCC_BOARD_WM8524
	bool "WM8524"
	select SND_SOC_WM8524
	depends on SND_SOC_TCC

	help
	  Say Y if you want to add support for SoC audio on Telechips
	  TCC (WM8524).
  
config SND_SOC_TCC_BOARD_DUMMY
	bool "TCC DUMMY"
	select SND_SOC_DUMMY
	depends on SND_SOC_TCC

	help
	  Say Y if you want to add support for SoC audio on Telechips
	  TCC (DUMMY).

config SND_SOC_TCC8970_BOARD_STB
	tristate "TCC8970 STB"
	select SND_SOC_WM8524
	select SND_SOC_DUMMY
	depends on SND_SOC_TCC && ARCH_TCC897X

	help
	  Say Y if you want to add support for SoC audio on TCC8970 STB(WM8524)

config SND_SOC_TCC8971_BOARD_LCN1
	tristate "TCC8971 LCN 1.0"
	select SND_SOC_WM8731
	select SND_SOC_DUMMY
	depends on SND_SOC_TCC && ARCH_TCC897X

	help
	  Say Y if you want to add support for SoC audio on TCC8971 LCN 1.0(WM8731)

config SND_SOC_TCC8971_BOARD_LCN2
	tristate "TCC8971 LCN 2.0"
	select SND_SOC_AK4601
	select SND_SOC_DUMMY
	depends on SND_SOC_TCC && ARCH_TCC897X

	help
	  Say Y if you want to add support for SoC audio on TCC8971 LCN 2.0(AK4601)
	 
config SND_SOC_TCC8971_BOARD_LCN3
	tristate "TCC8971 LCN 3.0"
	select SND_SOC_AK4601
	select SND_SOC_DUMMY
	depends on SND_SOC_TCC && ARCH_TCC897X

	help
	  Say Y if you want to add support for SoC audio on TCC8971 LCN 3.0(AK4601)
	 
config SND_SOC_TCC5700_BOARD_HD_DMB
	tristate "TCC5700 HD-DMB"
	select SND_SOC_WM8524
	select SND_SOC_DUMMY
	depends on SND_SOC_TCC && ARCH_TCC570X

	help
	  Say Y if you want to add support for SoC audio on TCC5700 HD-DMB(WM8524)

config SND_SOC_TCC8021_BOARD_EVM
	tristate "TCC8021 EVM 1.0"
	select SND_SOC_AK4601
	select SND_SOC_DUMMY
	depends on SND_SOC_TCC && ARCH_TCC802X

	help
	  Say Y if you want to add support for SoC audio on TCC8021 EVM 1.0(AK4601)
	  TCC8021 EVM LIST
		- TCC8021/2_CPU_MOD_D3084_6L_SV01

config SND_SOC_TCC8021_BOARD_EVM2
	tristate "TCC8021 EVM 2.0"
	select SND_SOC_AK4601
	select SND_SOC_DUMMY
	depends on SND_SOC_TCC && ARCH_TCC802X

	help
	  Say Y if you want to add support for SoC audio on TCC8021 EVM 2.0(AK4601)
	  TCC8021 EVM LIST
		- TCC8021/2_CPU_MOD_D3084_6L_SV20

config SND_SOC_TCC_PCM_V10
	bool
	depends on SND_SOC_TCC && (ARCH_TCC897X || ARCH_TCC570X)
	default y
	help
	  Say Y if you want to add support for SoC audio on PCM driver V1.0

config SND_SOC_TCC_PCM_V20
	bool
	depends on SND_SOC_TCC && (ARCH_TCC898X || ARCH_TCC802X)
	default y
	help
	  Say Y if you want to add support for SoC audio on PCM driver V2.0

source "sound/soc/tcc/asrc/Kconfig"
```

## sound/soc/tcc_tcc897x/asrc/Kconfig
```kconfig
config TCC_ASRC
	tristate "Telechips ASRC Driver"
	depends on (ARCH_TCC802X)
	default n
	help
		Telechips ASRC Driver
```
