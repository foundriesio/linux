/*
 * Copyright (C) 2016 Toradex AG
 *
 * This program is free software; you can redistribute it and/or modify
 * it under the terms of the GNU General Public License version 2 as
 * published by the Free Software Foundation.
 */

#include "imx7s.dtsi"
#include "imx7-colibri.dtsi"

/ {
	memory {
		reg = <0x80000000 0x10000000>;
	};
};

&gpmi {
	status = "okay";
};
