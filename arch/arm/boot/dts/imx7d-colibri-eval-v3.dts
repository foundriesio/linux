/*
 * Copyright 2016 Toradex AG
 *
 * This program is free software; you can redistribute it and/or modify
 * it under the terms of the GNU General Public License as published by
 * the Free Software Foundation; either version 2 of the License, or
 * (at your option) any later version.
 */

/dts-v1/;
#include "imx7d-colibri.dtsi"
#include "imx7-colibri-eval-v3.dtsi"

/ {
	model = "Toradex Colibri iMX7D on Colibri Evaluation Board V3";
	compatible = "toradex,colibri_imx7d-eval", "toradex,colibri_imx7d", \
		     "fsl,imx7d";
};

&usbotg2 {
	vbus-supply = <&reg_usb_otg2_vbus>;
	status = "okay";
};
