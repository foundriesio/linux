// SPDX-License-Identifier: (GPL-2.0+ OR MIT)
/*
 * Copyright (C) Telechips Inc.
 */

#include "../../../../../include/generated/autoconf.h"

#include <dt-bindings/pmap/tcc803x/pmap-tcc803x-android-ivi.h>

#define CONF_ANDROID
#define CONF_ARCH_TCC803X

#define CONF_SUPPORT_TCC_WAVE410_HEVC
#define CONF_SUPPORT_TCC_JPU
#define CONF_VDEC_CNT_2
#define CONF_VENC_CNT_1

#undef SZ_1MB
#define SZ_1MB                          (1024*1024)
#define ARRAY_16MBYTE(x)                ((((x) + ((16*SZ_1MB)-1))>> 24) << 24)
#define ARRAY_MBYTE(x)                  ((((x) + (SZ_1MB-1))>> 20) << 20)
#define ARRAY_256KBYTE(x)               ((((x) + ((SZ_1MB/4)-1))>> 18) << 18)

// For HEVC/VPU framebuffer_size Calculation
#define WAVE_CAL_PROCBUFFER(use,w,h,f) \
	(((0x700000 /*the rest except framebuffer and workbuffer*/) + \
	 (ARRAY_MBYTE(((w*h*2014)/1000)*(f+7))))*use)

#define VPU_CAL_PROCBUFFER(use,w,h,f) \
	(((0x400000 /*the rest except framebuffer and workbuffer*/) + \
	 ARRAY_MBYTE(((w*h*182)/100)*(f+7)))*use)

#define VPU_CAL_ENC_PROCBUFFER(use,w,h,f) \
	(((0x300000 /*the rest except framebuffer and workbuffer*/) + \
	ARRAY_MBYTE(w*h*3/2) + \
	 ARRAY_MBYTE((((w+15)/16*16)*((h+15)/16*16)*3/2)*f))*use)

////////////////////////////////////////////////////////////////////////////////
//                     NEED TO BE OPTIMIZED BY CUSTOMER
////////////////////////////////////////////////////////////////////////////////

// If there's rotation h/w block and video rotation (90/180/270) is required.
//#define SUPPORT_ROTATION

//********************************* VPU/HEVC **********************************/
//Should sync with hardware/telechips/omx/omx_videodec_interface/include/vdec.h

#define SUPPORT_VIDEO_MAX_WIDTH         (1920)
#define SUPPORT_VIDEO_MAX_HEIGHT        (1088)

#define SUPPORT_VIQE_MAX_WIDTH          (1920)
#define SUPPORT_VIQE_MAX_HEIGHT         (1088)

/*
 * DECODER on VPU
 *
 * INST_XXX_USE : Decide whether to use an instance or not. 1 means to use.
 * INST_XXX_IS_HEVC_TYPE : Decide whether or not to set the HEVC codec type.
 *                      1 means to set HEVC (please check
 *                      "CONFIG_SUPPORT_TCC_HEVC" Feature in order to enable
 *                      HEVC at first.)
 * INST_XXX_VIDEO_WIDTH : Set the width of the video (HEVC: 32x alignment,
 *                      Other: 16x alignment)
 * INST_XXX_VIDEO_HEIGHT : Set the width of the video (HEVC: 32x alignment,
 *                      Other: 16x alignment)
 * INST_XXX_MAX_FRAMEBUFFER : Set the number of frame buffers (HEVC-4K: 7,
 *                      Others: 1~24)
 */
#define INST_1ST_USE                    (1)
#define INST_1ST_IS_HEVC_TYPE           (1)
#define INST_1ST_VIDEO_WIDTH            (1920)
#define INST_1ST_VIDEO_HEIGHT           (1088)
#define INST_1ST_MAX_FRAMEBUFFERS       (24)

#define INST_2ND_USE                    (0)
#define INST_2ND_IS_HEVC_TYPE           (0)
#define INST_2ND_VIDEO_WIDTH            (1920)
#define INST_2ND_VIDEO_HEIGHT           (1088)
#define INST_2ND_MAX_FRAMEBUFFERS       (24)

#define INST_3RD_USE                    (0)
#define INST_3RD_IS_HEVC_TYPE           (0)
#define INST_3RD_VIDEO_WIDTH            (720)
#define INST_3RD_VIDEO_HEIGHT           (576)
#define INST_3RD_MAX_FRAMEBUFFERS       (24)

#define INST_4TH_USE                    (0)
#define INST_4TH_IS_HEVC_TYPE           (0)
#define INST_4TH_VIDEO_WIDTH            (720)
#define INST_4TH_VIDEO_HEIGHT           (576)
#define INST_4TH_MAX_FRAMEBUFFERS       (24)

#define INST_5TH_USE                    (0)
#define INST_5TH_IS_HEVC_TYPE           (0)
#define INST_5TH_VIDEO_WIDTH            (720)
#define INST_5TH_VIDEO_HEIGHT           (576)
#define INST_5TH_MAX_FRAMEBUFFERS       (24)

/*
 * ENCODER on VPU
 *
 * INST_ENC_XXX_USE : Decide whether to use an instance or not. 1 means to use.
 * INST_ENC_XXX_IS_HEVC_TYPE : Decide whether or not to set the HEVC codec type.
 *                      1 means to set HEVC (please check
 *                      "CONFIG_SUPPORT_TCC_HEVC" Feature in order to enable
 *                      HEVC at first.)
 * INST_ENC_XXX_VIDEO_WIDTH : Set the width of the video (16x alignment)
 * INST_ENC_XXX_VIDEO_HEIGHT : Set the width of the video (16x alignment)
 * INST_ENC_XXX_MAX_FRAMEBUFFERS : 8 :: fixed value. ask right engineer
 *                      if you want to change it.
 */
#define INST_ENC_1ST_USE                (0)
#define INST_ENC_1ST_IS_HEVC_TYPE       (0)
#define INST_ENC_1ST_VIDEO_WIDTH        (1920)
#define INST_ENC_1ST_VIDEO_HEIGHT       (1088)
#define INST_ENC_1ST_MAX_FRAMEBUFFERS   (8)

#define INST_ENC_2ND_USE                (0)
#define INST_ENC_2ND_IS_HEVC_TYPE       (0)
#define INST_ENC_2ND_VIDEO_WIDTH        (1280)
#define INST_ENC_2ND_VIDEO_HEIGHT       (720)
#define INST_ENC_2ND_MAX_FRAMEBUFFERS   (8)

#define INST_ENC_3RD_USE                (0)
#define INST_ENC_3RD_IS_HEVC_TYPE       (0)
#define INST_ENC_3RD_VIDEO_WIDTH        (800)
#define INST_ENC_3RD_VIDEO_HEIGHT       (480)
#define INST_ENC_3RD_MAX_FRAMEBUFFERS   (8)

#define INST_ENC_4TH_USE                (0)
#define INST_ENC_4TH_IS_HEVC_TYPE       (0)
#define INST_ENC_4TH_VIDEO_WIDTH        (640)
#define INST_ENC_4TH_VIDEO_HEIGHT       (480)
#define INST_ENC_4TH_MAX_FRAMEBUFFERS   (8)

#define INST_ENC_5TH_USE                (0)
#define INST_ENC_5TH_IS_HEVC_TYPE       (0)
#define INST_ENC_5TH_VIDEO_WIDTH        (640)
#define INST_ENC_5TH_VIDEO_HEIGHT       (480)
#define INST_ENC_5TH_MAX_FRAMEBUFFERS   (8)

#define INST_ENC_6TH_USE                (0)
#define INST_ENC_6TH_IS_HEVC_TYPE       (0)
#define INST_ENC_6TH_VIDEO_WIDTH        (640)
#define INST_ENC_6TH_VIDEO_HEIGHT       (480)
#define INST_ENC_6TH_MAX_FRAMEBUFFERS   (8)

#define INST_ENC_7TH_USE                (0)
#define INST_ENC_7TH_IS_HEVC_TYPE       (0)
#define INST_ENC_7TH_VIDEO_WIDTH        (640)
#define INST_ENC_7TH_VIDEO_HEIGHT       (480)
#define INST_ENC_7TH_MAX_FRAMEBUFFERS   (8)

#define INST_ENC_8TH_USE                (0)
#define INST_ENC_8TH_IS_HEVC_TYPE       (0)
#define INST_ENC_8TH_VIDEO_WIDTH        (640)
#define INST_ENC_8TH_VIDEO_HEIGHT       (480)
#define INST_ENC_8TH_MAX_FRAMEBUFFERS   (8)

#define INST_ENC_9TH_USE                (0)
#define INST_ENC_9TH_IS_HEVC_TYPE       (0)
#define INST_ENC_9TH_VIDEO_WIDTH        (640)
#define INST_ENC_9TH_VIDEO_HEIGHT       (480)
#define INST_ENC_9TH_MAX_FRAMEBUFFERS   (8)

#define INST_ENC_10TH_USE               (0)
#define INST_ENC_10TH_IS_HEVC_TYPE      (0)
#define INST_ENC_10TH_VIDEO_WIDTH       (640)
#define INST_ENC_10TH_VIDEO_HEIGHT      (480)
#define INST_ENC_10TH_MAX_FRAMEBUFFERS  (8)

#define INST_ENC_11TH_USE               (0)
#define INST_ENC_11TH_IS_HEVC_TYPE      (0)
#define INST_ENC_11TH_VIDEO_WIDTH       (640)
#define INST_ENC_11TH_VIDEO_HEIGHT      (480)
#define INST_ENC_11TH_MAX_FRAMEBUFFERS  (8)

#define INST_ENC_12TH_USE               (0)
#define INST_ENC_12TH_IS_HEVC_TYPE      (0)
#define INST_ENC_12TH_VIDEO_WIDTH       (640)
#define INST_ENC_12TH_VIDEO_HEIGHT      (480)
#define INST_ENC_12TH_MAX_FRAMEBUFFERS  (8)

#define INST_ENC_13TH_USE               (0)
#define INST_ENC_13TH_IS_HEVC_TYPE      (0)
#define INST_ENC_13TH_VIDEO_WIDTH       (640)
#define INST_ENC_13TH_VIDEO_HEIGHT      (480)
#define INST_ENC_13TH_MAX_FRAMEBUFFERS  (8)

#define INST_ENC_14TH_USE               (0)
#define INST_ENC_14TH_IS_HEVC_TYPE      (0)
#define INST_ENC_14TH_VIDEO_WIDTH       (640)
#define INST_ENC_14TH_VIDEO_HEIGHT      (480)
#define INST_ENC_14TH_MAX_FRAMEBUFFERS  (8)

#define INST_ENC_15TH_USE               (0)
#define INST_ENC_15TH_IS_HEVC_TYPE      (0)
#define INST_ENC_15TH_VIDEO_WIDTH       (640)
#define INST_ENC_15TH_VIDEO_HEIGHT      (480)
#define INST_ENC_15TH_MAX_FRAMEBUFFERS  (8)

#define INST_ENC_16TH_USE               (0)
#define INST_ENC_16TH_IS_HEVC_TYPE      (0)
#define INST_ENC_16TH_VIDEO_WIDTH       (640)
#define INST_ENC_16TH_VIDEO_HEIGHT      (480)
#define INST_ENC_16TH_MAX_FRAMEBUFFERS  (8)
