// SPDX-License-Identifier: (GPL-2.0+ OR MIT)
/*
 * Copyright (C) 2020 Telechips Inc.
 */

#include "../../../../../include/generated/autoconf.h"

#undef SZ_1MB
#define SZ_1MB 				(1024*1024)
#define ARRAY_16MBYTE(x)          	((((x) + ((16*SZ_1MB)-1))>> 24) << 24)
#define ARRAY_MBYTE(x)            	((((x) + (SZ_1MB-1))>> 20) << 20)
#define ARRAY_256KBYTE(x)         	((((x) + ((SZ_1MB/4)-1))>> 18) << 18)

//***************************** DISPLAY ******************************/
#define PRIMARY_FRAMEBUFFER_WIDTH	1920
#define PRIMARY_FRAMEBUFFER_HEIGHT	720
#define SECONDARY_FRAMEBUFFER_WIDTH	0
#define SECONDARY_FRAMEBUFFER_HEIGHT	0
#define TERTIARY_FRAMEBUFFER_WIDTH	0
#define TERTIARY_FRAMEBUFFER_HEIGHT	0
