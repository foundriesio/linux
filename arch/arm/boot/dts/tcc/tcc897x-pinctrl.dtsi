/*
 * Device tree for Telechips TCC897x pinctrl
 *
 * Copyright (C) 2018 Telechips Inc. - http://www.telechips.com
 *
 * This file is dual-licensed: you can use it either under the terms
 * of the GPL or the X11 license, at your option. Note that this dual
 * licensing only applies to this file, and not this project as a
 * whole.
 *
 *  a) This file is free software; you can redistribute it and/or
 *     modify it under the terms of the GNU General Public License as
 *     published by the Free Software Foundation; either version 2 of the
 *     License, or (at your option) any later version.
 *
 *     This file is distributed in the hope that it will be useful,
 *     but WITHOUT ANY WARRANTY; without even the implied warranty of
 *     MERCHANTABILITY or FITNESS FOR A PARTICULAR PURPOSE.  See the
 *     GNU General Public License for more details.
 *
 * Or, alternatively,
 *
 *  b) Permission is hereby granted, free of charge, to any person
 *     obtaining a copy of this software and associated documentation
 *     files (the "Software"), to deal in the Software without
 *     restriction, including without limitation the rights to use,
 *     copy, modify, merge, publish, distribute, sublicense, and/or
 *     sell copies of the Software, and to permit persons to whom the
 *     Software is furnished to do so, subject to the following
 *     conditions:
 *
 *     The above copyright notice and this permission notice shall be
 *     included in all copies or substantial portions of the Software.
 *
 *     THE SOFTWARE IS PROVIDED "AS IS", WITHOUT WARRANTY OF ANY KIND,
 *     EXPRESS OR IMPLIED, INCLUDING BUT NOT LIMITED TO THE WARRANTIES
 *     OF MERCHANTABILITY, FITNESS FOR A PARTICULAR PURPOSE AND
 *     NONINFRINGEMENT. IN NO EVENT SHALL THE AUTHORS OR COPYRIGHT
 *     HOLDERS BE LIABLE FOR ANY CLAIM, DAMAGES OR OTHER LIABILITY,
 *     WHETHER IN AN ACTION OF CONTRACT, TORT OR OTHERWISE, ARISING
 *     FROM, OUT OF OR IN CONNECTION WITH THE SOFTWARE OR THE USE OR
 *     OTHER DEALINGS IN THE SOFTWARE.
 */

&pinctrl {
	gpa: gpa {
		gpio-controller;
		#gpio-cells = <2>;
		reg = <0x0 0 32>;
	};

	gpb: gpb {
		gpio-controller;
		#gpio-cells = <2>;
		reg = <0x40 0 32>;
	};

	gpc: gpc {
		gpio-controller;
		#gpio-cells = <2>;
		reg = <0x80 0 32>;
	};

	gpd: gpd {
		gpio-controller;
		#gpio-cells = <2>;
		reg = <0xc0 0 32>;
	};

	gpe: gpe {
		gpio-controller;
		#gpio-cells = <2>;
		reg = <0x100 0 32>;
	};

	gpf: gpf {
		gpio-controller;
		#gpio-cells = <2>;
		reg = <0x140 0 32>;
	};

	gpg: gpg {
		gpio-controller;
		#gpio-cells = <2>;
		reg = <0x180 0 32>;
	};

	gphdmi: gphdmi {
		gpio-controller;
		#gpio-cells = <2>;
		reg = <0x1c0 0 32>;
	};

	gpsd: gpsd { /*GPSD3*/
		gpio-controller;
		#gpio-cells = <2>;
		reg = <0x240 0 32>;
	};

	gpadc: gpadc {	/* dummy regs. */
		gpio-controller;
		#gpio-cells = <2>;
		reg = <0x2C0 2 32>;	/* use 2~9 pins */
	};

	tco_0_0: tco_0_0 {
		telechips,pins = "gpc-19";
		telechips,pin-function = <4>;
	};

	tco_0_0_idle: tco_0_0_idle {
		telechips,pins = "gpc-19";
		telechips,pin-function = <0>;
		telechips,output-low = <0>;
	};

	tco_0_1: tco_0_1 {
		telechips,pins = "gpc-23";
		telechips,pin-function = <4>;
	};

	tco_0_1_idle: tco_0_1_idle {
		telechips,pins = "gpc-23";
		telechips,pin-function = <0>;
		telechips,output-low = <0>;
	};

	tco_0_2: tco_0_2 {
		telechips,pins = "gpd-9";
		telechips,pin-function = <9>;
	};

	tco_0_2_idle: tco_0_2_idle {
		telechips,pins = "gpd-9";
		telechips,pin-function = <0>;
		telechips,output-low = <0>;
	};

	tco_0_3: tco_0_3 {
		telechips,pins = "gpe-12";
		telechips,pin-function = <7>;
	};

	tco_0_3_idle: tco_0_3_idle {
		telechips,pins = "gpe-12";
		telechips,pin-function = <0>;
		telechips,output-low = <0>;
	};

	tco_0_4: tco_0_4 {
		telechips,pins = "gpf-16";
		telechips,pin-function = <11>;
	};

	tco_0_4_idle: tco_0_4_idle {
		telechips,pins = "gpf-16";
		telechips,pin-function = <0>;
		telechips,output-low = <0>;
	};

	tco_0_5: tco_0_5 {
		telechips,pins = "gpg-5";
		telechips,pin-function = <7>;
	};

	tco_0_5_idle: tco_0_5_idle {
		telechips,pins = "gpg-5";
		telechips,pin-function = <0>;
		telechips,output-low = <0>;
	};

	pwm_c_23: pwm_c_23 {
		telechips,pins = "gpc-23";
		telechips,pin-function = <4>;
		telechips,drive-strength = <3>;
		telechips,no-pull = <1>;
		telechips,input_buffer_disable;
		telechips,input-disable;
	};

	pwm_c_23_idle: pwm_c_23_idle {
		telechips,pins = "gpc-23";
		telechips,pin-function = <0>;
		telechips,output-low = <0>;
	};

	edi_xd {
		telechips,pins = "gpa-0", "gpa-1", "gpa-2", "gpa-3",
		                 "gpa-4", "gpa-5", "gpa-6", "gpa-7";
		telechips,pin-function = <1>;
	};

	edi_xa {
		telechips,pins = "gpa-8", "gpa-9";
		telechips,pin-function = <1>;
	};

	edi_oen {
		telechips,pins = "gpa-10";
		telechips,pin-function = <1>;
	};

	edi_wen {
		telechips,pins = "gpa-11";
		telechips,pin-function = <1>;
	};

	edi_csn {
		telechips,pins = "gpa-12", "gpa-13", "gpa-14", "gpa-15";
		telechips,pin-function = <1>;
	};

	sd0_clk: sd0_clk {
		telechips,pins = "gpsd-0";
		telechips,pin-function = <1>;
		telechips,drive-strength = <3>;
		telechips,pull-disable;
		telechips,output-low;
	};

	sd0_cmd: sd0_cmd {
		telechips,pins = "gpsd-1";
		telechips,pin-function = <1>;
		telechips,drive-strength = <3>;
		telechips,pull-disable;
		telechips,output-low;
	};

	sd0_bus1: sd0_bus1 {
		telechips,pins = "gpsd-2";
		telechips,pin-function = <1>;
		telechips,drive-strength = <2>;
		telechips,pull-disable;
		telechips,output-low;
	};

	sd0_bus4: sd0_bus4 {
		telechips,pins = "gpsd-2", "gpsd-3", "gpsd-4", "gpsd-5";
		telechips,pin-function = <1>;
		telechips,drive-strength = <3>;
		telechips,pull-disable;
		telechips,output-low;
	};

	sd0_bus8: sd0_bus8 {
		telechips,pins = "gpsd-2", "gpsd-3", "gpsd-4", "gpsd-5", "gpsd-6", "gpsd-7", "gpsd-8", "gpsd-9";
		telechips,pin-function = <1>;
		telechips,drive-strength = <3>;
		telechips,pull-disable;
		telechips,output-low;
	};

	sd0_clk_idle: sd0_clk_idle {
		telechips,pins = "gpsd-0";
		telechips,pin-function = <0>;
		telechips,pull-disable;
		telechips,output-low;
	};

	sd0_cmd_idle: sd0_cmd_idle {
		telechips,pins = "gpsd-1";
		telechips,pin-function = <0>;
		telechips,pull-disable;
		telechips,output-low;
	};

	sd0_bus1_idle: sd0_bus1_idle {
		telechips,pins = "gpsd-2";
		telechips,pin-function = <0>;
		telechips,pull-disable;
		telechips,output-low;
	};

	sd0_bus4_idle: sd0_bus4_idle {
		telechips,pins = "gpsd-2", "gpsd-3", "gpsd-4", "gpsd-5";
		telechips,pin-function = <0>;
		telechips,pull-disable;
		telechips,output-low;
	};

	sd0_bus8_idle: sd0_bus8_idle {
		telechips,pins = "gpsd-2", "gpsd-3", "gpsd-4", "gpsd-5", "gpsd-6", "gpsd-7", "gpsd-8", "gpsd-9";
		telechips,pin-function = <0>;
		telechips,pull-disable;
		telechips,output-low;
	};

	sd1_clk: sd1_clk {
		telechips,pins = "gpa-7";
		telechips,pin-function = <2>;
		telechips,drive-strength = <3>;
	};

	sd1_cmd: sd1_cmd {
		telechips,pins = "gpa-8";
		telechips,pin-function = <2>;
		telechips,drive-strength = <3>;
	};

	sd1_bus1: sd1_bus1 {
		telechips,pins = "gpa-9";
		telechips,pin-function = <2>;
		telechips,drive-strength = <2>;
	};

	sd1_bus4: sd1_bus4 {
		telechips,pins = "gpa-9", "gpa-10", "gpa-11", "gpa-12";
		telechips,pin-function = <2>;
		telechips,drive-strength = <2>;
	};

	sd1_bus8: sd1_bus8 {
		telechips,pins = "gpa-9", "gpa-10", "gpa-11", "gpa-12", "gpa-13", "gpa-14", "gpa-15", "gpa-16";
		telechips,pin-function = <2>;
		telechips,drive-strength = <2>;
	};

	sd1_clk_idle: sd1_clk_idle {
		telechips,pins = "gpa-7";
		telechips,pin-function = <0>;
		telechips,pull-disable;
		telechips,output-low;
	};

	sd1_cmd_idle: sd1_cmd_idle {
		telechips,pins = "gpa-8";
		telechips,pin-function = <0>;
		telechips,pull-disable;
		telechips,output-low;
	};

	sd1_bus1_idle: sd1_bus1_idle {
		telechips,pins = "gpa-9";
		telechips,pin-function = <0>;
		telechips,pull-disable;
		telechips,output-low;
	};

	sd1_bus4_idle: sd1_bus4_idle {
		telechips,pins = "gpa-9", "gpa-10", "gpa-11", "gpa-12";
		telechips,pin-function = <0>;
		telechips,pull-disable;
		telechips,output-low;
	};

	sd1_bus8_idle: sd1_bus8_idle {
		telechips,pins = "gpa-9", "gpa-10", "gpa-11", "gpa-12", "gpa-13", "gpa-14", "gpa-15", "gpa-16";
		telechips,pin-function = <0>;
		telechips,pull-disable;
		telechips,output-low;
	};

	sd2_clk: sd2_clk {
		telechips,pins = "gpb-28";
		telechips,pin-function = <3>;
		telechips,drive-strength = <3>;
	};

	sd2_cmd: sd2_cmd {
		telechips,pins = "gpb-19";
		telechips,pin-function = <3>;
		telechips,drive-strength = <3>;
	};

	sd2_bus1: sd2_bus1 {
		telechips,pins = "gpb-27";
		telechips,pin-function = <3>;
		telechips,drive-strength = <2>;
	};

	sd2_bus4: sd2_bus4 {
		telechips,pins = "gpb-27", "gpb-26", "gpb-25", "gpb-24";
		telechips,pin-function = <3>;
		telechips,drive-strength = <2>;
	};

	sd2_bus8: sd2_bus8 {
		telechips,pins = "gpb-27", "gpb-26", "gpb-25", "gpb-24", "gpb-23", "gpb-22", "gpb-21", "gpb-20";
		telechips,pin-function = <3>;
		telechips,drive-strength = <2>;
	};

	sd2_clk_idle: sd2_clk_idle {
		telechips,pins = "gpb-28";
		telechips,pin-function = <0>;
		telechips,pull-disable;
		telechips,output-low;
	};

	sd2_cmd_idle: sd2_cmd_idle {
		telechips,pins = "gpb-19";
		telechips,pin-function = <0>;
		telechips,pull-disable;
		telechips,output-low;
	};

	sd2_bus1_idle: sd2_bus1_idle {
		telechips,pins = "gpb-27";
		telechips,pin-function = <0>;
		telechips,pull-disable;
		telechips,output-low;
	};

	sd2_bus4_idle: sd2_bus4_idle {
		telechips,pins = "gpb-27", "gpb-26", "gpb-25", "gpb-24";
		telechips,pin-function = <0>;
		telechips,pull-disable;
		telechips,output-low;
	};

	sd2_bus8_idle: sd2_bus8_idle {
		telechips,pins = "gpb-27", "gpb-26", "gpb-25", "gpb-24", "gpb-23", "gpb-22", "gpb-21", "gpb-20";
		telechips,pin-function = <0>;
		telechips,pull-disable;
		telechips,output-low;
	};

	sd3_clk: sd3_clk {
		telechips,pins = "gpa-7";
		telechips,pin-function = <3>;
		telechips,drive-strength = <3>;
	};

	sd3_cmd: sd3_cmd {
		telechips,pins = "gpa-8";
		telechips,pin-function = <3>;
		telechips,drive-strength = <3>;
	};

	sd3_bus1: sd3_bus1 {
		telechips,pins = "gpa-9";
		telechips,pin-function = <3>;
		telechips,drive-strength = <2>;
	};

	sd3_bus4: sd3_bus4 {
		telechips,pins = "gpa-9", "gpa-10", "gpa-11", "gpa-12";
		telechips,pin-function = <3>;
		telechips,drive-strength = <2>;
	};

	sd3_bus8: sd3_bus8 {
		telechips,pins = "gpa-9", "gpa-10", "gpa-11", "gpa-12", "gpa-13", "gpa-14", "gpa-15", "gpa-16";
		telechips,pin-function = <3>;
		telechips,drive-strength = <2>;
	};

	sd3_clk_idle: sd3_clk_idle {
		telechips,pins = "gpa-7";
		telechips,pin-function = <0>;
		telechips,pull-disable;
		telechips,output-low;
	};

	sd3_cmd_idle: sd3_cmd_idle {
		telechips,pins = "gpa-8";
		telechips,pin-function = <0>;
		telechips,pull-disable;
		telechips,output-low;
	};

	sd3_bus1_idle: sd3_bus1_idle {
		telechips,pins = "gpa-9";
		telechips,pin-function = <0>;
		telechips,pull-disable;
		telechips,output-low;
	};

	sd3_bus4_idle: sd3_bus4_idle {
		telechips,pins = "gpa-9", "gpa-10", "gpa-11", "gpa-12";
		telechips,pin-function = <0>;
		telechips,pull-disable;
		telechips,output-low;
	};

	sd3_bus8_idle: sd3_bus8_idle {
		telechips,pins = "gpa-9", "gpa-10", "gpa-11", "gpa-12", "gpa-13", "gpa-14", "gpa-15", "gpa-16";
		telechips,pin-function = <0>;
		telechips,pull-disable;
		telechips,output-low;
	};

	sd4_clk: sd4_clk {
		telechips,pins = "gpb-0";
		telechips,pin-function = <3>;
		telechips,drive-strength = <3>;
	};

	sd4_cmd: sd4_cmd {
		telechips,pins = "gpb-1";
		telechips,pin-function = <3>;
		telechips,drive-strength = <3>;
	};

	sd4_bus1: sd4_bus1 {
		telechips,pins = "gpb-2";
		telechips,pin-function = <3>;
		telechips,drive-strength = <2>;
	};

	sd4_bus4: sd4_bus4 {
		telechips,pins = "gpb-2", "gpb-3", "gpb-4", "gpb-5";
		telechips,pin-function = <3>;
		telechips,drive-strength = <2>;
	};

	sd4_bus8: sd4_bus8 {
		telechips,pins = "gpb-2", "gpb-3", "gpb-4", "gpb-5", "gpb-6", "gpb-7", "gpb-8", "gpb-9";
		telechips,pin-function = <3>;
		telechips,drive-strength = <2>;
	};

	sd4_clk_idle: sd4_clk_idle {
		telechips,pins = "gpb-0";
		telechips,pin-function = <0>;
		telechips,pull-disable;
		telechips,output-low;
	};

	sd4_cmd_idle: sd4_cmd_idle {
		telechips,pins = "gpb-1";
		telechips,pin-function = <0>;
		telechips,pull-disable;
		telechips,output-low;
	};

	sd4_bus1_idle: sd4_bus1_idle {
		telechips,pins = "gpb-2";
		telechips,pin-function = <0>;
		telechips,pull-disable;
		telechips,output-low;
	};

	sd4_bus4_idle: sd4_bus4_idle {
		telechips,pins = "gpb-2", "gpb-3", "gpb-4", "gpb-5";
		telechips,pin-function = <0>;
		telechips,pull-disable;
		telechips,output-low;
	};

	sd4_bus8_idle: sd4_bus8_idle {
		telechips,pins = "gpb-2", "gpb-3", "gpb-4", "gpb-5", "gpb-6", "gpb-7", "gpb-8", "gpb-9";
		telechips,pin-function = <0>;
		telechips,pull-disable;
		telechips,output-low;
	};

	sd5_clk: sd5_clk {
		telechips,pins = "gpd-20";
		telechips,pin-function = <2>;
		telechips,drive-strength = <3>;
	};

	sd5_cmd: sd5_cmd {
		telechips,pins = "gpd-19";
		telechips,pin-function = <2>;
		telechips,drive-strength = <3>;
	};

	sd5_bus1: sd5_bus1 {
		telechips,pins = "gpd-18";
		telechips,pin-function = <2>;
		telechips,drive-strength = <2>;
	};

	sd5_bus4: sd5_bus4 {
		telechips,pins = "gpd-18", "gpd-17", "gpd-16", "gpd-15";
		telechips,pin-function = <2>;
		telechips,drive-strength = <2>;
	};

	sd5_bus8: sd5_bus8 {
		telechips,pins = "gpd-18", "gpd-17", "gpd-16", "gpd-15", "gpd-14", "gpd-13", "gpd-12", "gpd-11";
		telechips,pin-function = <2>;
		telechips,drive-strength = <2>;
	};

	sd5_clk_idle: sd5_clk_idle {
		telechips,pins = "gpd-20";
		telechips,pin-function = <0>;
		telechips,pull-disable;
		telechips,output-low;
	};

	sd5_cmd_idle: sd5_cmd_idle {
		telechips,pins = "gpd-19";
		telechips,pin-function = <0>;
		telechips,pull-disable;
		telechips,output-low;
	};

	sd5_bus1_idle: sd5_bus1_idle {
		telechips,pins = "gpd-18";
		telechips,pin-function = <0>;
		telechips,pull-disable;
		telechips,output-low;
	};

	sd5_bus4_idle: sd5_bus4_idle {
		telechips,pins = "gpd-18", "gpd-17", "gpd-16", "gpd-15";
		telechips,pin-function = <0>;
		telechips,pull-disable;
		telechips,output-low;
	};

	sd5_bus8_idle: sd5_bus8_idle {
		telechips,pins = "gpd-18", "gpd-17", "gpd-16", "gpd-15", "gpd-14", "gpd-13", "gpd-12", "gpd-11";
		telechips,pin-function = <0>;
		telechips,pull-disable;
		telechips,output-low;
	};

	sd6_clk: sd6_clk {
		telechips,pins = "gpc-0";
		telechips,pin-function = <3>;
		telechips,drive-strength = <2>;
	};

	sd6_cmd: sd6_cmd {
		telechips,pins = "gpc-1";
		telechips,pin-function = <3>;
		telechips,drive-strength = <2>;
	};

	sd6_bus1: sd6_bus1 {
		telechips,pins = "gpc-2";
		telechips,pin-function = <3>;
		telechips,drive-strength = <2>;
	};

	sd6_bus4: sd6_bus4 {
		telechips,pins = "gpc-2", "gpc-3", "gpc-4", "gpc-5";
		telechips,pin-function = <3>;
		telechips,drive-strength = <2>;
	};

	sd6_bus8: sd6_bus8 {
		telechips,pins = "gpc-2", "gpc-3", "gpc-4", "gpc-6", "gpc-7", "gpc-8", "gpc-9";
		telechips,pin-function = <3>;
		telechips,drive-strength = <2>;
	};

	sd6_clk_idle: sd6_clk_idle {
		telechips,pins = "gpc-0";
		telechips,pin-function = <0>;
		telechips,pull-disable;
		telechips,output-low;
	};

	sd6_cmd_idle: sd6_cmd_idle {
		telechips,pins = "gpc-1";
		telechips,pin-function = <0>;
		telechips,pull-disable;
		telechips,output-low;
	};

	sd6_bus1: sd6_bus1 {
		telechips,pins = "gpc-2";
		telechips,pin-function = <3>;
		telechips,drive-strength = <2>;
		telechips,pin-function = <0>;
		telechips,pull-disable;
		telechips,output-low;
	};

	sd6_bus4_idle: sd6_bus4_idle {
		telechips,pins = "gpc-2", "gpc-3", "gpc-4", "gpc-5";
		telechips,pin-function = <0>;
		telechips,pull-disable;
		telechips,output-low;
	};

	sd6_bus8_idle: sd6_bus8_idle {
		telechips,pins = "gpc-2", "gpc-3", "gpc-4", "gpc-6", "gpc-7", "gpc-8", "gpc-9";
		telechips,pin-function = <0>;
		telechips,pull-disable;
		telechips,output-low;
	};

	sd7_clk: sd7_clk {
		telechips,pins = "gpe-25";
		telechips,pin-function = <2>;
		telechips,drive-strength = <3>;
	};

	sd7_cmd: sd7_cmd {
		telechips,pins = "gpe-24";
		telechips,pin-function = <2>;
		telechips,drive-strength = <3>;
	};

	sd7_bus1: sd7_bus1 {
		telechips,pins = "gpe-23";
		telechips,pin-function = <2>;
		telechips,drive-strength = <2>;
	};

	sd7_bus4: sd7_bus4 {
		telechips,pins = "gpe-23", "gpe-22", "gpe-21", "gpe-29";
		telechips,pin-function = <2>;
		telechips,drive-strength = <2>;
	};

	sd7_bus8: sd7_bus8 {
		telechips,pins = "gpe-23", "gpe-22", "gpe-21", "gpe-20", "gpe-19", "gpe-18", "gpe-17", "gpe-16";
		telechips,pin-function = <2>;
		telechips,drive-strength = <2>;
	};

	sd7_clk_idle: sd7_clk_idle {
		telechips,pins = "gpe-25";
		telechips,pin-function = <0>;
		telechips,pull-disable;
		telechips,output-low;
	};

	sd7_cmd_idle: sd7_cmd_idle{
		telechips,pins = "gpe-24";
		telechips,pin-function = <0>;
		telechips,pull-disable;
		telechips,output-low;
	};

	sd7_bus1_idle: sd7_bus1_idle {
		telechips,pins = "gpe-23";
		telechips,pin-function = <0>;
		telechips,pull-disable;
		telechips,output-low;
	};

	sd7_bus4_idle: sd7_bus4_idle {
		telechips,pins = "gpe-23", "gpe-22", "gpe-21", "gpe-29";
		telechips,pin-function = <0>;
		telechips,pull-disable;
		telechips,output-low;
	};

	sd7_bus8_idle: sd7_bus8_idle {
		telechips,pins = "gpe-23", "gpe-22", "gpe-21", "gpe-20", "gpe-19", "gpe-18", "gpe-17", "gpe-16";
		telechips,pin-function = <0>;
		telechips,pull-disable;
		telechips,output-low;
	};

	sd8_clk: sd8_clk {
		telechips,pins = "gpf-16";
		telechips,pin-function = <2>;
		telechips,drive-strength = <3>;
	};

	sd8_cmd: sd8_cmd {
		telechips,pins = "gpf-17";
		telechips,pin-function = <2>;
		telechips,drive-strength = <3>;
	};

	sd8_bus1: sd8_bus1 {
		telechips,pins = "gpf-18";
		telechips,pin-function = <2>;
		telechips,drive-strength = <2>;
	};

	sd8_bus4: sd8_bus4 {
		telechips,pins = "gpf-18", "gpf-19", "gpf-20", "gpf-21";
		telechips,pin-function = <2>;
		telechips,drive-strength = <2>;
	};

	sd8_bus8: sd8_bus8 {
		telechips,pins = "gpf-18", "gpf-19", "gpf-20", "gpf-21", "gpf-22", "gpf-23", "gpf-24", "gpf-25";
		telechips,pin-function = <2>;
		telechips,drive-strength = <2>;
	};

	sd8_clk_idle: sd8_clk_idle {
		telechips,pins = "gpf-16";
		telechips,pin-function = <0>;
		telechips,pull-disable;
		telechips,output-low;
	};

	sd8_cmd_idle: sd8_cmd_idle_{
		telechips,pins = "gpf-17";
		telechips,pin-function = <0>;
		telechips,pull-disable;
		telechips,output-low;
	};

	sd8_bus1_idle: sd8_bus1_idle {
		telechips,pins = "gpf-18";
		telechips,pin-function = <0>;
		telechips,pull-disable;
		telechips,output-low;
	};

	sd8_bus4_idle: sd8_bus4_idle {
		telechips,pins = "gpf-18", "gpf-19", "gpf-20", "gpf-21";
		telechips,pin-function = <0>;
		telechips,pull-disable;
		telechips,output-low;
	};

	sd8_bus8_idle: sd8_bus8_idle {
		telechips,pins = "gpf-18", "gpf-19", "gpf-20", "gpf-21", "gpf-22", "gpf-23", "gpf-24", "gpf-25";
		telechips,pin-function = <0>;
		telechips,pull-disable;
		telechips,output-low;
	};

	sd9_clk: sd9_clk {
		telechips,pins = "gpg-6";
		telechips,pin-function = <5>;
		telechips,drive-strength = <3>;
	};

	sd9_cmd: sd9_cmd {
		telechips,pins = "gpg-7";
		telechips,pin-function = <5>;
		telechips,drive-strength = <3>;
	};

	sd9_bus1: sd9_bus1 {
		telechips,pins = "gpg-8";
		telechips,pin-function = <5>;
		telechips,drive-strength = <2>;
	};

	sd9_bus4: sd9_bus4 {
		telechips,pins = "gpg-8", "gpg-9", "gpg-10", "gpg-11";
		telechips,pin-function = <5>;
		telechips,drive-strength = <2>;
	};

	sd9_bus8: sd9_bus8 {
		telechips,pins = "gpg-8", "gpg-9", "gpg-10", "gpg-11", "gpg-12", "gpg-13", "gpg-14", "gpg-15";
		telechips,pin-function = <5>;
		telechips,drive-strength = <2>;
	};

	sd9_clk_idle: sd9_clk_idle {
		telechips,pins = "gpg-6";
		telechips,pin-function = <0>;
		telechips,pull-disable;
		telechips,output-low;
	};

	sd9_cmd_idle: sd9_cmd_idle {
		telechips,pins = "gpg-7";
		telechips,pin-function = <0>;
		telechips,pull-disable;
		telechips,output-low;
	};

	sd9_bus1_idle: sd9_bus1_idle {
		telechips,pins = "gpg-8";
		telechips,pin-function = <0>;
		telechips,pull-disable;
		telechips,output-low;
	};

	sd9_bus4_idle: sd9_bus4_idle {
		telechips,pins = "gpg-8", "gpg-9", "gpg-10", "gpg-11";
		telechips,pin-function = <0>;
		telechips,pull-disable;
		telechips,output-low;
	};

	sd9_bus8_idle: sd9_bus8_idle {
		telechips,pins = "gpg-8", "gpg-9", "gpg-10", "gpg-11", "gpg-12", "gpg-13", "gpg-14", "gpg-15";
		telechips,pin-function = <0>;
		telechips,pull-disable;
		telechips,output-low;
	};

	out0_clk: out0_clk {
		telechips,pins = "gpb-29";
		telechips,pin-function = <12>;
		telechips,drive-strength = <3>;
	}; // ext32.768 clock

	out1_clk: out1_clk {
		telechips,pins = "gpc-23";
		telechips,pin-function = <9>;
		telechips,drive-strength = <3>;
	}; // ext32.768 clock

	i2c0_bus: i2c0_bus {
		telechips,pins = "gpa-9", "gpa-10";
		telechips,pin-function = <8>;
		telechips,input_buffer_enable;
		telechips,pull-up;
	};

	i2c1_bus: i2c1_bus {
		telechips,pins = "gpa-11", "gpa-12";
		telechips,pin-function = <8>;
		telechips,input_buffer_enable;
		telechips,pull-up;
	};

	i2c2_bus: i2c2_bus {
		telechips,pins = "gpa-15", "gpa-16";
		telechips,pin-function = <8>;
		telechips,input_buffer_enable;
		telechips,pull-up;
	};

	i2c3_bus: i2c3_bus {
		telechips,pins = "gpb-9", "gpb-10";
		telechips,pin-function = <11>;
		telechips,input_buffer_enable;
		telechips,pull-up;
	};

	i2c4_bus: i2c4_bus {
		telechips,pins = "gpb-13", "gpb-14";
		telechips,pin-function = <11>;
		telechips,input_buffer_enable;
		telechips,pull-up;
	};

	i2c5_bus: i2c5_bus {
		telechips,pins = "gpb-23", "gpb-24";
		telechips,pin-function = <11>;
		telechips,input_buffer_enable;
		telechips,pull-up;
	};

	i2c6_bus: i2c6_bus {
		telechips,pins = "gpb-27", "gpb-28";
		telechips,pin-function = <11>;
		telechips,input_buffer_enable;
		telechips,pull-up;
	};

	i2c7_bus: i2c7_bus {
		telechips,pins = "gpc-2", "gpc-3";
		telechips,pin-function = <7>;
		telechips,input_buffer_enable;
		telechips,pull-up;
	};

	i2c8_bus: i2c8_bus {
		telechips,pins = "gpc-12", "gpc-13";
		telechips,pin-function = <7>;
		telechips,input_buffer_enable;
		telechips,pull-up;
	};

	i2c9_bus: i2c9_bus {
		telechips,pins = "gpc-14", "gpc-15";
		telechips,pin-function = <7>;
		telechips,input_buffer_enable;
		telechips,pull-up;
	};

	i2c10_bus: i2c10_bus {
		telechips,pins = "gpc-25", "gpc-26";
		telechips,pin-function = <7>;
		telechips,input_buffer_enable;
		telechips,pull-up;
	};

	i2c11_bus: i2c11_bus {
		telechips,pins = "gpd-0", "gpd-1";
		telechips,pin-function = <8>;
		telechips,input_buffer_enable;
		telechips,pull-up;
	};

	i2c12_bus: i2c12_bus {
		telechips,pins = "gpd-2", "gpd-3";
		telechips,pin-function = <8>;
		telechips,input_buffer_enable;
		telechips,pull-up;
	};

	i2c13_bus: i2c13_bus {
		telechips,pins = "gpd-6", "gpd-7";
		telechips,pin-function = <8>;
		telechips,input_buffer_enable;
		telechips,pull-up;
	};

	i2c14_bus: i2c14_bus {
		telechips,pins = "gpd-8", "gpd-8";
		telechips,pin-function = <8>;
		telechips,input_buffer_enable;
		telechips,pull-up;
	};

	i2c15_bus: i2c15_bus {
		telechips,pins = "gpd-13", "gpd-14";
		telechips,pin-function = <8>;
		telechips,input_buffer_enable;
		telechips,pull-up;
	};

	i2c16_bus: i2c16_bus {
		telechips,pins = "gpd-15", "gpd-16";
		telechips,pin-function = <8>;
		telechips,input_buffer_enable;
		telechips,pull-up;
	};

	i2c17_bus: i2c17_bus {
		telechips,pins = "gpd-19", "gpd-20";
		telechips,pin-function = <8>;
		telechips,input_buffer_enable;
		telechips,pull-up;
	};

	i2c18_bus: i2c18_bus {
		telechips,pins = "gpe-13", "gpe-14";
		telechips,pin-function = <8>;
		telechips,input_buffer_enable;
		telechips,pull-up;
	};

	i2c19_bus: i2c19_bus {
		telechips,pins = "gpe-29", "gpe-30";
		telechips,pin-function = <8>;
		telechips,input_buffer_enable;
		telechips,pull-up;
	};

	i2c20_bus: i2c20_bus {
		telechips,pins = "gpf-13", "gpf-14";
		telechips,pin-function = <10>;
		telechips,input_buffer_enable;
		telechips,pull-up;
	};

	i2c21_bus: i2c21_bus {
		telechips,pins = "gpf-15", "gpf-16";
		telechips,pin-function = <10>;
		telechips,input_buffer_enable;
		telechips,pull-up;
	};

	i2c22_bus0: i2c22_bus0 {
		telechips,pins = "gpf-19", "gpf-20";
		telechips,pin-function = <10>;
		telechips,input_buffer_enable;
		telechips,pull-up;
	};

	i2c23_bus: i2c23_bus {
		telechips,pins = "gpf-28", "gpf-29";
		telechips,pin-function = <10>;
		telechips,input_buffer_enable;
		telechips,pull-up;
	};

	i2c24_bus: i2c24_bus {
		telechips,pins = "gpg-6", "gpg-7";
		telechips,pin-function = <4>;
		telechips,input_buffer_enable;
		telechips,pull-up;
	};

	i2c25_bus: i2c25_bus {
		telechips,pins = "gpg-10", "gpg-11";
		telechips,pin-function = <4>;
		telechips,input_buffer_enable;
		telechips,pull-up;
	};

	i2c26_bus: i2c26_bus {
		telechips,pins = "gpg-12", "gpg-13";
		telechips,pin-function = <4>;
		telechips,input_buffer_enable;
		telechips,pull-up;
	};

	i2c27_bus: i2c27_bus {
		telechips,pins = "gpg-15", "gpg-16";
		telechips,pin-function = <4>;
		telechips,input_buffer_enable;
		telechips,pull-up;
	};

	i2c28_bus: i2c28_bus {
		telechips,pins = "gpg-18", "gpg-19";
		telechips,pin-function = <4>;
		telechips,input_buffer_enable;
		telechips,pull-up;
	};

	i2c29_bus: i2c29_bus {
		telechips,pins = "gphdmi-2", "gphdmi-3";
		telechips,pin-function = <1>;
		telechips,drive-strength = <3>;
		telechips,input_buffer_enable;
		telechips,pull-up;
	};

	i2c29_bus_idle: i2c29_bus_idle {
		telechips,pins = "gphdmi-2", "gphdmi-3";
		telechips,pin-function = <0>;
		telechips,drive-strength = <3>;
		telechips,input_buffer_enable;
		telechips,pull-up;
	};

	i2c30_bus: i2c30_bus {
		telechips,pins = "gpsd-6", "gpsd-7";
		telechips,pin-function = <4>;
		telechips,drive-strength = <3>;
		telechips,input_buffer_enable;
		telechips,pull-up;
	};

	i2c31_bus: i2c31_bus {
		telechips,pins = "gpsd-8", "gpsd-9";
		telechips,pin-function = <4>;
		telechips,drive-strength = <3>;
		telechips,input_buffer_enable;
		telechips,pull-up;
	};

	hdmi_cec: hdmi_cec {
		telechips,pins = "gphdmi-0";
		telechips,pin-function = <1>;
		telechips,pull-enable;
		telechips,pull-up;
	};
	
	hdmi_hpd: hdmi_hpd {
		telechips,pins = "gphdmi-1";
		telechips,pin-function = <0>;
		telechips,pull-enable;
		telechips,pull-down;
	};
	hdmi_i2c: hdmi_i2c {
		telechips,pins = "gphdmi-2", "gphdmi-3";
		telechips,pin-function = <1>;
		telechips,pull-up;
	};
	
	gpsb0_bus: gpsb0_bus {
		telechips,pins = "gpa-7", "gpa-8", "gpa-9", "gpa-10";
		telechips,pin-function = <6>;
		telechips,input_buffer_enable;
	};

	gpsb1_bus: gpsb1_bus {
		telechips,pins = "gpa-13", "gpa-14", "gpa-15", "gpa-16";
		telechips,pin-function = <6>;
		telechips,input_buffer_enable;
	};

	gpsb2_bus: gpsb2_bus {
		telechips,pins = "gpb-0", "gpb-1", "gpb-2", "gpb-3";
		telechips,pin-function = <9>;
		telechips,input_buffer_enable;
	};

	gpsb3_bus: gpsb3_bus {
		telechips,pins = "gpb-11", "gpb-12", "gpb-13", "gpb-14";
		telechips,pin-function = <9>;
		telechips,input_buffer_enable;
	};

	gpsb4_bus: gpsb4_bus {
		telechips,pins = "gpb-19", "gpb-20", "gpb-21", "gpb-22";
		telechips,pin-function = <9>;
		telechips,input_buffer_enable;
	};

	gpsb5_bus: gpsb5_bus {
		telechips,pins = "gpb-25", "gpb-26", "gpb-27", "gpb-28";
		telechips,pin-function = <9>;
		telechips,input_buffer_enable;
	};

	gpsb6_bus: gpsb6_bus {
		telechips,pins = "gpc-0", "gpc-1", "gpc-2", "gpc-3";
		telechips,pin-function = <5>;
		telechips,input_buffer_enable;
	};

	gpsb7_bus: gpsb7_bus {
		telechips,pins = "gpc-10", "gpc-11", "gpc-12", "gpc-13";
		telechips,pin-function = <5>;
		telechips,input_buffer_enable;
	};

	gpsb8_bus: gpsb8_bus {
		telechips,pins = "gpc-23", "gpc-24", "gpc-25", "gpc-26";
		telechips,pin-function = <5>;
		telechips,input_buffer_enable;
	};

	gpsb9_bus: gpsb9_bus {
		telechips,pins = "gpd-7", "gpd-8", "gpd-9", "gpd-10";
		telechips,pin-function = <6>;
		telechips,input_buffer_enable;
	};

	gpsb10_bus: gpsb10_bus {
		telechips,pins = "gpd-11", "gpd-12", "gpd-13", "gpd-14";
		telechips,pin-function = <6>;
		telechips,input_buffer_enable;
	};

	gpsb10_bus_idle: gpsb10_bus_idle {
		telechips,pins = "gpd-11", "gpd-12", "gpd-13", "gpd-14";
		telechips,pin-function = <0>;
		telechips,output-low;
	};

	gpsb10_bus_spi: gpsb10_bus_spi {
		telechips,pins = "gpd-11", "gpd-12", "gpd-13", "gpd-14";
		telechips,pin-function = <6>;
		telechips,input_buffer_enable;
	};

	gpsb11_bus: gpsb11_bus {
		telechips,pins = "gpd-17", "gpd-18", "gpd-19", "gpd-20";
		telechips,pin-function = <6>;
		telechips,input_buffer_enable;
	};

	gpsb12_bus: gpsb12_bus {
		telechips,pins = "gpe-0", "gpe-1", "gpe-2", "gpe-3";
		telechips,pin-function = <6>;
		telechips,input_buffer_enable;
	};

	gpsb12_bus_idle: gpsb12_bus_idle {
		telechips,pins = "gpe-0", "gpe-1", "gpe-2", "gpe-3";
		telechips,pin-function = <0>;
		telechips,output-low;
	};

	gpsb12_bus_spi: gpsb12_bus_spi {
		telechips,pins = "gpe-0", "gpe-1", "gpe-2", "gpe-3";
		telechips,pin-function = <6>;
		telechips,input_buffer_enable;
	};

	gpsb12_bus_tsif: gpsb12_bus_tsif {
		telechips,pins = "gpe-0", "gpe-1", "gpe-2", "gpe-3";
		telechips,pin-function = <6>;
		telechips,input_buffer_enable;
	};

	gpsb13_bus: gpsb13_bus {
		telechips,pins = "gpe-16", "gpe-17", "gpe-18", "gpe-19";
		telechips,pin-function = <6>;
		telechips,input_buffer_enable;
	};

	gpsb13_bus_idle: gpsb13_bus_idle {
		telechips,pins = "gpe-16", "gpe-17", "gpe-18", "gpe-19";
		telechips,pin-function = <0>;
		telechips,output-low;
	};

	gpsb13_bus_tsif: gpsb13_bus_tsif {
		telechips,pins = "gpe-16", "gpe-17", "gpe-18", "gpe-19";
		telechips,pin-function = <6>;
		telechips,input_buffer_enable;
	};

	gpsb14_bus: gpsb14_bus {
		telechips,pins = "gpf-11", "gpf-8", "gpf-9", "gpf-10";
		telechips,pin-function = <8>;
		telechips,input_buffer_enable;
	};

	gpsb15_bus: gpsb15_bus {
		telechips,pins = "gpf-15", "gpf-12", "gpf-13", "gpf-14";
		telechips,pin-function = <8>;
		telechips,input_buffer_enable;
	};

	gpsb16_bus: gpsb16_bus {
		telechips,pins = "gpf-17", "gpf-18", "gpf-19", "gpf-20";
		telechips,pin-function = <8>;
		telechips,input_buffer_enable;
	};

	gpsb17_bus: gpsb17_bus {
		telechips,pins = "gpg-0", "gpg-1", "gpg-2", "gpg-3";
		telechips,pin-function = <2>;
		telechips,input_buffer_enable;
	};

	gpsb18_bus: gpsb18_bus {
		telechips,pins = "gpg-4", "gpg-5", "gpg-6", "gpg-7";
		telechips,pin-function = <2>;
		telechips,input_buffer_enable;
	};

	gpsb19_bus: gpsb19_bus {
		telechips,pins = "gpg-10", "gpg-11", "gpg-12", "gpg-13";
		telechips,pin-function = <2>;
		telechips,input_buffer_enable;
	};

	gpsb20_bus: gpsb20_bus {
		telechips,pins = "gpg-16", "gpg-17", "gpg-18", "gpg-19";
		telechips,pin-function = <2>;
		telechips,input_buffer_enable;
	};

	ts6_idle: ts6_idle {
		telechips,pins = "gpe-16", "gpe-17", "gpe-18", "gpe-19";
		telechips,pin-function = <0>;
		telechips,output-low;
	};

	ts6_active: ts6_active {
		telechips,pins = "gpe-16", "gpe-17", "gpe-18", "gpe-19";
		telechips,pin-function = <1>;
		telechips,input-enable;
	};
/*
	ts6_idle: ts6_idle_parallel {
		telechips,pins = "gpe-16", "gpe-17", "gpe-18", "gpe-19", "gpe-20", "gpe-21", "gpe-22", "gpe-23", "gpe-24", "gpe-25", "gpe-26";
		telechips,pin-function = <0>;
		telechips,output-low;
	};

	ts6_active: ts6_active_parallel {
		telechips,pins = "gpe-16", "gpe-17", "gpe-18", "gpe-19", "gpe-20", "gpe-21", "gpe-22", "gpe-23", "gpe-24", "gpe-25", "gpe-26";
		telechips,pin-function = <1>;
		telechips,input-enable;
	};
*/
	uart0_data: uart0_data {
		telechips,pins = "gpa-7", "gpa-8";
		telechips,pin-function = <7>;
	};

	uart0_rtscts: uart0_rtscts {
		telechips,pins = "gpa-9", "gpa-10";
		telechips,pin-function = <7>;
	};

	uart1_data: uart1_data {
		telechips,pins = "gpa-13", "gpa-14";
		telechips,pin-function = <7>;
	};

	uart1_rtscts: uart1_rtscts {
		telechips,pins = "gpa-15", "gpa-16";
		telechips,pin-function = <7>;
	};

	uart2_data: uart2_data {
		telechips,pins = "gpb-0", "gpb-1";
		telechips,pin-function = <10>;
	};

	uart2_rtscts: uart2_rtscts {
		telechips,pins = "gpb-2", "gpb-3";
		telechips,pin-function = <10>;
	};

	uart3_data: uart3_data {
		telechips,pins = "gpb-11", "gpb-12";
		telechips,pin-function = <10>;
	};

	uart3_rtscts: uart3_rtscts {
		telechips,pins = "gpb-13", "gpb-14";
		telechips,pin-function = <10>;
	};

	uart4_data: uart4_data {
		telechips,pins = "gpb-19", "gpb-20";
		telechips,pin-function = <10>;
	};

	uart4_rtscts: uart4_rtscts {
		telechips,pins = "gpb-21", "gpb-22";
		telechips,pin-function = <10>;
	};

	uart5_data: uart5_data {
		telechips,pins = "gpb-25", "gpb-26";
		telechips,pin-function = <10>;
	};

	uart5_rtscts: uart5_rtscts {
		telechips,pins = "gpb-27", "gpb-28";
		telechips,pin-function = <10>;
	};

	uart6_data: uart6_data {
		telechips,pins = "gpc-0", "gpc-1";
		telechips,pin-function = <6>;
	};

	uart6_rtscts: uart6_rtscts {
		telechips,pins = "gpc-2", "gpc-3";
		telechips,pin-function = <6>;
	};

	uart7_data: uart7_data {
		telechips,pins = "gpc-10", "gpc-11";
		telechips,pin-function = <6>;
	};

	uart7_rtscts: uart7_rtscts {
		telechips,pins = "gpc-12", "gpc-13";
		telechips,pin-function = <6>;
	};

	uart8_data: uart8_data {
		telechips,pins = "gpc-23", "gpc-24";
		telechips,pin-function = <6>;
	};

	uart8_rtscts: uart8_rtscts {
		telechips,pins = "gpc-25", "gpc-26";
		telechips,pin-function = <6>;
	};

	uart9_data: uart9_data {
		telechips,pins = "gpd-4", "gpd-5";
		telechips,pin-function = <7>;
	};

	uart9_rtscts: uart9_rtscts {
		telechips,pins = "gpd-6", "gpd-7";
		telechips,pin-function = <7>;
	};

	uart10_data: uart10_data {
		telechips,pins = "gpd-11", "gpd-12";
		telechips,pin-function = <7>;
	};

	uart10_rtscts: uart10_rtscts {
		telechips,pins = "gpd-13", "gpd-14";
		telechips,pin-function = <7>;
	};

	uart11_data: uart11_data {
		telechips,pins = "gpd-17", "gpd-18";
		telechips,pin-function = <7>;
	};

	uart11_rtscts: uart11_rtscts {
		telechips,pins = "gpd-19", "gpd-20";
		telechips,pin-function = <7>;
	};

	uart12_data: uart12_data {
		telechips,pins = "gpe-4", "gpe-5";
		telechips,pin-function = <7>;
	};

	uart12_rtscts: uart12_rtscts {
		telechips,pins = "gpe-6", "gpe-7";
		telechips,pin-function = <7>;
	};

	uart13_data: uart13_data {
		telechips,pins = "gpe-11", "gpe-12";
		telechips,pin-function = <7>;
	};

	uart13_rtscts: uart13_rtscts {
		telechips,pins = "gpe-13", "gpe-14";
		telechips,pin-function = <7>;
	};

	uart14_data: uart14_data {
		telechips,pins = "gpe-20", "gpe-21";
		telechips,pin-function = <7>;
	};

	uart14_rtscts: uart14_rtscts {
		telechips,pins = "gpe-22", "gpe-23";
		telechips,pin-function = <7>;
	};

	uart15_data: uart15_data {
		telechips,pins = "gpe-27", "gpe-28";
		telechips,pin-function = <7>;
	};

	uart15_rtscts: uart15_rtscts {
		telechips,pins = "gpe-29", "gpe-30";
		telechips,pin-function = <7>;
	};

	uart16_data: uart16_data {
		telechips,pins = "gpf-0", "gpf-1";
		telechips,pin-function = <9>;
	};

	uart16_rtscts: uart16_rtscts {
		telechips,pins = "gpf-2", "gpf-3";
		telechips,pin-function = <9>;
	};

	uart17_data: uart17_data {
		telechips,pins = "gpf-2", "gpf-3";
		telechips,pin-function = <10>;
	};

	uart17_rtscts: uart17_rtscts {
		telechips,pins = "gpf-0", "gpf-1";
		telechips,pin-function = <10>;
	};

	uart18_data: uart18_data {
		telechips,pins = "gpf-4", "gpf-5";
		telechips,pin-function = <9>;
	};

	uart18_rtscts: uart18_rtscts {
		telechips,pins = "gpf-6", "gpf-7";
		telechips,pin-function = <9>;
	};

	uart19_data: uart19_data {
		telechips,pins = "gpf-6", "gpf-7";
		telechips,pin-function = <10>;
	};

	uart19_rtscts: uart19_rtscts {
		telechips,pins = "gpf-8", "gpf-9";
		telechips,pin-function = <10>;
	};

	uart20_data: uart20_data {
		telechips,pins = "gpf-13", "gpf-14";
		telechips,pin-function = <9>;
	};

	uart20_rtscts: uart20_rtscts {
		telechips,pins = "gpf-11", "gpf-12";
		telechips,pin-function = <9>;
	};

	uart21_data: uart21_data {
		telechips,pins = "gpf-17", "gpf-18";
		telechips,pin-function = <9>;
	};

	uart21_rtscts: uart21_rtscts {
		telechips,pins = "gpf-19", "gpf-20";
		telechips,pin-function = <9>;
	};

	uart22_data: uart22_data {
		telechips,pins = "gpf-22", "gpf-23";
		telechips,pin-function = <9>;
	};

	uart22_rtscts: uart22_rtscts {
		telechips,pins = "gpf-24", "gpf-25";
		telechips,pin-function = <9>;
	};

	uart23_data: uart23_data {
		telechips,pins = "gpf-26", "gpf-27";
		telechips,pin-function = <9>;
	};

	uart23_rtscts: uart23_rtscts {
		telechips,pins = "gpf-28", "gpf-29";
		telechips,pin-function = <9>;
	};

	uart24_data: uart24_data {
		telechips,pins = "gpg-0", "gpg-1";
		telechips,pin-function = <3>;
	};

	uart24_rtscts: uart24_rtscts {
		telechips,pins = "gpg-2", "gpg-3";
		telechips,pin-function = <3>;
	};

	uart25_data: uart25_data {
		telechips,pins = "gpg-4", "gpg-5";
		telechips,pin-function = <3>;
	};

	uart25_rtscts: uart25_rtscts {
		telechips,pins = "gpg-6", "gpg-7";
		telechips,pin-function = <3>;
	};

	uart26_data: uart26_data {
		telechips,pins = "gpg-8", "gpg-9";
		telechips,pin-function = <3>;
	};

	uart26_rtscts: uart26_rtscts {
		telechips,pins = "gpg-10", "gpg-11";
		telechips,pin-function = <3>;
	};

	uart27_data: uart27_data {
		telechips,pins = "gpg-15", "gpg-14";
		telechips,pin-function = <3>;
	};

	uart27_rtscts: uart27_rtscts {
		telechips,pins = "gpg-13", "gpg-12";
		telechips,pin-function = <3>;
	};

	uart28_data: uart28_data {
		telechips,pins = "gpg-19", "gpg-18";
		telechips,pin-function = <3>;
	};

	uart28_rtscts: uart28_rtscts {
		telechips,pins = "gpg-17", "gpg-16";
		telechips,pin-function = <3>;
	};

	uart29_data: uart29_data {
		telechips,pins = "gphdmi-0", "gphdmi-1";
		telechips,pin-function = <3>;
	};

	uart29_rtscts: uart29_rtscts {
		telechips,pins = "gphdmi-2", "gphdmi-3";
		telechips,pin-function = <3>;
	};

	uart30_data: uart30_data {
		telechips,pins = "gpsd-6", "gpsd-7";
		telechips,pin-function = <3>;
	};

	uart30_rtscts: uart30_rtscts {
		telechips,pins = "gpsd-8", "gpsd-9";
		telechips,pin-function = <3>;
	};

	nand_rdy0: nand_rdy0 {
		telechips,pins = "gpa-16";
		telechips,pin-function = <1>;
		telechips,drive-strength = <3>;
	};

	nand_rdy1: nand_rdy1 {
		telechips,pins = "gpd-11";
		telechips,pin-function = <1>;
		telechips,drive-strength = <3>;
	};

	nand_cs0: nand_cs0 {
		telechips,pins = "gpa-12";
		telechips,pin-function = <1>;
		telechips,drive-strength = <3>;
	};

	nand_cs1: nand_cs1 {
		telechips,pins = "gpa-13";
		telechips,pin-function = <1>;
		telechips,drive-strength = <3>;
	};

	nand_we: nand_we {
		telechips,pins = "gpa-11";
		telechips,pin-function = <1>;
		telechips,drive-strength = <3>;
	};

	nand_oe: nand_oe {
		telechips,pins = "gpa-10";
		telechips,pin-function = <1>;
		telechips,drive-strength = <3>;
	};

	nand_cle: nand_cle {
		telechips,pins = "gpa-8";
		telechips,pin-function = <1>;
		telechips,drive-strength = <3>;
	};

	nand_ale: nand_ale {
		telechips,pins = "gpa-9";
		telechips,pin-function = <1>;
		telechips,drive-strength = <3>;
	};

	nand_wp: nand_wp {
		telechips,pins = "gpb-8";
		telechips,pin-function = <0>;
		telechips,drive-strength = <3>;
	};

	nand_wp_c29: nand_wp_c29 {
		telechips,pins = "gpc-29";
		telechips,pin-function = <0>;
		telechips,drive-strength = <3>;
	};

	nand_databus8: nand_databus8 {
		telechips,pins = "gpa-0", "gpa-1", "gpa-2", "gpa-3", "gpa-4", "gpa-5", "gpa-6", "gpa-7";
		telechips,pin-function = <1>;
		telechips,drive-strength = <3>;
		telechips,pull-up;
	};

	gmac0_mdc: gmac0_mdc {
		telechips,pins = "gpb-0";
		telechips,pin-function = <4>;
	};

	gmac0_mdio: gmac0_mdio {
		telechips,pins = "gpb-1";
		telechips,pin-function = <4>;
	};

	gmac0_txclk: gmac0_txclk {
		telechips,pins = "gpb-2";
		telechips,pin-function = <4>;
		telechips,drive-strength = <1>;
	};

	gmac0_txen: gmac0_txen {
		telechips,pins = "gpb-7";
		telechips,pin-function = <4>;
		telechips,drive-strength = <1>;
	};

	gmac0_txd0: gmac0_txd0 {
		telechips,pins = "gpb-5";
		telechips,pin-function = <4>;
		telechips,drive-strength = <1>;
	};

	gmac0_txd1: gmac0_txd1 {
		telechips,pins = "gpb-6";
		telechips,pin-function = <4>;
		telechips,drive-strength = <1>;
	};

	gmac0_txd2: gmac0_txd2{
		telechips,pins = "gpb-12";
		telechips,pin-function = <4>;
		telechips,drive-strength = <1>;
	};

	gmac0_txd3: gmac0_txd3{
		telechips,pins = "gpb-13";
		telechips,pin-function = <4>;
		telechips,drive-strength = <1>;
	};

	gmac0_txd4: gmac0_txd4 {
		telechips,pins = "gpb-22";
		telechips,pin-function = <4>;
	};

	gmac0_txd5: gmac0_txd5 {
		telechips,pins = "gpb-23";
		telechips,pin-function = <4>;
	};

	gmac0_txd6: gmac0_txd6{
		telechips,pins = "gpb-24";
		telechips,pin-function = <4>;
	};

	gmac0_txd7: gmac0_txd7{
		telechips,pins = "gpb-25";
		telechips,pin-function = <4>;
	};

	gmac0_rxclk: gmac0_rxclk {
		telechips,pins = "gpb-26";
		telechips,pin-function = <4>;
	};

	gmac0_rxdv: gmac0_rxdv {
		telechips,pins = "gpb-8";
		telechips,pin-function = <4>;
	};

	gmac0_rxd0: gmac0_rxd0 {
		telechips,pins = "gpb-3";
		telechips,pin-function = <4>;
	};

	gmac0_rxd1: gmac0_rxd1 {
		telechips,pins = "gpb-4";
		telechips,pin-function = <4>;
	};

	gmac0_rxd2: gmac0_rxd2{
		telechips,pins = "gpb-10";
		telechips,pin-function = <4>;
	};

	gmac0_rxd3: gmac0_rxd3{
		telechips,pins = "gpb-11";
		telechips,pin-function = <4>;
	};

	gmac0_rxd4: gmac0_rxd4 {
		telechips,pins = "gpb-18";
		telechips,pin-function = <4>;
	};

	gmac0_rxd5: gmac0_rxd5 {
		telechips,pins = "gpb-19";
		telechips,pin-function = <4>;
	};

	gmac0_rxd6: gmac0_rxd6{
		telechips,pins = "gpb-20";
		telechips,pin-function = <4>;
	};

	gmac0_rxd7: gmac0_rxd7{
		telechips,pins = "gpb-21";
		telechips,pin-function = <4>;
	};

	gmac0_rxer: gmac0_rxer{
		telechips,pins = "gpb-14";
		telechips,pin-function = <4>;
	};

	gmac0_txer: gmac0_txer{
		telechips,pins = "gpb-15";
		telechips,pin-function = <4>;
	};

	gmac0_col: gmac0_col{
		telechips,pins = "gpb-16";
		telechips,pin-function = <4>;
	};

	gmac0_crs: gmac0_crs{
		telechips,pins = "gpb-17";
		telechips,pin-function = <4>;
	};

	gmac1_mdc: gmac1_mdc {
		telechips,pins = "gpc-1";
		telechips,pin-function = <1>;
	};

	gmac1_mdio: gmac1_mdio {
		telechips,pins = "gpc-2";
		telechips,pin-function = <1>;
	};

	gmac1_txclk: gmac1_txclk {
		telechips,pins = "gpc-0";
		telechips,pin-function = <1>;
		telechips,drive-strength = <1>;
	};

	gmac1_txen: gmac1_txen {
		telechips,pins = "gpc-7";
		telechips,pin-function = <1>;
		telechips,drive-strength = <1>;
	};

	gmac1_txd0: gmac1_txd0 {
		telechips,pins = "gpc-5";
		telechips,pin-function = <1>;
		telechips,drive-strength = <1>;
	};

	gmac1_txd1: gmac1_txd1 {
		telechips,pins = "gpc-6";
		telechips,pin-function = <1>;
		telechips,drive-strength = <1>;
	};

	gmac1_txd2: gmac1_txd2{
		telechips,pins = "gpc-12";
		telechips,pin-function = <1>;
		telechips,drive-strength = <1>;
	};

	gmac1_txd3: gmac1_txd3{
		telechips,pins = "gpc-13";
		telechips,pin-function = <1>;
		telechips,drive-strength = <1>;
	};

	gmac1_txd4: gmac1_txd4 {
		telechips,pins = "gpc-22";
		telechips,pin-function = <1>;
		telechips,drive-strength = <1>;
	};

	gmac1_txd5: gmac1_txd5 {
		telechips,pins = "gpc-23";
		telechips,pin-function = <1>;
		telechips,drive-strength = <1>;
	};

	gmac1_txd6: gmac1_txd6{
		telechips,pins = "gpc-24";
		telechips,pin-function = <1>;
		telechips,drive-strength = <1>;
	};

	gmac1_txd7: gmac1_txd7{
		telechips,pins = "gpc-25";
		telechips,pin-function = <1>;
		telechips,drive-strength = <1>;
	};

	gmac1_rxclk: gmac1_rxclk {
		telechips,pins = "gpc-26";
		telechips,pin-function = <1>;
	};

	gmac1_rxdv: gmac1_rxdv {
		telechips,pins = "gpc-8";
		telechips,pin-function = <1>;
	};

	gmac1_rxd0: gmac1_rxd0 {
		telechips,pins = "gpc-3";
		telechips,pin-function = <1>;
	};

	gmac1_rxd1: gmac1_rxd1 {
		telechips,pins = "gpc-4";
		telechips,pin-function = <1>;
	};

	gmac1_rxd2: gmac1_rxd2{
		telechips,pins = "gpc-10";
		telechips,pin-function = <1>;
	};

	gmac1_rxd3: gmac1_rxd3{
		telechips,pins = "gpc-11";
		telechips,pin-function = <1>;
	};

	gmac1_rxd4: gmac1_rxd4 {
		telechips,pins = "gpc-18";
		telechips,pin-function = <1>;
	};

	gmac1_rxd5: gmac1_rxd5 {
		telechips,pins = "gpc-19";
		telechips,pin-function = <1>;
	};

	gmac1_rxd6: gmac1_rxd6{
		telechips,pins = "gpc-20";
		telechips,pin-function = <1>;
	};

	gmac1_rxd7: gmac1_rxd7{
		telechips,pins = "gpc-21";
		telechips,pin-function = <1>;
	};

	gmac1_rxer: gmac1_rxer{
		telechips,pins = "gpc-14";
		telechips,pin-function = <1>;
	};

	gmac1_txer: gmac1_txer{
		telechips,pins = "gpc-15";
		telechips,pin-function = <1>;
		telechips,drive-strength = <1>;
	};

	gmac1_col: gmac1_col{
		telechips,pins = "gpc-16";
		telechips,pin-function = <1>;
	};

	gmac1_crs: gmac1_crs{
		telechips,pins = "gpc-17";
		telechips,pin-function = <1>;
	};

	switch_reverse0: switch_reverse0 {
		telechips,pins = "gpc-22";
		telechips,pin-function = <0>;
		telechips,input-enable;
		telechips,pull-up;
	};

	switch_reverse1: switch_reverse1 {
		telechips,pins = "gpd-8";
		telechips,pin-function = <0>;
		telechips,input-enable;
		telechips,pull-down;
	};

	switch_reverse2: switch_reverse2 {
		telechips,pins = "gpd-4";
		telechips,pin-function = <0>;
		telechips,input-enable;
		telechips,pull-down;
	};

	cam4_idle: cam4_idle {
		telechips,pins = "gpf-0",  "gpf-1",  "gpf-2",
		                 "gpf-3",  "gpf-4",  "gpf-5",  "gpf-6",  "gpf-7",  "gpf-8",  "gpf-9",  "gpf-10",
		                 "gpf-11";
		telechips,pin-function = <0>;
		telechips,output-low;
	};

	cam4_clk: cam4_clk {
		telechips,pins = "gpf-0";
		telechips,pin-function = <1>;
		telechips,drive-strength = <3>;
	};

	cam4_hsync: cam4_hsync {
		telechips,pins = "gpf-1";
		telechips,pin-function = <1>;
		telechips,drive-strength = <3>;
	};

	cam4_vsync: cam4_vsync {
		telechips,pins = "gpf-2";
		telechips,pin-function = <1>;
		telechips,drive-strength = <3>;
	};

	cam4_data: cam4_data {
		telechips,pins = "gpf-3", "gpf-4", "gpf-5", "gpf-6", "gpf-7", "gpf-8", "gpf-9", "gpf-10";
		telechips,pin-function = <1>;
		telechips,drive-strength = <3>;
	};

	cam4_fld: cam4_fld {
		telechips,pins = "gpf-11";
		telechips,pin-function = <1>;
		telechips,drive-strength = <3>;
	};

	cam4_de: cam4_de {
		telechips,pins = "gpf-12";
		telechips,pin-function = <1>;
		telechips,drive-strength = <3>;
	};

	cam1_idle: cam1_idle {
		telechips,pins = "gpb-28", "gpb-24", "gpb-25",
		                 "gpb-8",  "gpb-9",  "gpb-10", "gpb-11", "gpb-12", "gpb-13", "gpb-14", "gpb-15",
		                 "gpb-16", "gpb-17", "gpb-18", "gpb-19", "gpb-20", "gpb-21", "gpb-22", "gpb-23",
		                 "gpb-27", "gpb-26";
		telechips,pin-function = <0>;
		telechips,output-low;
	};

	cam1_clk: cam1_clk {
		telechips,pins = "gpb-28";
		telechips,pin-function = <5>;
		telechips,drive-strength = <2>;
	};

	cam1_hsync: cam1_hsync {
		telechips,pins = "gpb-24";
		telechips,pin-function = <5>;
		telechips,drive-strength = <2>;
	};

	cam1_vsync: cam1_vsync {
		telechips,pins = "gpb-25";
		telechips,pin-function = <5>;
		telechips,drive-strength = <2>;
	};

	cam1_data: cam1_data {
		telechips,pins = "gpb-8",  "gpb-9",  "gpb-10", "gpb-11", "gpb-12", "gpb-13", "gpb-14", "gpb-15",
		                 "gpb-16", "gpb-17", "gpb-18", "gpb-19", "gpb-20", "gpb-21", "gpb-22", "gpb-23";
		telechips,pin-function = <5>;
		telechips,drive-strength = <2>;
	};

	cam1_fld: cam1_fld {
		telechips,pins = "gpb-27";
		telechips,pin-function = <5>;
		telechips,drive-strength = <2>;
	};

	cam1_de: cam1_de {
		telechips,pins = "gpb-26";
		telechips,pin-function = <5>;
		telechips,drive-strength = <2>;
	};

	hdin_clki: hdin_clki {
		telechips,pins = "gpb-28";
		telechips,pin-function = <5>;

	};

	hdin_hsync: hdin_hsync {
		telechips,pins = "gpb-24";
		telechips,pin-function = <5>;

	};

	hdin_vsync: hdin_vsync {
		telechips,pins = "gpb-25";
		telechips,pin-function = <5>;
	};

	hdin_data: hdin_data {
		telechips,pins = "gpb-23", "gpb-22", "gpb-21", "gpb-20",
				 "gpb-19", "gpb-18", "gpb-17", "gpb-16",
				 "gpb-15", "gpb-14", "gpb-13", "gpb-12",
				 "gpb-11", "gpb-10", "gpb-9", "gpb-8",
				 "gpb-7", "gpb-6", "gpb-5", "gpb-4",
				 "gpb-3", "gpb-2", "gpb-1", "gpb-0";
		telechips,pin-function = <5>;

	};

	hdin_de: hdin_de {
		telechips,pins = "gpb-26";
		telechips,pin-function = <5>;
	};		

	mdai_clks: mdai_clks{
		telechips,pins = "gpg-6", "gpg-7", "gpg-8";
		telechips,pin-function = <1>;
	};

	mdai_d0: mdai_d0{
		telechips,pins = "gpg-9", "gpg-10";
		telechips,pin-function = <1>;
	};

	mdai_d1: mdai_d1{
		telechips,pins = "gpg-11", "gpg-12";
		telechips,pin-function = <1>;
	};

	mdai_d2: mdai_d2{
		telechips,pins = "gpg-13", "gpg-14";
		telechips,pin-function = <1>;
	};

	mdai_d3: mdai_d3{
		telechips,pins = "gpg-15", "gpg-16";
		telechips,pin-function = <1>;
	};

	mute_mdai_d0: mute_mdai_d0{
		telechips,pins = "gpg-10";
		telechips,pin-function = <0>;
	};

	mute_mdai_d1: mute_mdai_d1{
		telechips,pins = "gpg-12";
		telechips,pin-function = <0>;
	};

	mute_mdai_d2: mute_mdai_d2{
		telechips,pins = "gpg-14";
		telechips,pin-function = <0>;
	};

	mute_mdai_d3: mute_mdai_d3{
		telechips,pins = "gpg-16";
		telechips,pin-function = <0>;
	};


	mdai_spdif_rx: mdai_spdif_rx{
		telechips,pins = "gpg-17";
		telechips,pin-function = <1>;
	};

	mdai_spdif_tx: mdai_spdif_tx{
		telechips,pins = "gpg-18";
		telechips,pin-function = <1>;
	};

	s1dai_clks: s1dai_clks{
		telechips,pins = "gpg-11", "gpg-12", "gpg-13";
		telechips,pin-function = <9>;
	};

	s1dai_d0: s1dai_d0{
		telechips,pins = "gpg-14", "gpg-15", "gpg-16";
		telechips,pin-function = <9>;
	};

	s1dai_d1: s1dai_d1{
		telechips,pins = "gpg-16", "gpg-17";
		telechips,pin-function = <9>;
	};

	s1dai_d2: s1dai_d2{
		telechips,pins = "gpg-18", "gpg-19";
		telechips,pin-function = <9>;
	};

	s1dai_d3: s1dai_d3{
		telechips,pins = "gpg-5", "gpg-6";
		telechips,pin-function = <9>;
	};

	mute_s1dai_d0: mute_s1dai_d0{
		telechips,pins = "gpg-15";
		telechips,pin-function = <0>;
	};

	mute_s1dai_d1: mute_s1dai_d1{
		telechips,pins = "gpg-17";
		telechips,pin-function = <0>;
	};

	mute_s1dai_d2: mute_s1dai_d2{
		telechips,pins = "gpg-19";
		telechips,pin-function = <0>;
	};

	mute_s1dai_d3: mute_s1dai_d3{
		telechips,pins = "gpg-6";
		telechips,pin-function = <0>;
	};

	s2dai_clks: s2dai_clks{
		telechips,pins = "gpe-23", "gpe-24";
		telechips,pin-function = <3>;
	};

	s2dai_d0: s2dai_d0{
		telechips,pins = "gpe-25", "gpe-26";
		telechips,pin-function = <3>;
	};

	s2dai_d1: s2dai_d1{
		telechips,pins = "gpe-27", "gpe-28";
		telechips,pin-function = <3>;
	};

	s2dai_d2: s2dai_d2{
		telechips,pins = "gpe-29", "gpe-30";
		telechips,pin-function = <3>;
	};

	s2dai_d3: s2dai_d3{
		telechips,pins = "gpe-21";
		telechips,pin-function = <3>;
	};

	mute_s2dai_d0: mute_s2dai_d0{
		telechips,pins = "gpe-26";
		telechips,pin-function = <0>;
	};

	mute_s2dai_d1: mute_s2dai_d1{
		telechips,pins = "gpe-28";
		telechips,pin-function = <0>;
	};

	mute_s2dai_d2: mute_s2dai_d2{
		telechips,pins = "gpe-30";
		telechips,pin-function = <0>;
	};

	mute_s2dai_d3: mute_s2dai_d3{
		telechips,pins = "gpe-21";
		telechips,pin-function = <0>;
	};

	s3dai_clks: s3dai_clks{
		telechips,pins = "gpg-0", "gpg-1", "gpg-2";
		telechips,pin-function = <1>;
	};

	s3dai_d0: s3dai_d0{
		telechips,pins = "gpg-3", "gpg-4";
		telechips,pin-function = <1>;
	};

	mute_s3dai_d0: mute_s3dai_d0{
		telechips,pins = "gpg-4";
		telechips,pin-function = <0>;
	};

	s3dai_spdif_tx: s3dai_spdif_tx{
		telechips,pins = "gpg-5";
		telechips,pin-function = <1>;
	};

	mcdif0_clks: mcdif0_clks{
		telechips,pins = "gpb-15", "gpb-16";
		telechips,pin-function = <7>;
	};

	mcdif0_d0: mcdif0_d0{
		telechips,pins = "gpb-17";
		telechips,pin-function = <7>;
	};

	mcdif1_clks: mcdif1_clks{
		telechips,pins = "gpg-14", "gpg-15";
		telechips,pin-function = <6>;
	};

	mcdif1_d0: mcdif1_d0{
		telechips,pins = "gpg-16";
		telechips,pin-function = <6>;
	};

	scdif0_bclk: scdif0_bclk{
		telechips,pins = "gpc-27";
		telechips,pin-function = <1>;
	};

	scdif0_lrck: scdif0_lrck{
		telechips,pins = "gpc-28";
		telechips,pin-function = <3>;
	};

	scdif0_d0: scdif0_d0{
		telechips,pins = "gpc-9";
		telechips,pin-function = <1>;
	};

	scdif1_clks: scdif1_clks{
		telechips,pins = "gpd-12", "gpd-13";
		telechips,pin-function = <5>;
	};

	scdif1_d0: scdif1_d0{
		telechips,pins = "gpd-14";
		telechips,pin-function = <5>;
	};

	scdif2_clks: scdif2_clks{
		telechips,pins = "gpf-16", "gpf-17";
		telechips,pin-function = <5>;
	};

	scdif2_d0: scdif2_d0{
		telechips,pins = "gpf-18";
		telechips,pin-function = <5>;
	};

	scdif3_clks: scdif3_clks{
		telechips,pins = "gpsd-6", "gpsd-7";
		telechips,pin-function = <5>;
	};

	scdif3_d0: scdif3_d0{
		telechips,pins = "gpsd-8";
		telechips,pin-function = <5>;
	};

	remote_b28: remote_b28 {
		telechips,pins = "gpb-28";
		telechips,pin-function = <12>;
		telechips,output-low;
	};

	remote_c28: remote_c28 {
		telechips,pins = "gpc-28";
		telechips,pin-function = <9>;
		telechips,output-low;
	};

	remote_d21: remote_d21 {
		telechips,pins = "gpd-21";
		telechips,pin-function = <9>;
		telechips,output-low;
	};

	remote_e31: remote_e31 {
		telechips,pins = "gpe-31";
		telechips,pin-function = <9>;
		telechips,output-low;
	};

	remote_f28: remote_f28 {
		telechips,pins = "gpf-28";
		telechips,pin-function = <11>;
		telechips,output-low;
	};

	remote_g17: remote_g17 {
		telechips,pins = "gpg-17";
		telechips,pin-function = <7>;
		telechips,output-low;
	};

	lcd_lpxclk: lcd_lpxclk{
		telechips,pins = "gpb-0";
		telechips,pin-function = <1>;
	};

	lcd_lpxclk_idle: lcd_lpxclk_idle {
		telechips,pins = "gpb-0";
		telechips,pin-function = <0>;
		telechips,output-low = <0>;
	};

	lcd_lhsync: lcd_lhsync {
		telechips,pins = "gpb-1";
		telechips,pin-function = <1>;
	};

	lcd_lhsync_idle: lcd_lhsync_idle {
		telechips,pins = "gpb-1";
		telechips,pin-function = <0>;
		telechips,output-low = <0>;
	};		

	lcd_lvsync: lcd_lvsync {
		telechips,pins = "gpb-2";
		telechips,pin-function = <1>;
	};

	lcd_lvsync_idle: lcd_lvsync_idle {
		telechips,pins = "gpb-2";
		telechips,pin-function = <0>;
		telechips,output-low = <0>;
	};

	lcd_lacbias: lcd_lacbias {
		telechips,pins = "gpb-19";
		telechips,pin-function = <1>;
	};

	lcd_lacbias_idle: lcd_lacbias_idle {
		telechips,pins = "gpb-19";
		telechips,pin-function = <0>;
		telechips,output-low = <0>;
	};

	lcd_lpd: lcd_lpd {
		telechips,pins ="gpb-3", "gpb-4", "gpb-5", "gpb-6",
		                "gpb-7", "gpb-8", "gpb-9", "gpb-10",
		                "gpb-11", "gpb-12", "gpb-13", "gpb-14",
		                "gpb-15", "gpb-16", "gpb-17", "gpb-18",
		                "gpb-20", "gpb-21", "gpb-22", "gpb-23",
		                "gpb-24", "gpb-25", "gpb-26", "gpb-27";
		telechips,pin-function = <1>;
	};

	lcd_lpd_idle: lcd_lpd_idle {
		telechips,pins ="gpb-3", "gpb-4", "gpb-5", "gpb-6",
		                "gpb-7", "gpb-8", "gpb-9", "gpb-10",
		                "gpb-11", "gpb-12", "gpb-13", "gpb-14",
		                "gpb-15", "gpb-16", "gpb-17", "gpb-18",
		                "gpb-20", "gpb-21", "gpb-22", "gpb-23",
		                "gpb-24", "gpb-25", "gpb-26", "gpb-27";
		telechips,pin-function = <0>;
		telechips,output-low = <0>;
	};

	tsc_default: tsc_default {
		telechips,pins = "gpd-21", "gpe-5";
		telechips,pin-function = <0>;
	};

	tsc_default2: tsc_default2 {
		telechips,pins = "gpb-28";
		telechips,pin-function = <0>;
	};

	aud_amp: aud_amp{
		telechips,pins = "gpc-16", "gpg-17";
		telechips,pin-function = <0>;
		telechips,output-high;
	};
};
