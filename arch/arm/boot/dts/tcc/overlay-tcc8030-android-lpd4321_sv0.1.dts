// SPDX-License-Identifier: (GPL-2.0-or-later OR MIT)
/*
 * Copyright (C) Telechips Inc.
 */

/dts-v1/;
/plugin/;

#define DT_OVERLAY

#include <dt-bindings/interrupt-controller/arm-gic.h>
#include <dt-bindings/clock/telechips,tcc803x-clks.h>
#include <dt-bindings/display/tcc803x-vioc.h>
#include <dt-bindings/power/telechips,boot-mode.h>
#include <dt-bindings/gpio/gpio.h>

#include "tcc-pmap-803x-android-customized.dtsi"

#include <dt-bindings/pmap/tcc803x/pmap-tcc803x-android-ivi.h>
#include "tcc-pmap-common.dtsi"

#include "tcc8030-android-lpd4321_sv0.1.dts"
