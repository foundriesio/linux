// SPDX-License-Identifier: (GPL-2.0+ OR MIT)
/*
 * Device tree for Telechips TCC899x family SoC
 *
 * Copyright (C) 2018 Telechips Inc.
 */

#include <dt-bindings/interrupt-controller/arm-gic.h>
#include <dt-bindings/clock/telechips,tcc899x-clks.h>
#include <dt-bindings/reset/telechips,tcc899x-reset.h>
#include <dt-bindings/soc/tcc899x-pm.h>
#include <dt-bindings/display/tcc899x-vioc.h>
#include <dt-bindings/power/telechips,boot-mode.h>
#include <dt-bindings/gpio/gpio.h>

#include "tcc-pmap-common.dtsi"

/ {
	compatible = "telechips,tcc899x";
	interrupt-parent = <&gic>;
	#address-cells = <1>;
	#size-cells = <1>;

	chosen: chosen {
		bootargs = "vmalloc=480M console=ttyAMA0,115200";
	};

	memory: memory@20000000 { // dummy dt
		#address-cells = <2>;
		#size-cells = <2>;
		device_type = "memory";
		reg = <0x0 0x20000000 0x0 0x80000000>;
	};

	aliases {
		i2c0 = &i2c0;
		i2c1 = &i2c1;
		i2c2 = &i2c2;
		i2c3 = &i2c3;
		i2s0 = &i2s0;
		i2s1 = &i2s1;
		spdif0 = &spdif0;
		spdif1 = &spdif1;
		cdif0 = &cdif0;
		cdif1 = &cdif1;
		serial0 = &uart0;
		serial1 = &uart1;
		serial2 = &uart2;
		serial3 = &uart3;
		serial4 = &uart4;
		serial5 = &uart5;
		serial6 = &uart6;
		serial7 = &uart7;
		dma0 = &dma0;
		dma1 = &dma1;
		dma2 = &dma2;
		dma3 = &dma3;
		udma0 = &udma0;
		udma1 = &udma1;
		udma2 = &udma2;
		udma3 = &udma3;
		wmixer_drv0 = &wmixer_drv0;
		wmixer_drv1 = &wmixer_drv1;
		scaler_drv1 = &scaler_drv1;
		scaler_drv3 = &scaler_drv3;
		attach_drv0 = &attach_drv0;
		attach_drv1 = &attach_drv1;
		vout_drv0 = &vout_drv0;
		vout_drv1 = &vout_drv1;
		wdma_drv0 = &wdma_drv0;
		fb0 = &fb0;
		fb1 = &fb1;
		fb2 = &fb2;
	};

	psci {
		compatible = "arm,psci-0.2";
		method = "smc";
	};

	cpus {
		#address-cells = <1>;
		#size-cells = <0>;
		cpu-map {
			cluster0 {
				core0 {
					cpu = <&A53_0>;
				};
				core1 {
					cpu = <&A53_1>;
				};
				core2 {
					cpu = <&A53_2>;
				};
				core3 {
					cpu = <&A53_3>;
				};
			};
		};

		A53_0: cpu@0 {
			device_type = "cpu";
			compatible = "arm,cortex-a53";
			reg = <0x0>;
			enable-method = "psci";
			next-level-cache = <&A53_L2>;
			cpu-idle-states = <&CPU_SLEEP_0_0>;
			operating-points-v2 = <&cpu_opp_table>;
			clocks = <&clk_fbus FBUS_CPU0>;
			sched-energy-costs = <&CPU_COST &CLUSTER_COST>;
		};
		A53_1: cpu@1 {
			device_type = "cpu";
			compatible = "arm,cortex-a53";
			reg = <0x1>;
			enable-method = "psci";
			next-level-cache = <&A53_L2>;
			cpu-idle-states = <&CPU_SLEEP_0_0>;
			operating-points-v2 = <&cpu_opp_table>;
			sched-energy-costs = <&CPU_COST &CLUSTER_COST>;
		};
		A53_2: cpu@2 {
			device_type = "cpu";
			compatible = "arm,cortex-a53";
			reg = <0x2>;
			enable-method = "psci";
			next-level-cache = <&A53_L2>;
			cpu-idle-states = <&CPU_SLEEP_0_0>;
			operating-points-v2 = <&cpu_opp_table>;
			sched-energy-costs = <&CPU_COST &CLUSTER_COST>;
		};
		A53_3: cpu@3 {
			device_type = "cpu";
			compatible = "arm,cortex-a53";
			reg = <0x3>;
			enable-method = "psci";
			next-level-cache = <&A53_L2>;
			cpu-idle-states = <&CPU_SLEEP_0_0>;
			operating-points-v2 = <&cpu_opp_table>;
			sched-energy-costs = <&CPU_COST &CLUSTER_COST>;
		};

		idle-states {
			entry-method = "arm,psci";

			CPU_SLEEP_0_0: cpu-sleep-0-0 {
				compatible = "arm,idle-state";
				local-timer-stop;
				arm,psci-suspend-param = <0x0010000>;
				entry-latency-us = <250>;
				exit-latency-us = <500>;
				min-residency-us = <950>;
			};
		};
		A53_L2: l2-cache0 {
			compatible = "cache";
		};

		/include/ "tcc899x-sched-energy.dtsi"
	};

	cpu_opp_table: cpu_opp_table {
		compatible = "operating-points-v2";
		opp-shared;

		opp0 {
			opp-hz = /bits/ 64 <1400000000>;
			opp-microvolt = <900000>;
			clock-latency-ns = <300000>;
		};

		opp1 {
			opp-hz = /bits/ 64 <1250000000>;
			opp-microvolt = <900000>;
			clock-latency-ns = <300000>;
		};

		opp2 {
			opp-hz = /bits/ 64 <1050000000>;
			opp-microvolt = <800000>;
			clock-latency-ns = <300000>;
		};

	};

	gic: interrupt-controller@17301000 {
		compatible = "arm,gic-400", "telechips,tcc899x-vpic";
		#interrupt-cells = <3>;
		#address-cells = <0>;
		interrupt-controller;
		reg = <0x17301000 0x1000>,
		      <0x17302000 0x1000>,
		      <0x17304000 0x2000>,
		      <0x17306000 0x2000>,
		      <0x14100000 0x260>;
	};

	timer {
		compatible = "arm,armv8-timer";
		interrupts = <GIC_PPI 13 (GIC_CPU_MASK_SIMPLE(4) | IRQ_TYPE_LEVEL_LOW)>,
			     <GIC_PPI 14 (GIC_CPU_MASK_SIMPLE(4) | IRQ_TYPE_LEVEL_LOW)>,
			     <GIC_PPI 11 (GIC_CPU_MASK_SIMPLE(4) | IRQ_TYPE_LEVEL_LOW)>,
			     <GIC_PPI 10 (GIC_CPU_MASK_SIMPLE(4) | IRQ_TYPE_LEVEL_LOW)>;
	};

	pmu {
		compatible = "arm,cortex-a15-pmu";
		interrupts = <GIC_SPI 160 IRQ_TYPE_LEVEL_LOW>,
			     <GIC_SPI 161 IRQ_TYPE_LEVEL_LOW>,
			     <GIC_SPI 162 IRQ_TYPE_LEVEL_LOW>,
			     <GIC_SPI 163 IRQ_TYPE_LEVEL_LOW>;
	};

	reserved-memory {
		#address-cells = <1>;
		#size-cells = <1>;
		ranges;

		/*-----------------------------------------------------------
		 * Secure Area 1 (CPU R/W, VPU X, GPU R/W, VIOC R)
		 *-----------------------------------------------------------
		 */
		pmap_fb_video: fb_video {
			compatible = "telechips,pmap";
			telechips,pmap-name = "fb_video";
			alloc-ranges = <SECURE_AREA_1_BASE SECURE_AREA_1_SIZE>;
			size = <PMAP_SIZE_FB_VIDEO>;
			telechips,cma-alloc-size = <CMA_SIZE_FB_VIDEO>;
			telechips,pmap-secured = <1>;
			no-map;
		};

		pmap_fb1_video: fb1_video {
			compatible = "telechips,pmap";
			telechips,pmap-name = "fb1_video";
			alloc-ranges = <SECURE_AREA_1_BASE SECURE_AREA_1_SIZE>;
			size = <PMAP_SIZE_FB1_VIDEO>;
			telechips,cma-alloc-size = <CMA_SIZE_FB1_VIDEO>;
			telechips,pmap-secured = <1>;
			no-map;
		};

		pmap_fb2_video: fb2_video {
			compatible = "telechips,pmap";
			telechips,pmap-name = "fb2_video";
			alloc-ranges = <SECURE_AREA_1_BASE SECURE_AREA_1_SIZE>;
			size = <PMAP_SIZE_FB2_VIDEO>;
			telechips,cma-alloc-size = <CMA_SIZE_FB2_VIDEO>;
			telechips,pmap-secured = <1>;
			no-map;
		};

		/*-----------------------------------------------------------
		 * Secure Area 2 (CPU X, VPU X, GPU X, VIOC R/W)
		 *-----------------------------------------------------------
		 */
		pmap_overlay: overlay {
			compatible = "telechips,pmap";
			telechips,pmap-name = "overlay";
			alloc-ranges = <SECURE_AREA_2_BASE SECURE_AREA_2_SIZE>;
			size = <PMAP_SIZE_OVERLAY>; // Max-Displayed-Output(w*h*2) * 3
			telechips,cma-alloc-size = <CMA_SIZE_OVERLAY>;
			telechips,pmap-secured = <2>;
			no-map;
		};

		pmap_overlay1: overlay1 {
			compatible = "telechips,pmap";
			telechips,pmap-name = "overlay1";
			alloc-ranges = <SECURE_AREA_2_BASE SECURE_AREA_2_SIZE>;
			size = <PMAP_SIZE_OVERLAY1>; // Max-Displayed-Output(w*h*2) * 3
			telechips,cma-alloc-size = <CMA_SIZE_OVERLAY1>;
			telechips,pmap-secured = <2>;
			no-map;
		};

		pmap_overlay_rot: overlay_rot {
			compatible = "telechips,pmap";
			telechips,pmap-name = "overlay_rot";
			alloc-ranges = <SECURE_AREA_2_BASE SECURE_AREA_2_SIZE>;
			size = <PMAP_SIZE_OVERLAY_ROT>; // Max-Displayed-Output(w*h*2) for device-rotation.
			telechips,cma-alloc-size = <CMA_SIZE_OVERLAY_ROT>;
			telechips,pmap-secured = <2>;
			no-map;
		};

		pmap_viqe0: viqe0 {
			compatible = "telechips,pmap";
			telechips,pmap-name = "viqe";
			alloc-ranges = <SECURE_AREA_2_BASE SECURE_AREA_2_SIZE>;
			size = <PMAP_SIZE_VIQE0>;
			telechips,cma-alloc-size = <CMA_SIZE_VIQE0>;
			telechips,pmap-secured = <2>;
			no-map;
		};

		pmap_viqe1: viqe1 {
			compatible = "telechips,pmap";
			telechips,pmap-name = "viqe1";
			alloc-ranges = <SECURE_AREA_2_BASE SECURE_AREA_2_SIZE>;
			size = <PMAP_SIZE_VIQE1>;
			telechips,cma-alloc-size = <CMA_SIZE_VIQE1>;
			telechips,pmap-secured = <2>;
			no-map;
		};

		pmap_output_attach: output_attach {
			compatible = "telechips,pmap";
			telechips,pmap-name = "output_attach";
			alloc-ranges = <SECURE_AREA_2_BASE SECURE_AREA_2_SIZE>;
			size = <PMAP_SIZE_OUTPUT_ATTACH>;
			telechips,cma-alloc-size = <CMA_SIZE_OUTPUT_ATTACH>;
			telechips,pmap-secured = <2>;
			no-map;
		};

		pmap_v4l2_vout0: v4l2_vout0 {
			compatible = "telechips,pmap";
			telechips,pmap-name = "v4l2_vout0";
			alloc-ranges = <SECURE_AREA_2_BASE SECURE_AREA_2_SIZE>;
			size = <PMAP_SIZE_V4L2_VOUT0>;
			telechips,cma-alloc-size = <CMA_SIZE_V4L2_VOUT0>;
			telechips,pmap-secured = <2>;
			no-map;
		};

		pmap_v4l2_vout1: v4l2_vout1 {
			compatible = "telechips,pmap";
			telechips,pmap-name = "v4l2_vout1";
			alloc-ranges = <SECURE_AREA_2_BASE SECURE_AREA_2_SIZE>;
			size = <PMAP_SIZE_V4L2_VOUT1>;
			telechips,cma-alloc-size = <CMA_SIZE_V4L2_VOUT1>;
			telechips,pmap-secured = <2>;
			no-map;
		};

		pmap_video_dual: video_dual {
			compatible = "telechips,pmap";
			telechips,pmap-name = "video_dual";
			alloc-ranges = <SECURE_AREA_2_BASE SECURE_AREA_2_SIZE>;
			size = <PMAP_SIZE_VIDEO_DUAL>;
			telechips,cma-alloc-size = <CMA_SIZE_VIDEO_DUAL>;
			telechips,pmap-secured = <2>;
			no-map;
		};

		pmap_fb_wmixer: fb_wmixer {
			compatible = "telechips,pmap";
			telechips,pmap-name = "fb_wmixer";
			alloc-ranges = <SECURE_AREA_2_BASE SECURE_AREA_2_SIZE>;
			size = <PMAP_SIZE_FB_WMIXER>; // Max-Video-Resolution(w*h*2)
			telechips,cma-alloc-size = <CMA_SIZE_FB_WMIXER>;
			telechips,pmap-secured = <2>;
			no-map;
		};

		/*-----------------------------------------------------------
		 * Secure Area 3 (CPU X, VPU R/W, GPU X, VIOC R)
		 *-----------------------------------------------------------
		 */

		pmap_secure_inbuf: secure_inbuf {
			compatible = "telechips,pmap";
			telechips,pmap-name = "secure_inbuf";
			alloc-ranges = <SECURE_AREA_3_BASE SECURE_AREA_3_SIZE>;
			size = <PMAP_SIZE_SECURE_INBUF>;
			telechips,cma-alloc-size = <CMA_SIZE_SECURE_INBUF>;
			telechips,pmap-secured = <3>;
			no-map;
		};

		pmap_video_ext: video_ext {
			compatible = "telechips,pmap";
			telechips,pmap-name = "video_ext";
			alloc-ranges = <SECURE_AREA_3_BASE SECURE_AREA_3_SIZE>;
			size = <PMAP_SIZE_VIDEO_EXT>;
			telechips,cma-alloc-size = <CMA_SIZE_VIDEO_EXT>;
			telechips,pmap-secured = <3>;
			no-map;
		};

		pmap_video_ext2: video_ext2 {
			compatible = "telechips,pmap";
			telechips,pmap-name = "video_ext2";
			alloc-ranges = <SECURE_AREA_3_BASE SECURE_AREA_3_SIZE>;
			size = <PMAP_SIZE_VIDEO_EXT2>;
			telechips,cma-alloc-size = <CMA_SIZE_VIDEO_EXT2>;
			telechips,pmap-secured = <3>;
			no-map;
		};

		pmap_video: video {
			compatible = "telechips,pmap";
			telechips,pmap-name = "video";
			alloc-ranges = <SECURE_AREA_3_BASE SECURE_AREA_3_SIZE>;
			size = <PMAP_SIZE_VIDEO>;
			telechips,cma-alloc-size = <CMA_SIZE_VIDEO>;
			telechips,pmap-secured = <3>;
			no-map;
		};

		pmap_video_sw: video_sw {
			compatible = "telechips,pmap";
			telechips,pmap-name = "video_sw";
			alloc-ranges = <RESERVED_MEM_BASE RESERVED_MEM_SIZE>;
			size = <PMAP_SIZE_VIDEO_SW_EXTRA>;
			telechips,cma-alloc-size = <CMA_SIZE_VIDEO_SW_EXTRA>;
			no-map;
		};

		/*-----------------------------------------------------------
		 * Secure Area 4 (CPU X, VPU X, GPU R/W, VIOC R/W)
		 *-----------------------------------------------------------
		 */
		pmap_ump_reserved: ump_reserved {
			compatible = "telechips,pmap";
			telechips,pmap-name = "ump_reserved";
			alloc-ranges = <SECURE_AREA_4_BASE SECURE_AREA_4_SIZE>;
			size = <PMAP_SIZE_UMP_RESERVED>; // Max-Video-Resolution(Aligned_256KB(w*h*3/2)) * 12 + 1MB
			telechips,cma-alloc-size = <CMA_SIZE_UMP_RESERVED>;
			telechips,pmap-secured = <4>;
		};

                pmap_ion_carveout_cam: ion_carveout_cam {
                        compatible = "telechips,pmap";
                        telechips,pmap-name = "ion_carveout_cam";
                        alloc-ranges = <SECURE_AREA_4_BASE SECURE_AREA_4_SIZE>;
                        size = <PMAP_SIZE_ION_CARVEOUT_CAM>; // 12MB
			telechips,cma-alloc-size = <CMA_SIZE_ION_CARVEOUT_CAM>;
                        telechips,pmap-secured = <4>;
                };

		/*-----------------------------------------------------------
		 * Shared Memory with pmap_viqe
		 *-----------------------------------------------------------
		 */
		pmap_jpeg_header: jpeg_header {
			compatible = "telechips,pmap";
			telechips,pmap-name = "jpeg_header";
			alloc-ranges = <RESERVED_MEM_BASE RESERVED_MEM_SIZE>;
			telechips,pmap-shared = <&pmap_viqe0>;
			telechips,pmap-shared-size = <PMAP_SIZE_JPEG_HEADER>;
			telechips,pmap-offset = <0x0>;
			size = <0x0>;
			no-map;
		};

		pmap_jpeg_stream: jpeg_stream {
			compatible = "telechips,pmap";
			telechips,pmap-name = "jpeg_stream";
			alloc-ranges = <RESERVED_MEM_BASE RESERVED_MEM_SIZE>;
			telechips,pmap-shared = <&pmap_jpeg_header>;
			telechips,pmap-shared-size = <PMAP_SIZE_JPEG_STREAM>;
			telechips,pmap-offset = <PMAP_SIZE_JPEG_HEADER>;
			size = <0x0>;
			no-map;
		};

		pmap_jpeg_raw: jpeg_raw {
			compatible = "telechips,pmap";
			telechips,pmap-name = "jpeg_raw";
			alloc-ranges = <RESERVED_MEM_BASE RESERVED_MEM_SIZE>;
			telechips,pmap-shared = <&pmap_jpeg_stream>;
			telechips,pmap-shared-size = <PMAP_SIZE_JPEG_RAW>;
			telechips,pmap-offset = <PMAP_SIZE_JPEG_STREAM>;
			size = <0x0>;
			no-map;
		};

		/*-----------------------------------------------------------
		 * Default Reserved Memory
		 *-----------------------------------------------------------
		 */
		pmap_ump_reserved_sw: ump_reserved_sw {
			compatible = "telechips,pmap";
			telechips,pmap-name = "ump_reserved_sw";
			alloc-ranges = <RESERVED_MEM_BASE RESERVED_MEM_SIZE>;
			size = <PMAP_SIZE_UMP_RESERVED_SW>; // 4KB * 12
			telechips,cma-alloc-size = <CMA_SIZE_UMP_RESERVED_SW>;
			no-map;
		};

		pmap_secure_exp: secure_exp {
			compatible = "telechips,pmap";
			telechips,pmap-name = "secure_exp";
			alloc-ranges = <RESERVED_MEM_BASE RESERVED_MEM_SIZE>;
			size = <PMAP_SIZE_SECURE_EXP>;
			no-map;
		};

		pmap_enced_ts: enced_ts {
			compatible = "telechips,pmap";
			telechips,pmap-name = "enced_ts";
			alloc-ranges = <RESERVED_MEM_BASE RESERVED_MEM_SIZE>;
			size = <PMAP_SIZE_ENCED_TS>;
			no-map;
		};

		pmap_video_sbackup: video_sbackup {
			compatible = "telechips,pmap";
			telechips,pmap-name = "video_sbackup";
			alloc-ranges = <RESERVED_MEM_BASE RESERVED_MEM_SIZE>;
			size = <PMAP_SIZE_VIDEO_SBACKUP>;  // 0x200000 for 1080p, 0x600000 for 2160p
			telechips,pmap-secured;
			no-map;
		};

		pmap_pmem: pmem {
			compatible = "telechips,pmap";
			telechips,pmap-name = "pmem";
			alloc-ranges = <RESERVED_MEM_BASE RESERVED_MEM_SIZE>;
			size = <PMAP_SIZE_PMEM>;
			no-map;
		};

		pmap_video_thumb: video_thumb {
			compatible = "telechips,pmap";
			telechips,pmap-name = "video_thumb";
			alloc-ranges = <RESERVED_MEM_BASE RESERVED_MEM_SIZE>;
			size = <PMAP_SIZE_VIDEO_THUMB>; //0x600000 for 1080p video, 0x1A00000 for 2160p
			no-map;
		};

		pmap_ext_camera: ext_camera {
			compatible = "telechips,pmap";
			telechips,pmap-name = "ext_camera";
			alloc-ranges = <RESERVED_MEM_BASE RESERVED_MEM_SIZE>;
			size = <PMAP_SIZE_EXT_CAMERA>;
			no-map;
		};

		pmap_nand_mem: nand_mem {
			compatible = "telechips,pmap";
			telechips,pmap-name = "nand_mem";
			alloc-ranges = <RESERVED_MEM_BASE RESERVED_MEM_SIZE>;
			size = <PMAP_SIZE_NAND_MEM>;
			no-map;
		};

		pmap_tsif: tsif {
			compatible = "telechips,pmap";
			telechips,pmap-name = "tsif";
			alloc-ranges = <RESERVED_MEM_BASE RESERVED_MEM_SIZE>;
			size = <PMAP_SIZE_TSIF>;
			no-map;
		};

		/*
		pmap_jpg_enc_dxb: jpg_enc_dxb {
			telechips,pmap-name = "jpg_enc_dxb";
			alloc-ranges = <RESERVED_MEM_BASE RESERVED_MEM_SIZE>;
			size = <PMAP_SIZE_JPG_ENC_DXB>;
			no-map;
		};

		pmap_jpg_raw_dxb: jpg_raw_dxb {
			telechips,pmap-name = "jpg_raw_dxb";
			alloc-ranges = <RESERVED_MEM_BASE RESERVED_MEM_SIZE>;
			size = <PMAP_SIZE_JPG_RAW_DXB>;
			no-map;
		};
		*/

		pmap_v4l2_subtitle: v4l2_subtitle {
			compatible = "telechips,pmap";
			telechips,pmap-name = "v4l2_subtitle";
			alloc-ranges = <RESERVED_MEM_BASE RESERVED_MEM_SIZE>;
			size = <PMAP_SIZE_V4L2_SUBTITLE>;
			no-map;
		};

		pmap_itapi_fifo: itapi_fifo {
			compatible = "telechips,pmap";
			telechips,pmap-name = "itapi_fifo";
			alloc-ranges = <RESERVED_MEM_BASE RESERVED_MEM_SIZE>;
			size = <PMAP_SIZE_ITAPI_FIFO>;
			no-map;
		};

		reserved_ramoops: ramoops {
			compatible = "telechips,pmap";
			telechips,pmap-name = "ramoops";
			alloc-ranges = <RESERVED_MEM_BASE RESERVED_MEM_SIZE>;
			size = <PMAP_SIZE_RAMOOPS>;
			no-map;
		};

		reserved_cma: linux,cma {
			compatible = "shared-dma-pool";
			alloc-ranges = <RESERVED_MEM_BASE RESERVED_MEM_SIZE>;
			size = <PMAP_SIZE_CMA>;
			//alignment = <0x04000000>;
			alignment = <0x0>;
			linux,cma-default;
			reusable;
		};

		pmap_dolby_regs: dolby_regs {
			compatible = "telechips,pmap";
			telechips,pmap-name = "dolby_regs";
			alloc-ranges = <RESERVED_MEM_BASE RESERVED_MEM_SIZE>;
			size = <PMAP_SIZE_DOLBY_REGS>;
			no-map;
		};

		/*-----------------------------------------------------------
		 * Shared Memory with pmap_video :: only for enc_main pmap.
		 *-----------------------------------------------------------
		 */
		pmap_enc_main: enc_main {
			compatible = "telechips,pmap";
			telechips,pmap-name = "enc_main";
			alloc-ranges = <RESERVED_MEM_BASE RESERVED_MEM_SIZE>;
			telechips,pmap-shared = <&pmap_video>;
			telechips,pmap-shared-size = <PMAP_SIZE_ENC>;
			telechips,pmap-offset = <VIDEO_MAIN_SIZE>;
			size = <0x0>;
			no-map;
		};

		pmap_enc_ext: enc_ext {
			compatible = "telechips,pmap";
			telechips,pmap-name = "enc_ext";
			alloc-ranges = <RESERVED_MEM_BASE RESERVED_MEM_SIZE>;
			size = <PMAP_SIZE_ENC_EXT>;
			no-map;
		};

		pmap_enc_ext2: enc_ext2 {
			compatible = "telechips,pmap";
			telechips,pmap-name = "enc_ext2";
			alloc-ranges = <RESERVED_MEM_BASE RESERVED_MEM_SIZE>;
			size = <PMAP_SIZE_ENC_EXT2>;
			no-map;
		};

		pmap_enc_ext3: enc_ext3 {
			compatible = "telechips,pmap";
			telechips,pmap-name = "enc_ext3";
			alloc-ranges = <RESERVED_MEM_BASE RESERVED_MEM_SIZE>;
			size = <PMAP_SIZE_ENC_EXT3>;
			no-map;
		};

		reserved_optee: optee_os {
			compatible = "optee.os";
			reg = <PMAP_BASE_OPTEE_OS PMAP_SIZE_OPTEE_OS>;
			no-map;
			//status = "disabled";
		};

		reserved_dw_esm: dw_esm {
			compatible = "dw.esm";
			reg = <PMAP_BASE_PROT_ESM_FW PMAP_SIZE_PROT_ESM_FW>;
			no-map;
		};

		reserved_prot_vpu: prot_vpu {
			compatible = "telechips,pmap";
			//telechips,pmap-name = "prot_vpu";
			reg = <PMAP_BASE_PROT_VPU_FW PMAP_SIZE_PROT_VPU_FW>;
			no-map;
		};

		reserved_prot_ca7: prot_ca7 {
			compatible = "telechips,pmap";
			//telechips,pmap-name = "prot_ca7";
			reg = <PMAP_BASE_PROT_CA7_FW PMAP_SIZE_PROT_CA7_FW>;
			no-map;
		};

		reserved_secure_sap: secure_sap {
			compatible = "telechips,pmap";
			telechips,pmap-name = "secure_sap";
			reg = <PMAP_BASE_SECURE_SAP PMAP_SIZE_SECURE_SAP>;
			no-map;
		};

		reserved_secure_tsa: secure_tsa {
			compatible = "telechips,pmap";
			telechips,pmap-name = "secure_tsa";
			reg = <PMAP_BASE_SECURE_TSA PMAP_SIZE_SECURE_TSA>;
			no-map;
		};

		reserved_secure_tsv: secure_tsv {
			compatible = "telechips,pmap";
			telechips,pmap-name = "secure_tsv";
			reg = <PMAP_BASE_SECURE_TSV PMAP_SIZE_SECURE_TSV>;
			no-map;
		};
	};

	ramoops {
		compatible = "ramoops";
		memory-region = <&reserved_ramoops>;
		record-size = <0x00000000 0x00020000>;
		console-size = <0x00000000 0x00020000>;
		ecc-size = <16>;
		unbuffered;
		status = "okay";
	};

	tcc_pm: tcc_pm {
		compatible = "telechips,pm";
		reg = < 0x16400000 0x000100  /* nfc*/
			0x16430000 0x000030  /* edi*/
			0x16600000 0x000050  /* uart0*/
			0x16684000 0x000010  /* uart config*/
			0x14200000 0x000540>;  /* gpio*/
		suspend_mode = <0>;	/* 0:sleep, 1:shutdown, 2:wfi */
	};

	pmu_rst: reset-controller@140000b4 {
		compatible = "telechips,reset";
		#reset-cells = <1>;
	};

	vpubus_rst: reset-controller@15100004 {
		compatible = "telechips,vpubus-reset";
		#reset-cells = <1>;
	};

	ddibus_rst: reset-controller@12380004 {
		compatible = "telechips,ddibus-reset";
		#reset-cells = <1>;
	};

	iobus_rst: reset-controller@1605100c {
		compatible = "telechips,iobus-reset";
		#reset-cells = <1>;
	};

	hsiobus_rst: reset-controller@111a0004 {
		compatible = "telechips,hsiobus-reset";
		#reset-cells = <1>;
	};

	clocks {
		compatible = "telechips,ckc";
		#address-cells = <1>;
		#size-cells = <1>;

		osc24m: oscillator {
			compatible = "fixed-clock";
			#clock-cells = <0>;
			clock-frequency = <24000000>;
			clock-output-names = "osc24m";
		};

		clk_ext0: clk_ext@0 {
			compatible = "fixed-clock";
			#clock-cells = <0>;
			clock-frequency = <24000000>;
			clock-output-names = "clk_ext0";
		};

		clk_ext1: clk_ext@1 {
			compatible = "fixed-clock";
			#clock-cells = <0>;
			clock-frequency = <24000000>;
			clock-output-names = "clk_ext1";
		};

		clk_pll: pll_clk {
			compatible = "telechips,clk-pll";
			#clock-cells = <1>;
			clocks = <&osc24m>;
			clock-output-names = "pll0", "pll1", "pll2", "pll3",
					     "pll4";
		};

		clk_fbus: clk@14000000 {
			compatible = "telechips,clk-fbus";
			#clock-cells = <1>;
			clock-indices =
				<FBUS_CPU0>, <FBUS_CPU1>, <FBUS_CBUS>, <FBUS_CMBUS>,
				<FBUS_MEM>, <FBUS_VBUS>, <FBUS_HSIO>, <FBUS_SMU>,
				<FBUS_GPU>, <FBUS_DDI>, <FBUS_IO>, <FBUS_BODA>,
				<FBUS_CHEVC>, <FBUS_BHEVC>, <FBUS_MEM_PHY>;
			clock-output-names =
				"fbus_cpu0", "fbus_cpu1", "fbus_cbus", "fbus_cmbus",
				"fbus_mem", "fbus_vbus", "fbus_hsio", "fbus_smu",
				"fbus_gpu", "fbus_ddi", "fbus_io", "fbus_boda",
				"fbus_chevc", "fbus_bhevc", "fbus_mem_phy";
			telechips,clock-flags =
				<0>,	/* FBUS_CPU0 */
				<CLK_IGNORE_UNUSED>,	/* FBUS_CPU1 */
				<(CLK_SET_RATE_GATE | CLK_IGNORE_UNUSED)>,	/* FBUS_CBUS */
				<(CLK_SET_RATE_GATE | CLK_IGNORE_UNUSED)>,	/* FBUS_CMBUS */
				<(CLK_SET_RATE_GATE | CLK_IGNORE_UNUSED)>,	/* FBUS_MEM */
				<0>,	/* FBUS_VBUS */
				<CLK_SET_RATE_GATE>,	/* FBUS_HSIO */
				<(CLK_SET_RATE_GATE | CLK_IGNORE_UNUSED)>,	/* FBUS_SMU */
				<0>,	/* FBUS_GPU */
				<(CLK_SET_RATE_GATE | CLK_IGNORE_UNUSED)>,	/* FBUS_DDI */
				<(CLK_SET_RATE_GATE | CLK_IS_CRITICAL)>,	/* FBUS_IO */
				<0>,	/* FBUS_BODA */
				<0>,	/* FBUS_CHEVC */
				<0>,	/* FBUS_BHEVC */
				<CLK_IGNORE_UNUSED>;	/* FBUS_MEM_PHY */
		};

		clk_peri: clk@140000d0 {
			compatible = "telechips,clk-peri";
			#clock-cells = <1>;
			clock-indices =
				<PERI_TCX>, <PERI_TCT>, <PERI_TCZ>,
				<PERI_LCDTIMER>, <PERI_LCD0>, <PERI_LCD1>,
				<PERI_HDMI_27MHZ>, <PERI_HDMI_SPDIF>,
				<PERI_HDMI_PHY>, <PERI_HDMI_CEC>,
				<PERI_HDMI_HDCP14>, <PERI_HDMI_HDCP22>, <PERI_SAR>,
				<PERI_DEINTERLACER>, <PERI_GMAC>,
				<PERI_PCIE_PCS>, <PERI_GMAC_PTP>,
				<PERI_PCIE_AUX>, <PERI_PCIE_REF_EXT>,
				<PERI_PCIE_APB>, <PERI_USB20H>, <PERI_USB_OTG_ADP>,
				<PERI_USB_OTG>, <PERI_RMT>, <PERI_SDMMC0>,
				<PERI_SDMMC1>, <PERI_SDMMC2>, <PERI_CEC1_CORE>,
				<PERI_MDAI0>, <PERI_MFLT0_DAI>, <PERI_MSPDIF0>,
				<PERI_MDAI1>, <PERI_MFLT1_DAI>, <PERI_MSPDIF1>,
				<PERI_PDM>, <PERI_CEC1_SFR>, <PERI_TSADC>,
				<PERI_I2C0>, <PERI_I2C1>, <PERI_I2C2>, <PERI_I2C3>,
				<PERI_UART0>, <PERI_UART1>, <PERI_UART2>,
				<PERI_UART3>, <PERI_UART4>, <PERI_UART5>,
				<PERI_UART6>, <PERI_UART7>, <PERI_GPSB0>,
				<PERI_GPSB1>, <PERI_GPSB2>, <PERI_GPSBMS0>,
				<PERI_GPSBMS1>, <PERI_GPSBMS2>, <PERI_ASRC0_INPUT>,
				<PERI_ASRC1_INPUT>, <PERI_MFLT0_CDIF>,
				<PERI_ASRC0_OUTPUT>, <PERI_ASRC1_OUTPUT>,
				<PERI_MFLT1_CDIF>, <PERI_IC_TC>, <PERI_TSRX0>,
				<PERI_TSRX1>, <PERI_TSRX2>, <PERI_TSRX3>,
				<PERI_TSRX4>, <PERI_TSRX5>, <PERI_TSRX6>,
				<PERI_TSRX7>, <PERI_TSRX8>, <PERI_CB_WDT>,
				<PERI_OUT0>, <PERI_OUT1>, <PERI_OUT2>, <PERI_OUT3>,
				<PERI_OUT4>, <PERI_OUT5>;
			clock-output-names =
				"peri_tcx", "peri_tct", "peri_tcz",
				"peri_lcdtimer", "peri_lcd0", "peri_lcd1",
				"peri_hdmi_27mhz", "peri_hdmi_spdif",
				"peri_hdmi_phy", "peri_hdmi_cec",
				"peri_hdmi_hdcp14", "peri_hdmi_hdcp22", "peri_sar",
				"peri_deinterlacer", "peri_gmac",
				"peri_pcie_pcs", "peri_gmac_ptp",
				"peri_pcie_aux", "peri_pcie_ref_ext",
				"peri_pcie_apb", "peri_usb20h", "peri_usb_otg_adp",
				"peri_usb_otg", "peri_rmt", "peri_sdmmc0",
				"peri_sdmmc1", "peri_sdmmc2", "peri_cec1_core",
				"peri_mdai0", "peri_mflt0_dai", "peri_mspdif0",
				"peri_mdai1", "peri_mflt1_dai", "peri_mspdif1",
				"peri_pdm", "peri_cec1_sfr", "peri_tsadc",
				"peri_i2c0", "peri_i2c1", "peri_i2c2", "peri_i2c3",
				"peri_uart0", "peri_uart1", "peri_uart2",
				"peri_uart3", "peri_uart4", "peri_uart5",
				"peri_uart6", "peri_uart7", "peri_gpsb0",
				"peri_gpsb1", "peri_gpsb2", "peri_gpsbms0",
				"peri_gpsbms1", "peri_gpsbms2", "peri_asrc0_input",
				"peri_asrc1_input", "peri_mflt0_cdif",
				"peri_asrc0_output", "peri_asrc1_output",
				"peri_mflt1_cdif", "peri_ic_tc", "peri_tsrx0",
				"peri_tsrx1", "peri_tsrx2", "peri_tsrx3",
				"peri_tsrx4", "peri_tsrx5", "peri_tsrx6",
				"peri_tsrx7", "peri_tsrx8", "peri_cb_wdt",
				"peri_out0", "peri_out1", "peri_out2", "peri_out3",
				"peri_out4", "peri_out5";
			telechips,clock-flags =
				<CLK_IGNORE_UNUSED>,	/* PERI_TCX */
				<CLK_IGNORE_UNUSED>,	/* PERI_TCT */
				<CLK_IGNORE_UNUSED>,	/* PERI_TCZ */
				<CLK_IGNORE_UNUSED>,	/* PERI_LCDTIMER */
				<CLK_IGNORE_UNUSED>,	/* PERI_LCD0 */
				<CLK_IGNORE_UNUSED>,	/* PERI_LCD1 */
				<CLK_IGNORE_UNUSED>,	/* PERI_HDMI_27MHZ */
				<CLK_IGNORE_UNUSED>,	/* PERI_HDMI_SPDIF */
				<CLK_IGNORE_UNUSED>,	/* PERI_HDMI_PHY */
				<CLK_IGNORE_UNUSED>,	/* PERI_HDMI_CEC */
				<CLK_IGNORE_UNUSED>,	/* PERI_HDMI_HDCP14 */
				<CLK_IGNORE_UNUSED>,	/* PERI_HDMI_HDCP22 */
				<CLK_IGNORE_UNUSED>,	/* PERI_SAR */
				<CLK_IGNORE_UNUSED>,	/* PERI_DEINTERLACER */
				<CLK_IGNORE_UNUSED>,	/* PERI_GMAC */
				<CLK_IGNORE_UNUSED>,	/* PERI_PCIE_PCS */
				<CLK_IGNORE_UNUSED>,	/* PERI_GMAC_PTP */
				<CLK_IGNORE_UNUSED>,	/* PERI_PCIE_AUX */
				<CLK_IGNORE_UNUSED>,	/* PERI_PCIE_REF_EXT */
				<CLK_IGNORE_UNUSED>,	/* PERI_PCIE_APB */
				<CLK_IGNORE_UNUSED>,	/* PERI_USB20H */
				<CLK_IGNORE_UNUSED>,	/* PERI_USB_OTG_ADP */
				<CLK_IGNORE_UNUSED>,	/* PERI_USB_OTG */
				<CLK_IGNORE_UNUSED>,	/* PERI_RMT */
				<CLK_IGNORE_UNUSED>,	/* PERI_SDMMC0 */
				<CLK_IGNORE_UNUSED>,	/* PERI_SDMMC1 */
				<CLK_IGNORE_UNUSED>,	/* PERI_SDMMC2 */
				<CLK_IGNORE_UNUSED>,	/* PERI_CEC1_CORE */
				<CLK_IGNORE_UNUSED>,	/* PERI_MDAI0 */
				<CLK_IGNORE_UNUSED>,	/* PERI_MFLT0_DAI */
				<CLK_IGNORE_UNUSED>,	/* PERI_MSPDIF0 */
				<CLK_IGNORE_UNUSED>,	/* PERI_MDAI1 */
				<CLK_IGNORE_UNUSED>,	/* PERI_MFLT1_DAI */
				<CLK_IGNORE_UNUSED>,	/* PERI_MSPDIF1 */
				<CLK_IGNORE_UNUSED>,	/* PERI_PDM */
				<CLK_IGNORE_UNUSED>,	/* PERI_CEC1_SFR */
				<CLK_IGNORE_UNUSED>,	/* PERI_TSADC */
				<CLK_IGNORE_UNUSED>,	/* PERI_I2C0 */
				<CLK_IGNORE_UNUSED>,	/* PERI_I2C1 */
				<CLK_IGNORE_UNUSED>,	/* PERI_I2C2 */
				<CLK_IGNORE_UNUSED>,	/* PERI_I2C3 */
				<CLK_IGNORE_UNUSED>,	/* PERI_UART0 */
				<CLK_IGNORE_UNUSED>,	/* PERI_UART1 */
				<CLK_IGNORE_UNUSED>,	/* PERI_UART2 */
				<CLK_IGNORE_UNUSED>,	/* PERI_UART3 */
				<CLK_IGNORE_UNUSED>,	/* PERI_UART4 */
				<CLK_IGNORE_UNUSED>,	/* PERI_UART5 */
				<CLK_IGNORE_UNUSED>,	/* PERI_UART6 */
				<CLK_IGNORE_UNUSED>,	/* PERI_UART7 */
				<CLK_IGNORE_UNUSED>,	/* PERI_GPSB0 */
				<CLK_IGNORE_UNUSED>,	/* PERI_GPSB1 */
				<CLK_IGNORE_UNUSED>,	/* PERI_GPSB2 */
				<CLK_IGNORE_UNUSED>,	/* PERI_GPSBMS0 */
				<CLK_IGNORE_UNUSED>,	/* PERI_GPSBMS1 */
				<CLK_IGNORE_UNUSED>,	/* PERI_GPSBMS2 */
				<CLK_IGNORE_UNUSED>,	/* PERI_ASRC0_INPUT */
				<CLK_IGNORE_UNUSED>,	/* PERI_ASRC1_INPUT */
				<CLK_IGNORE_UNUSED>,	/* PERI_MFLT0_CDIF */
				<CLK_IGNORE_UNUSED>,	/* PERI_ASRC0_OUTPUT */
				<CLK_IGNORE_UNUSED>,	/* PERI_ASRC1_OUTPUT */
				<CLK_IGNORE_UNUSED>,	/* PERI_MFLT1_CDIF */
				<CLK_IGNORE_UNUSED>,	/* PERI_IC_TC */
				<CLK_IGNORE_UNUSED>,	/* PERI_TSRX0 */
				<CLK_IGNORE_UNUSED>,	/* PERI_TSRX1 */
				<CLK_IGNORE_UNUSED>,	/* PERI_TSRX2 */
				<CLK_IGNORE_UNUSED>,	/* PERI_TSRX3 */
				<CLK_IGNORE_UNUSED>,	/* PERI_TSRX4 */
				<CLK_IGNORE_UNUSED>,	/* PERI_TSRX5 */
				<CLK_IGNORE_UNUSED>,	/* PERI_TSRX6 */
				<CLK_IGNORE_UNUSED>,	/* PERI_TSRX7 */
				<CLK_IGNORE_UNUSED>,	/* PERI_TSRX8 */
				<CLK_IGNORE_UNUSED>,	/* PERI_CB_WDT */
				<CLK_IGNORE_UNUSED>,	/* PERI_OUT0 */
				<CLK_IGNORE_UNUSED>,	/* PERI_OUT1 */
				<CLK_IGNORE_UNUSED>,	/* PERI_OUT2 */
				<CLK_IGNORE_UNUSED>,	/* PERI_OUT3 */
				<CLK_IGNORE_UNUSED>,	/* PERI_OUT4 */
				<CLK_IGNORE_UNUSED>;	/* PERI_OUT5 */
		};

		clk_io: clk@16051000 {
			compatible = "telechips,clk-iobus";
			#clock-cells = <1>;
			clocks = <&clk_fbus FBUS_IO>;
			clock-indices =
				<IOBUS_IC_TC>, <IOBUS_CEC1>, <IOBUS_DMA0>,
				<IOBUS_DMA1>, <IOBUS_DMA2>, <IOBUS_DMA>,
				<IOBUS_PWM>, <IOBUS_I2C_S2>, <IOBUS_REMOCON>,
				<IOBUS_TSADC>, <IOBUS_PRT>, <IOBUS_ADMA0>,
				<IOBUS_DAI0>, <IOBUS_SPDIF0>, <IOBUS_AUDIO0>,
				<IOBUS_ADMA1>, <IOBUS_DAI1>, <IOBUS_SPDIF1>,
				<IOBUS_AUDIO1>, <IOBUS_I2C_M0>, <IOBUS_I2C_M1>,
				<IOBUS_I2C_M2>, <IOBUS_I2C_M3>, <IOBUS_I2C_S0>,
				<IOBUS_I2C_S1>, <IOBUS_I2C0>, <IOBUS_I2C1>,
				<IOBUS_MUSTBE0_37>, <IOBUS_MUSTBE0_38>,
				<IOBUS_MUSTBE0_39>, <IOBUS_MUSTBE0_40>,
				<IOBUS_GPSB_2>, <IOBUS_GPSB0>, <IOBUS_GPSB1>,
				<IOBUS_GPSB2>, <IOBUS_GPSB3>, <IOBUS_GPSB4>,
				<IOBUS_GPSB5>, <IOBUS_GPSB>, <IOBUS_I2C_S3>,
				<IOBUS_I2C_M4>, <IOBUS_I2C_M5>, <IOBUS_I2C_M6>,
				<IOBUS_I2C_M7>, <IOBUS_UART0>, <IOBUS_UART1>,
				<IOBUS_UART2>, <IOBUS_UART3>, <IOBUS_UART4>,
				<IOBUS_UART5>, <IOBUS_UART6>, <IOBUS_UART7>,
				<IOBUS_SMARTCARD0>, <IOBUS_SMARTCARD1>,
				<IOBUS_SMARTCARD2>, <IOBUS_SMARTCARD3>,
				<IOBUS_SMARTCARD4>, <IOBUS_SMARTCARD5>,
				<IOBUS_SMARTCARD6>, <IOBUS_SMARTCARD7>, <IOBUS_UDMA0>,
				<IOBUS_UDMA1>, <IOBUS_UDMA2>, <IOBUS_UDMA3>,
				<IOBUS_UART_SMARTCARD0>,
				<IOBUS_UART_SMARTCARD1>, <IOBUS_GDMA1>,
				<IOBUS_CIPHER>, <IOBUS_SDMMC0>, <IOBUS_SDMMC1>,
				<IOBUS_SDMMC2>, <IOBUS_SDMMC>, <IOBUS_SMC>,
				<IOBUS_NFC>, <IOBUS_EDICFG>, <IOBUS_EDI>,
				<IOBUS_RTC>;
			clock-output-names =
				"iobus_ic_tc", "iobus_cec1", "iobus_dma0",
				"iobus_dma1", "iobus_dma2", "iobus_dma",
				"iobus_pwm", "iobus_i2c_s2", "iobus_remocon",
				"iobus_tsadc", "iobus_prt", "iobus_adma0",
				"iobus_dai0", "iobus_spdif0", "iobus_audio0",
				"iobus_adma1", "iobus_dai1", "iobus_spdif1",
				"iobus_audio1", "iobus_i2c_m0", "iobus_i2c_m1",
				"iobus_i2c_m2", "iobus_i2c_m3", "iobus_i2c_s0",
				"iobus_i2c_s1", "iobus_i2c0", "iobus_i2c1",
				"iobus_mustbe0_37", "iobus_mustbe0_38",
				"iobus_mustbe0_39", "iobus_mustbe0_40",
				"iobus_gpsb_2", "iobus_gpsb0", "iobus_gpsb1",
				"iobus_gpsb2", "iobus_gpsb3", "iobus_gpsb4",
				"iobus_gpsb5", "iobus_gpsb", "iobus_i2c_s3",
				"iobus_i2c_m4", "iobus_i2c_m5", "iobus_i2c_m6",
				"iobus_i2c_m7", "iobus_uart0", "iobus_uart1",
				"iobus_uart2", "iobus_uart3", "iobus_uart4",
				"iobus_uart5", "iobus_uart6", "iobus_uart7",
				"iobus_smartcard0", "iobus_smartcard1",
				"iobus_smartcard2", "iobus_smartcard3",
				"iobus_smartcard4", "iobus_smartcard5",
				"iobus_smartcard6", "iobus_smartcard7", "iobus_udma0",
				"iobus_udma1", "iobus_udma2", "iobus_udma3",
				"iobus_uart_smartcard0",
				"iobus_uart_smartcard1", "iobus_gdma1",
				"iobus_cipher", "iobus_sdmmc0", "iobus_sdmmc1",
				"iobus_sdmmc2", "iobus_sdmmc", "iobus_smc",
				"iobus_nfc", "iobus_edicfg", "iobus_edi",
				"iobus_rtc";
			telechips,clock-flags =
				<CLK_IGNORE_UNUSED>,	/* IOBUS_IC_TC */
				<CLK_IGNORE_UNUSED>,	/* IOBUS_CEC1 */
				<CLK_IGNORE_UNUSED>,	/* IOBUS_DMA0 */
				<CLK_IGNORE_UNUSED>,	/* IOBUS_DMA1 */
				<CLK_IGNORE_UNUSED>,	/* IOBUS_DMA2 */
				<CLK_IGNORE_UNUSED>,	/* IOBUS_DMA */
				<CLK_IGNORE_UNUSED>,	/* IOBUS_PWM */
				<CLK_IGNORE_UNUSED>,	/* IOBUS_I2C_S2 */
				<CLK_IGNORE_UNUSED>,	/* IOBUS_REMOCON */
				<CLK_IGNORE_UNUSED>,	/* IOBUS_TSADC */
				<CLK_IGNORE_UNUSED>,	/* IOBUS_PRT */
				<CLK_IGNORE_UNUSED>,	/* IOBUS_ADMA0 */
				<CLK_IGNORE_UNUSED>,	/* IOBUS_DAI0 */
				<CLK_IGNORE_UNUSED>,	/* IOBUS_SPDIF0 */
				<CLK_IGNORE_UNUSED>,	/* IOBUS_AUDIO0 */
				<CLK_IGNORE_UNUSED>,	/* IOBUS_ADMA1 */
				<CLK_IGNORE_UNUSED>,	/* IOBUS_DAI1 */
				<CLK_IGNORE_UNUSED>,	/* IOBUS_SPDIF1 */
				<CLK_IGNORE_UNUSED>,	/* IOBUS_AUDIO1 */
				<CLK_IGNORE_UNUSED>,	/* IOBUS_I2C_M0 */
				<CLK_IGNORE_UNUSED>,	/* IOBUS_I2C_M1 */
				<CLK_IGNORE_UNUSED>,	/* IOBUS_I2C_M2 */
				<CLK_IGNORE_UNUSED>,	/* IOBUS_I2C_M3 */
				<CLK_IGNORE_UNUSED>,	/* IOBUS_I2C_S0 */
				<CLK_IGNORE_UNUSED>,	/* IOBUS_I2C_S1 */
				<CLK_IGNORE_UNUSED>,	/* IOBUS_I2C0 */
				<CLK_IGNORE_UNUSED>,	/* IOBUS_I2C1 */
				<CLK_IGNORE_UNUSED>,	/* IOBUS_MUSTBE0_37 */
				<CLK_IGNORE_UNUSED>,	/* IOBUS_MUSTBE0_38 */
				<CLK_IGNORE_UNUSED>,	/* IOBUS_MUSTBE0_39 */
				<CLK_IGNORE_UNUSED>,	/* IOBUS_MUSTBE0_40 */
				<CLK_IGNORE_UNUSED>,	/* IOBUS_GPSB_2 */
				<CLK_IGNORE_UNUSED>,	/* IOBUS_GPSB0 */
				<CLK_IGNORE_UNUSED>,	/* IOBUS_GPSB1 */
				<CLK_IGNORE_UNUSED>,	/* IOBUS_GPSB2 */
				<CLK_IGNORE_UNUSED>,	/* IOBUS_GPSB3 */
				<CLK_IGNORE_UNUSED>,	/* IOBUS_GPSB4 */
				<CLK_IGNORE_UNUSED>,	/* IOBUS_GPSB5 */
				<CLK_IGNORE_UNUSED>,	/* IOBUS_GPSB */
				<CLK_IGNORE_UNUSED>,	/* IOBUS_I2C_S3 */
				<CLK_IGNORE_UNUSED>,	/* IOBUS_I2C_M4 */
				<CLK_IGNORE_UNUSED>,	/* IOBUS_I2C_M5 */
				<CLK_IGNORE_UNUSED>,	/* IOBUS_I2C_M6 */
				<CLK_IGNORE_UNUSED>,	/* IOBUS_I2C_M7 */
				<CLK_IGNORE_UNUSED>,	/* IOBUS_UART0 */
				<CLK_IGNORE_UNUSED>,	/* IOBUS_UART1 */
				<CLK_IGNORE_UNUSED>,	/* IOBUS_UART2 */
				<CLK_IGNORE_UNUSED>,	/* IOBUS_UART3 */
				<CLK_IGNORE_UNUSED>,	/* IOBUS_UART4 */
				<CLK_IGNORE_UNUSED>,	/* IOBUS_UART5 */
				<CLK_IGNORE_UNUSED>,	/* IOBUS_UART6 */
				<CLK_IGNORE_UNUSED>,	/* IOBUS_UART7 */
				<CLK_IGNORE_UNUSED>,	/* IOBUS_SMARTCARD0 */
				<CLK_IGNORE_UNUSED>,	/* IOBUS_SMARTCARD1 */
				<CLK_IGNORE_UNUSED>,	/* IOBUS_SMARTCARD2 */
				<CLK_IGNORE_UNUSED>,	/* IOBUS_SMARTCARD3 */
				<CLK_IGNORE_UNUSED>,	/* IOBUS_SMARTCARD4 */
				<CLK_IGNORE_UNUSED>,	/* IOBUS_SMARTCARD5 */
				<CLK_IGNORE_UNUSED>,	/* IOBUS_SMARTCARD6 */
				<CLK_IGNORE_UNUSED>,	/* IOBUS_SMARTCARD7 */
				<CLK_IGNORE_UNUSED>,	/* IOBUS_UDMA0 */
				<CLK_IGNORE_UNUSED>,	/* IOBUS_UDMA1 */
				<CLK_IGNORE_UNUSED>,	/* IOBUS_UDMA2 */
				<CLK_IGNORE_UNUSED>,	/* IOBUS_UDMA3 */
				<CLK_IGNORE_UNUSED>,	/* IOBUS_UART_SMARTCARD0 */
				<CLK_IGNORE_UNUSED>,	/* IOBUS_UART_SMARTCARD1 */
				<CLK_IGNORE_UNUSED>,	/* IOBUS_GDMA1 */
				<CLK_IGNORE_UNUSED>,	/* IOBUS_CIPHER */
				<CLK_IGNORE_UNUSED>,	/* IOBUS_SDMMC0 */
				<CLK_IGNORE_UNUSED>,	/* IOBUS_SDMMC1 */
				<CLK_IGNORE_UNUSED>,	/* IOBUS_SDMMC2 */
				<CLK_IGNORE_UNUSED>,	/* IOBUS_SDMMC */
				<CLK_IGNORE_UNUSED>,	/* IOBUS_SMC */
				<CLK_IGNORE_UNUSED>,	/* IOBUS_NFC */
				<CLK_IGNORE_UNUSED>,	/* IOBUS_EDICFG */
				<CLK_IGNORE_UNUSED>,	/* IOBUS_EDI */
				<CLK_IGNORE_UNUSED>;	/* IOBUS_RTC */
		};

		clk_hsio: clk@111a0000 {
			compatible = "telechips,clk-hsiobus";
			#clock-cells = <1>;
			clocks = <&clk_fbus FBUS_HSIO>;
			clock-indices =
				<HSIOBUS_GMAC>, <HSIOBUS_USB20H>,
				<HSIOBUS_CIPHER>, <HSIOBUS_DWC_OTG>,
				<HSIOBUS_SECURE_WRAP>, <HSIOBUS_TRNG>;
			clock-output-names =
				"hsiobus_gmac", "hsiobus_usb20h",
				"hsiobus_cipher", "hsiobus_dwc_otg",
				"hsiobus_secure_wrap", "hsiobus_trng";
			telechips,clock-flags =
				<CLK_IGNORE_UNUSED>,	/* HSIOBUS_GMAC */
				<CLK_IGNORE_UNUSED>,	/* HSIOBUS_USB20H */
				<CLK_IGNORE_UNUSED>,	/* HSIOBUS_CIPHER */
				<CLK_IGNORE_UNUSED>,	/* HSIOBUS_DWC_OTG */
				<CLK_IGNORE_UNUSED>,	/* HSIOBUS_SECURE_WRAP */
				<CLK_IGNORE_UNUSED>;	/* HSIOBUS_TRNG */
		};

		clk_ddi: clk@12380000 {
			compatible = "telechips,clk-ddibus";
			#clock-cells = <1>;
			clocks = <&clk_fbus FBUS_DDI>;
			clock-indices =
				<DDIBUS_VIOC>, <DDIBUS_NTSCPAL>, <DDIBUS_HDMI>,
				<DDIBUS_VIOCEX>, <DDIBUS_DOLBY>, <DDIBUS_SAR>,
				<DDIBUS_MADI>;
			clock-output-names =
				"ddibus_vioc", "ddibus_ntscpal", "ddibus_hdmi",
				"ddibus_viocex", "ddibus_dolby", "ddibus_sar",
				"ddibus_madi";
			telechips,clock-flags =
				<CLK_IS_CRITICAL>,	/* DDIBUS_VIOC */
				<0>,	/* DDIBUS_NTSCPAL */
				<CLK_IS_CRITICAL>,	/* DDIBUS_HDMI */
				<0>,	/* DDIBUS_VIOCEX */
				<0>,	/* DDIBUS_DOLBY */
				<0>,	/* DDIBUS_SAR */
				<0>;	/* DDIBUS_MADI */
		};

		clk_vpu: clk@15280000 {
			compatible = "telechips,clk-vpubus";
			#clock-cells = <1>;
			clocks = <&clk_fbus FBUS_VBUS>;
			clock-indices =
				<VIDEOBUS_JPEG>, <VIDEOBUS_BODA_BUS>,
				<VIDEOBUS_BODA_CORE>, <VIDEOBUS_HEVC_BUS>,
				<VIDEOBUS_HEVC_CORE>;
			clock-output-names =
				"videobus_jpeg", "videobus_boda_bus",
				"videobus_boda_core", "videobus_hevc_bus",
				"videobus_hevc_core";
			telechips,clock-flags =
				<CLK_SET_RATE_GATE>,	/* VIDEOBUS_JPEG */
				<CLK_SET_RATE_GATE>,	/* VIDEOBUS_BODA_BUS */
				<CLK_SET_RATE_GATE>,	/* VIDEOBUS_BODA_CORE */
				<CLK_SET_RATE_GATE>,	/* VIDEOBUS_HEVC_BUS */
				<CLK_SET_RATE_GATE>;	/* VIDEOBUS_HEVC_CORE */
		};

		clk_isoip_top: clk@14400074 {
			compatible = "telechips,clk-isoip_top";
			#clock-cells = <1>;
			clock-indices =
				<ISOIP_TOP_VLD>, <ISOIP_TOP_POR>,
				<ISOIP_TOP_ECID>, <ISOIP_TOP_OSC>,
				<ISOIP_TOP_TSADC>, <ISOIP_TOP_RTC>,
				<ISOIP_TOP_U30>, <ISOIP_TOP_U20H>,
				<ISOIP_TOP_OTG>, <ISOIP_TOP_PCIE>,
				<ISOIP_TOP_OTP>, <ISOIP_TOP_TSEN>,
				<ISOIP_TOP_DPLL>, <ISOIP_TOP_NPLL>,
				<ISOIP_TOP_MBPLL>, <ISOIP_TOP_DWC1>,
				<ISOIP_TOP_DWC0>;
			clock-output-names =
				"isoip_top_vld", "isoip_top_por",
				"isoip_top_ecid", "isoip_top_osc",
				"isoip_top_tsadc", "isoip_top_rtc",
				"isoip_top_u30", "isoip_top_u20h",
				"isoip_top_otg", "isoip_top_pcie",
				"isoip_top_otp", "isoip_top_tsen",
				"isoip_top_dpll", "isoip_top_npll",
				"isoip_top_mbpll", "isoip_top_dwc1",
				"isoip_top_dwc0";
			telechips,clock-flags =
				<CLK_IGNORE_UNUSED>,	/* ISOIP_TOP_VLD */
				<CLK_IGNORE_UNUSED>,	/* ISOIP_TOP_POR */
				<CLK_IGNORE_UNUSED>,	/* ISOIP_TOP_ECID */
				<CLK_IGNORE_UNUSED>,	/* ISOIP_TOP_OSC */
				<CLK_IGNORE_UNUSED>,	/* ISOIP_TOP_TSADC */
				<CLK_IGNORE_UNUSED>,	/* ISOIP_TOP_RTC */
				<CLK_IGNORE_UNUSED>,	/* ISOIP_TOP_U30 */
				<CLK_IGNORE_UNUSED>,	/* ISOIP_TOP_U20H */
				<CLK_IGNORE_UNUSED>,	/* ISOIP_TOP_OTG */
				<CLK_IGNORE_UNUSED>,	/* ISOIP_TOP_PCIE */
				<CLK_IGNORE_UNUSED>,	/* ISOIP_TOP_OTP */
				<CLK_IGNORE_UNUSED>,	/* ISOIP_TOP_TSEN */
				<CLK_IGNORE_UNUSED>,	/* ISOIP_TOP_DPLL */
				<CLK_IGNORE_UNUSED>,	/* ISOIP_TOP_NPLL */
				<CLK_IGNORE_UNUSED>,	/* ISOIP_TOP_MBPLL */
				<CLK_IGNORE_UNUSED>,	/* ISOIP_TOP_DWC1 */
				<CLK_IGNORE_UNUSED>;	/* ISOIP_TOP_DWC0 */
		};

		clk_isoip_ddi: clk@1440006c {
			compatible = "telechips,clk-isoip_ddi";
			#clock-cells = <1>;
			clock-indices =
				<ISOIP_DDB_HDMI>, <ISOIP_DDB_LVDS>,
				<ISOIP_DDB_VDAC>;
			clock-output-names =
				"isoip_ddb_hdmi", "isoip_ddb_lvds",
				"isoip_ddb_vdac";
			telechips,clock-flags =
				<CLK_IGNORE_UNUSED>,	/* ISOIP_DDB_HDMI */
				<CLK_IGNORE_UNUSED>,	/* ISOIP_DDB_LVDS */
				<CLK_IGNORE_UNUSED>;	/* ISOIP_DDB_VDAC */
		};
	};

	pinctrl: pinctrl@14200000 {
		compatible = "telechips,tcc899x-pinctrl";
		reg = <0x14200000 0x300>;
		#address-cells = <1>;
		#size-cells = <2>;
		interrupts = <GIC_SPI 0 0>,
				   <GIC_SPI 1 0>,
				   <GIC_SPI 2 0>,
				   <GIC_SPI 3 0>,
				   <GIC_SPI 4 0>,
				   <GIC_SPI 5 0>,
				   <GIC_SPI 6 0>,
				   <GIC_SPI 7 0>,
				   <GIC_SPI 8 0>,
				   <GIC_SPI 9 0>,
				   <GIC_SPI 10 0>,
				   <GIC_SPI 11 0>,
				   <GIC_SPI 12 0>,
				   <GIC_SPI 13 0>,
				   <GIC_SPI 14 0>,
				   <GIC_SPI 15 0>,
				   <GIC_SPI 16 0>,
				   <GIC_SPI 17 0>,
				   <GIC_SPI 18 0>,
				   <GIC_SPI 19 0>,
				   <GIC_SPI 20 0>,
				   <GIC_SPI 21 0>,
				   <GIC_SPI 22 0>,
				   <GIC_SPI 23 0>,
				   <GIC_SPI 24 0>,
				   <GIC_SPI 25 0>,
				   <GIC_SPI 26 0>,
				   <GIC_SPI 27 0>,
				   <GIC_SPI 28 0>,
				   <GIC_SPI 29 0>,
				   <GIC_SPI 30 0>,
				   <GIC_SPI 31 0>;
	};

	cmbox: mbox@19000000 {
		compatible = "telechips,mailbox";
		reg = <0x19000000 0x100>;
		interrupts = <GIC_SPI 43 IRQ_TYPE_LEVEL_LOW>;
		#mbox-cells = <1>;
	};

	mbox: mbox@17b00000 {
		compatible = "telechips,mailbox";
		reg = <0x17b00000 0x100>;
		interrupts = <GIC_SPI 184 IRQ_TYPE_LEVEL_HIGH>;
		#mbox-cells = <1>;
	};

	dma0: dma@16020000 {
		compatible = "telechips,tcc899x-dma";
		reg = <0x16020000 0x94 0x1605101C 0x4>;
		interrupts = <GIC_SPI 51 IRQ_TYPE_LEVEL_HIGH>;
		#dma-cells = <2>;
		dma-channels = <3>;
		dma-requests = <32>;
		channel-priority = <0>;
		clocks = <&clk_io IOBUS_DMA0>;
		clock-names = "dmac0";
	};

	dma1: dma@16020100 {
		compatible = "telechips,tcc899x-dma";
		reg = <0x16020100 0x94 0x16051020 0x4>;
		interrupts = <GIC_SPI 52 IRQ_TYPE_LEVEL_HIGH>;
		#dma-cells = <2>;
		dma-channels = <3>;
		dma-requests = <32>;
		channel-priority = <0>;
		clocks = <&clk_io IOBUS_DMA1>;
		clock-names = "dmac1";
	};

	dma2: dma@16020200 {
		compatible = "telechips,tcc899x-dma";
		reg = <0x16020200 0x94 0x16051024 0x4>;
		interrupts = <GIC_SPI 53 IRQ_TYPE_LEVEL_HIGH>;
		#dma-cells = <2>;
		dma-channels = <3>;
		dma-requests = <32>;
		channel-priority = <0>;
		clocks = <&clk_io IOBUS_DMA2>;
		clock-names = "dmac2";
	};

	dma3: dma@16490000 {
		compatible = "telechips,tcc899x-dma";
		reg = <0x16490000 0x94>;
		interrupts = <GIC_SPI 54 IRQ_TYPE_LEVEL_HIGH>;
		#dma-cells = <2>;
		dma-channels = <3>;
		dma-requests = <32>;
		channel-priority = <0>;
		clocks = <&clk_io IOBUS_DMA>;
		clock-names = "dmac3";
	};

	udma0: udma@16680000 {
		compatible = "arm,pl081", "arm,primecell";
		reg = <0x16680000 0x1000>;
		interrupts = <GIC_SPI 84 IRQ_TYPE_LEVEL_HIGH>;
		//dma-channels = <2>;
		//dma-requests = <32>;
		channel-priority = <0>;
		clocks = <&clk_io IOBUS_UDMA0>;
		clock-names = "apb_pclk";
		lli-bus-interface-ahb1;
		lli-bus-interface-ahb2;
		mem-bus-interface-ahb2;
		memcpy-burst-size = <256>;
		memcpy-bus-width = <32>;
		#dma-cells = <2>;
	};

	udma1: udma@16681000 {
		compatible = "arm,pl081", "arm,primecell";
		reg = <0x16681000 0x1000>;
		interrupts = <GIC_SPI 85 IRQ_TYPE_LEVEL_HIGH>;
		//dma-channels = <2>;
		//dma-requests = <32>;
		channel-priority = <0>;
		clocks = <&clk_io IOBUS_UDMA1>;
		clock-names = "apb_pclk";
		lli-bus-interface-ahb1;
		lli-bus-interface-ahb2;
		mem-bus-interface-ahb2;
		memcpy-burst-size = <256>;
		memcpy-bus-width = <32>;
		#dma-cells = <2>;
	};

	udma2: udma@16682000 {
		compatible = "arm,pl081", "arm,primecell";
		reg = <0x16682000 0x1000>;
		interrupts = <GIC_SPI 86 IRQ_TYPE_LEVEL_HIGH>;
		//dma-channels = <2>;
		//dma-requests = <32>;
		channel-priority = <0>;
		clocks = <&clk_io IOBUS_UDMA2>;
		clock-names = "apb_pclk";
		lli-bus-interface-ahb1;
		lli-bus-interface-ahb2;
		mem-bus-interface-ahb2;
		memcpy-burst-size = <256>;
		memcpy-bus-width = <32>;
		#dma-cells = <2>;
	};

	udma3: udma@16683000 {
		compatible = "arm,pl081", "arm,primecell";
		reg = <0x16683000 0x1000>;
		interrupts = <GIC_SPI 87 IRQ_TYPE_LEVEL_HIGH>;
		//dma-channels = <2>;
		//dma-requests = <32>;
		channel-priority = <0>;
		clocks = <&clk_io IOBUS_UDMA3>;
		clock-names = "apb_pclk";
		lli-bus-interface-ahb1;
		lli-bus-interface-ahb2;
		mem-bus-interface-ahb2;
		memcpy-burst-size = <256>;
		memcpy-bus-width = <32>;
		#dma-cells = <2>;
	};

	timer@14300080 {
		compatible = "telechips,timer32";
		reg = <0x14300080 0x1c>;
		interrupts = <GIC_SPI 32 IRQ_TYPE_NONE>;
		clocks = <&clk_peri PERI_TCZ>;
	};

	tcc_timer: timer@14300000 { /* tc0~tc5 */
		compatible = "telechips,timer";
		reg = <0x14300000 0xa0>;
		interrupts = <GIC_SPI 33 0>,
			     <GIC_SPI 34 0>,
			     <GIC_SPI 35 0>,
			     <GIC_SPI 36 0>,
			     <GIC_SPI 37 0>,
			     <GIC_SPI 38 0>;
		clocks = <&clk_peri PERI_TCT>;
		clock-frequency = <12000000>;
	};

	watchdog@144000C8 {
		compatible = "telechips,wdt";
		reg = <0x144000C8 0x4>, /* wdt_ctrl */
		      <0x144000CC 0x4>, /* wdt_cnt */
		      <0x144000D4 0x4>, /* wdt_clear */
		      <0x14300070 0xC>, /* wdt_timer */
		      <0x14300060 0x4>; /* wdt_int_sts */
		clocks = <&clk_peri PERI_TCX &clk_peri PERI_TCT>;
		clock-frequency = <24000000>;
		interrupts = <GIC_SPI 39 0>;
		int-offset = <6>;
		clear-bit = <0>;

		have-rstcnt-reg;	/* indicates separated reset count register later TCC899x */
		/* status = "disabled"; */
	};

	reboot-mode {
		compatible = "telechips,reboot-mode";
		mode-normal = <BOOT_NORMAL>;
		mode-bootloader = <BOOT_FASTBOOT>;
		mode-recovery = <BOOT_RECOVERY>;
	};

	ictc:ictc@0x16055000 {
		compatible = "telechips,ictc";
		reg = <0x16055000 0x4 0x16055004 0x4 0x16055008 0x4>;
		interrupt = <GIC_SPI 75 0>;
		f_in_sel = <15>;
		status = "disabled";
	};

	i2c0: i2c@16300000 {
		compatible = "telechips,tcc899x-i2c";
		reg = <0x16300000 0x1c 0x163C0000 0x10>;
		interrupts = <GIC_SPI 61 IRQ_TYPE_LEVEL_HIGH>;
		#address-cells = <1>;
		#size-cells = <0>;
		clocks = <&clk_peri PERI_I2C0 &clk_io IOBUS_I2C_M0>;
		clock-frequency = <400000>;
		port-mux = <0xFF>;	/* default value */
		status = "disabled";
		interrupt_mode = <0>;
	};

	i2c1: i2c@16310000 {
		compatible = "telechips,tcc899x-i2c";
		reg = <0x16310000 0x1c 0x163C0000 0x10>;
		interrupts = <GIC_SPI 62 IRQ_TYPE_LEVEL_HIGH>;
		#address-cells = <1>;
		#size-cells = <0>;
		clocks = <&clk_peri PERI_I2C1 &clk_io IOBUS_I2C_M1>;
		clock-frequency = <400000>;
		port-mux = <0xFF>;	/* default value */
		status = "disabled";
		interrupt_mode = <0>;
	};

	i2c2: i2c@16320000 {
		compatible = "telechips,tcc899x-i2c";
		reg = <0x16320000 0x1c 0x163C0000 0x10>;
		interrupts = <GIC_SPI 63 IRQ_TYPE_LEVEL_HIGH>;
		#address-cells = <1>;
		#size-cells = <0>;
		clocks = <&clk_peri PERI_I2C2 &clk_io IOBUS_I2C_M2>;
		clock-frequency = <400000>;
		port-mux = <0xFF>;	/* default value */
		status = "disabled";
		interrupt_mode = <0>;
	};

	i2c3: i2c@16330000 {
		compatible = "telechips,tcc899x-i2c";
		reg = <0x16330000 0x1c 0x163C0000 0x10>;
		interrupts = <GIC_SPI 64 IRQ_TYPE_LEVEL_HIGH>;
		#address-cells = <1>;
		#size-cells = <0>;
		clocks = <&clk_peri PERI_I2C3 &clk_io IOBUS_I2C_M3>;
		/*Set HDMI I2C frequency to 80Khz*/
		clock-frequency = <80000>;
		port-mux = <0xFF>;	/* default value */
		status = "disabled";
		interrupt_mode = <0>;
	};

	gpsb0: gpsb0@16900000 {
		compatible = "telechips,tcc899x-spi";
		reg = <0x16900000 0x38 0x16960000 0x20 0x16970000 0x84>;
		interrupts = <GIC_SPI 55 IRQ_TYPE_LEVEL_HIGH>;
		clocks = <&clk_peri PERI_GPSB0 &clk_io IOBUS_GPSB0>;
		gpsb-id = <0>;
		status = "disabled";
	};

	gpsb1: gpsb1@16910000 {
		compatible = "telechips,tcc899x-tsif";
		reg = <0x16910000 0x38 0x16960000 0x20 0x16970000 0x84>;
		interrupts = <GIC_SPI 56 IRQ_TYPE_LEVEL_HIGH>;
		clocks = <&clk_peri PERI_GPSB1 &clk_io IOBUS_GPSB1>;
		gpsb-id = <0>;
		status = "disabled";
	};

	gpsb2: gpsb2@16920000 {
		compatible = "telechips,tcc899x-tsif";
		reg = <0x16920000 0x38 0x16960000 0x20 0x16970000 0x84>;
		interrupts = <GIC_SPI 57 IRQ_TYPE_LEVEL_HIGH>;
		clocks = <&clk_peri PERI_GPSB2 &clk_io IOBUS_GPSB2>;
		gpsb-id = <1>;
		status = "disabled";
	};

	gpsb3: gpsb3@16930000 {
		compatible = "telechips,tcc899x-spi";
		reg = <0x16930000 0x38 0x16960000 0x20 0x16970000 0x84>;
		interrupts = <GIC_SPI 58 IRQ_TYPE_LEVEL_HIGH>;
		clocks = <&clk_peri PERI_GPSBMS0 &clk_io IOBUS_GPSB3>;
		gpsb-id = <1>;
		status = "disabled";

		// With DMA-engine
		// dmas = <&dma0 0 3 &dma0 1 9>;
		// dma-names = "tx", "rx";
	};

	gpsb4: gpsb4@16940000 {
		compatible = "telechips,tcc899x-tsif";
		reg = <0x16940000 0x38 0x16960000 0x20 0x16970000 0x84>;
		interrupts = <GIC_SPI 59 IRQ_TYPE_LEVEL_HIGH>;
		clocks = <&clk_peri PERI_GPSBMS1 &clk_io IOBUS_GPSB4>;
		gpsb-id = <2>;
		status = "disabled";

		// With DMA-engine
		// dmas = <&dma? ? 4 &dma? ? 10>;
		// dma-names = "tx", "rx";
	};

	gpsb5: gpsb5@16950000 {
		compatible = "telechips,tcc899x-tsif";
		reg = <0x16950000 0x38 0x16960000 0x20 0x16970000 0x84>;
		interrupts = <GIC_SPI 60 IRQ_TYPE_LEVEL_HIGH>;
		clocks = <&clk_peri PERI_GPSBMS2 &clk_io IOBUS_GPSB5>;
		gpsb-id = <3>;
		status = "disabled";

		// With DMA-engine
		// dmas = <&dma? ? 5 &dma? ? 11>;
		// dma-names = "tx", "rx";
	};

	tcc_hwdmx_tsif0: tcc_hwdmx_tsif@0 {
		clocks = <&clk_peri PERI_TSRX0>;
		clock-names = "tsrx0";
	};

	tcc_hwdmx_tsif1: tcc_hwdmx_tsif@1 {
		clocks = <&clk_peri PERI_TSRX1>;
		clock-names = "tsrx1";
	};

	tcc_dxb_ctrl: tcc_dxb_ctrl {};

	tcc_isdbt_ctrl: tcc_isdbt_ctrl{};

	/* Deprecated */
	tcc_ex_tsif0: tcc_ex_tsif@0 {};

	/* Deprecated */
	tcc_ex_tsif1: tcc_ex_tsif@1 {};

	/* Deprecated */
	tcc_dxb_drv0: tcc_dxb_drv@0 {};

	/* Deprecated */
	tcc_dxb_drv1: tcc_dxb_drv@1 {};

	/* Deprecated */
	tcc_dxb_internal: tcc_dxb_internal {};

	si_power: si_power {};
	avl62x1_power: avl62x1_power {};
	mxl532c_power: mxl532c_power {};

	adma0: adma@16100000 {
		compatible = "telechips,adma";
		reg = <0x16100000 0x200>;
		clocks = <&clk_io IOBUS_ADMA0>;
		interrupts = <GIC_SPI 80 IRQ_TYPE_LEVEL_HIGH>;
		have-hopcnt-clear = <1>;
		adrcnt-mode = <1>;
	};

	adma1: adma@16200000 {
		compatible = "telechips,adma";
		reg = <0x16200000 0x200>;
		clocks = <&clk_io IOBUS_ADMA1>;
		interrupts = <GIC_SPI 82 IRQ_TYPE_LEVEL_HIGH>;
		have-hopcnt-clear = <1>;
		adrcnt-mode = <1>;
	};

	i2s0: i2s@16101000 {
		compatible = "telechips,i2s";
		reg = <0x16101000 0x50 0x16100080 0x8>;
		clocks = <&clk_peri PERI_MDAI0 &clk_io IOBUS_DAI0 &clk_peri PERI_MFLT0_DAI>;
		clock-frequency = <32000>; //HDMI initial clock base 32kHz
		interrupts = <GIC_SPI 81 IRQ_TYPE_LEVEL_HIGH>;
		have-fifo-clear=<1>;
		block-type = <1>;  //1: 7.1CH
		adma = <&adma0>;
		status = "disabled";
	};

	i2s1: i2s@16201000 {
		compatible = "telechips,i2s";
		reg = <0x16201000 0x50 0x16200080 0x8>;
		clocks = <&clk_peri PERI_MDAI1 &clk_io IOBUS_DAI1 &clk_peri PERI_MFLT1_DAI>;
		clock-frequency = <32000>; //HDMI initial clock base 32kHz
		interrupts = <GIC_SPI 83 IRQ_TYPE_LEVEL_HIGH>;
		adma = <&adma1>;
		have-fifo-clear=<1>;
		block-type = <2>; //1: 9.1CH
		status = "disabled";
	};

	cdif0: cdif@16101080 {
		compatible = "telechips,cdif";
		reg = <0x16101080 0x20 0x16101000 0x50>;
		clocks = <&clk_peri PERI_MDAI0 &clk_io IOBUS_DAI0 &clk_peri PERI_MFLT0_CDIF>;
		clock-frequency = <11289600>;	// 44100*256
		status = "disabled";
	};

	cdif1: cdif@16201080 {
		compatible = "telechips,cdif";
		reg = <0x16201080 0x20 0x16201000 0x50>;
		clocks = <&clk_peri PERI_MDAI1 &clk_io IOBUS_DAI1 &clk_peri PERI_MFLT1_CDIF>;
		clock-frequency = <11289600>;	// 44100*256
		status = "disabled";
	};

	spdif0: spdif@16102000 {
		compatible = "telechips,spdif";
		reg = <0x16102000 0x1000>;
		clocks = <&clk_peri PERI_MSPDIF0 &clk_io IOBUS_SPDIF0>;
		clock-frequency = <44100>;
		adma = <&adma0>;
		status = "disabled";
	};

	spdif1: spdif@16202000 {
		compatible = "telechips,spdif";
		reg = <0x16202000 0x1000>;
		clocks = <&clk_peri PERI_MSPDIF1 &clk_io IOBUS_SPDIF1>;
		clock-frequency = <44100>;
		adma = <&adma1>;
		status = "disabled";
	};

	audio_chmux: audio_chmux@16051000{
		compatible = "telechips,audio-chmux-899x";
		reg = <0x16051000 0x78>;
		dai = <0 0>; // i2s0(x) i2s1(x)
		cdif = <0 0>; // cdif0(x) cdif1(x)
		spdif = <0 0>; // spdif0(x) spdif1(x)
		status = "disabled";
	};

	uart0: serial@16600000 {
		compatible = "arm,pl011", "arm,primecell";
		reg = <0x16600000 0x1000>;
		arm,primecell-periphid = <0x001feff7>;
	    interrupts = <GIC_SPI 88 IRQ_TYPE_LEVEL_HIGH>;
		clocks = <&clk_peri PERI_UART0>, <&clk_io IOBUS_UART0>;
		clock-names = "uartclk", "apb_pclk";
		status = "disabled";
	};

	uart1: serial@16610000 {
		compatible = "arm,pl011", "arm,primecell";
		reg = <0x16610000 0x1000>;
		arm,primecell-periphid = <0x001feff7>;
	    interrupts = <GIC_SPI 89 IRQ_TYPE_LEVEL_HIGH>;
		clocks = <&clk_peri PERI_UART1>, <&clk_io IOBUS_UART1>;
		clock-names = "uartclk", "apb_pclk";
		status = "disabled";
	};

	uart2: serial@16620000 {
		compatible = "arm,pl011", "arm,primecell";
		reg = <0x16620000 0x1000>;
		arm,primecell-periphid = <0x001feff7>;
	    interrupts = <GIC_SPI 90 IRQ_TYPE_LEVEL_HIGH>;
		clocks = <&clk_peri PERI_UART2>, <&clk_io IOBUS_UART2>;
		clock-names = "uartclk", "apb_pclk";
		status = "disabled";
	};

	uart3: serial@16630000 {
		compatible = "arm,pl011", "arm,primecell";
		reg = <0x16630000 0x1000>;
		arm,primecell-periphid = <0x001feff7>;
	    interrupts = <GIC_SPI 91 IRQ_TYPE_LEVEL_HIGH>;
		clocks = <&clk_peri PERI_UART3>, <&clk_io IOBUS_UART3>;
		clock-names = "uartclk", "apb_pclk";
		status = "disabled";
	};

	uart4: serial@16640000 {
		compatible = "arm,pl011", "arm,primecell";
		reg = <0x16640000 0x1000>;
		arm,primecell-periphid = <0x001feff7>;
	    interrupts = <GIC_SPI 92 IRQ_TYPE_LEVEL_HIGH>;
		clocks = <&clk_peri PERI_UART4>, <&clk_io IOBUS_UART4>;
		clock-names = "uartclk", "apb_pclk";
		status = "disabled";
	};

	uart5: serial@16650000 {
		compatible = "arm,pl011", "arm,primecell";
		reg = <0x16650000 0x1000>;
		arm,primecell-periphid = <0x001feff7>;
	    interrupts = <GIC_SPI 93 IRQ_TYPE_LEVEL_HIGH>;
		clocks = <&clk_peri PERI_UART5>, <&clk_io IOBUS_UART5>;
		clock-names = "uartclk", "apb_pclk";
		status = "disabled";
	};

	uart6: serial@16660000 {
		compatible = "arm,pl011", "arm,primecell";
		reg = <0x16660000 0x1000>;
		arm,primecell-periphid = <0x001feff7>;
	    interrupts = <GIC_SPI 94 IRQ_TYPE_LEVEL_HIGH>;
		clocks = <&clk_peri PERI_UART6>, <&clk_io IOBUS_UART6>;
		clock-names = "uartclk", "apb_pclk";
		status = "disabled";
	};

	uart7: serial@16670000 {
		compatible = "arm,pl011", "arm,primecell";
		reg = <0x16670000 0x1000>;
		arm,primecell-periphid = <0x001feff7>;
	    interrupts = <GIC_SPI 95 IRQ_TYPE_LEVEL_HIGH>;
		clocks = <&clk_peri PERI_UART7>, <&clk_io IOBUS_UART7>;
		clock-names = "uartclk", "apb_pclk";
		status = "disabled";
	};

	/*
	 * HSIO Bus Block
	 */

	dwc3_phy: dwc3_phy@11D90000 {
        compatible = "telechips,tcc_dwc3_phy";
        reg = <0x11D90000 0x48>;
        clocks = <&clk_isoip_top ISOIP_TOP_U30>;
        status = "disabled";
    };

	dwc3: dwc3_platform {
        compatible = "telechips,tcc-dwc3";
        clocks = <&clk_fbus FBUS_HSIO>;
        telechips,dwc3_phy = <&dwc3_phy>;
        #address-cells = <1>;
        #size-cells = <1>;
        ranges;
		status = "disabled";

        dwc3 {
            compatible = "snps,dwc3";
            reg = <0x11B00000 0xCFFF>;
            interrupts = <GIC_SPI 152 IRQ_TYPE_LEVEL_HIGH>;
            telechips,dwc3_phy = <&dwc3_phy>;
        };
    };

	trng@11DB0100 {
		compatible = "telechips,tcc-rng";
		status = "okay";
	};

	ehci_phy: ehci_phy@11DA0010 {
		 compatible = "telechips,tcc_ehci_phy";
		 reg = <0x11DA0010 0x30>;
		 /* otg_hclk=0xe0+0, otg_phy=0x10+9*/
		 clocks = <&clk_hsio HSIOBUS_USB20H &clk_isoip_top ISOIP_TOP_U20H>;
		resets = <&hsiobus_rst HSIOBUS_USB20H>;
		 status = "disabled";
	 };

	ehci: ehci@11A00000 {
		compatible = "telechips,tcc-ehci";
		reg = <0x11A00000 0x108 0x11DA0010 0x54>;
		interrupts = <GIC_SPI 142 IRQ_TYPE_LEVEL_HIGH>;
		clocks = <&clk_hsio HSIOBUS_USB20H &clk_isoip_top ISOIP_TOP_U20H>;
		telechips,ehci_phy = <&ehci_phy>;
		status = "disabled";
		tpl-support;   // Support TPL
	};

	ohci: ohci@11A80000 {
		compatible = "telechips,tcc-ohci";
		reg = <0x11A80000 0x60 0x11DA0010 0x54>;
		interrupts = <GIC_SPI 142 IRQ_TYPE_LEVEL_HIGH>;
		clocks = <&clk_hsio HSIOBUS_USB20H &clk_isoip_top ISOIP_TOP_U20H>;
		status = "disabled";
		tpl-support;   // Support TPL
	};

	dwc_otg_phy: dwc_otg_phy@11DA0100 {
		 compatible = "telechips,tcc_dwc_otg_phy";
		 reg = <0x11DA0100 0x30>;
		 /* otg_hclk=0xe0+0, otg_phy=0x10+9*/
		 clocks = <&clk_hsio HSIOBUS_DWC_OTG &clk_isoip_top ISOIP_TOP_OTG>;
		resets = <&hsiobus_rst HSIOBUS_DWC_OTG>;
		 status = "disabled";
	};

	mhst_phy: mux_host_phy@11DA00DC {
		 compatible = "telechips,tcc_ehci_phy";
		 reg = <0x11DA00DC 0x20>;
		 /* otg_hclk=0xe0+0, otg_phy=0x10+9*/
		 clocks = <&clk_hsio HSIOBUS_DWC_OTG &clk_isoip_top ISOIP_TOP_OTG>;
		resets = <&hsiobus_rst HSIOBUS_DWC_OTG>;
		 mux_port;
		 status = "disabled";
	};

	dwc_otg: dwc_otg@11980000 {
		compatible = "telechips,dwc2";
		reg = <0x11980000 0xcfff 0x11900000 0x108 0x11940000 0x60>;
		interrupts = <GIC_SPI 145 IRQ_TYPE_LEVEL_HIGH>, <GIC_SPI 147 IRQ_TYPE_LEVEL_HIGH>;
		clocks = <&clk_hsio HSIOBUS_DWC_OTG>;
		clock-names = "otg";
		phy = <&dwc_otg_phy>;
		phy-names = "usb2-phy";
		telechips,mhst_phy = <&mhst_phy>;
		status= "disabled";
	};

	tcc_cipher@111C0000 {
		compatible = "telechips,tcc-cipher";
		reg = <0x111C0000 0x1E0 0x14100000 0x10C>;      //HSIO_Cipher , VPIC(VECTORED PRIORITY INTERRUPT CONTROLLER)
		interrupts = <GIC_SPI 45 IRQ_TYPE_LEVEL_HIGH>;
		clocks = <&clk_hsio HSIOBUS_CIPHER>;    //HSIOBUS_CIPHER
		status = "disabled";
	};


	pcie: pcie@11800000 {
		compatible = "telechips,pcie", "snps,dw-pcie";
		reg = <0x11800000 0x1000
		       0x11880000 0x1000
		       0x118a0000 0x1000
		       0x11700000 0x100000>;
		reg-names = "dbi", "phy", "cfg", "config";
		interrupts = <GIC_SPI 138 IRQ_TYPE_LEVEL_HIGH>;
		clocks = <&clk_peri PERI_PCIE_AUX>, <&clk_peri PERI_PCIE_APB>, <&clk_peri PERI_PCIE_PCS>, <&clk_peri PERI_PCIE_REF_EXT>,
			 <&clk_fbus FBUS_HSIO>, <&clk_isoip_top ISOIP_TOP_PCIE>;
		clock-names = "pcie_aux", "pcie_apb", "pcie_pcs" ,"pcie_ref_ext", "fbus_hsio", "pcie_phy";
		resets = <&pmu_rst RESET_PCIE>;
		#address-cells = <3>;
		#size-cells = <2>;
		device_type = "pci";
		ranges = <0x81000000 0 0          0x11600000 0 0x00100000   /* downstream I/O */
			  0x82000000 0 0x00000000 0x11000000 0 0x00600000>;   /* non-prefetchable memory */
		//ranges = <0x82000000 0 0x00000000 0x11000000 0 0x00600000>;   /* non-prefetchable memory */
		#interrupt-cells = <1>;
		interrupt-map-mask = <0 0 0 0>;
		interrupt-map = <0 0 0 0 &gic GIC_SPI 138 IRQ_TYPE_LEVEL_HIGH>;
		num-lanes = <1>;
		num-viewport = <4>;
		using_ext_ref_clk = <1>;
		for_si_test = <0>;

		status = "disabled";
	};


	/*
	 * Graphic Bus Block
	 */
	gpu: gpu@0x10100000 {
		compatible = "arm,malit602", "arm,malit60x", "arm,malit6xx", "arm,mali-midgard";
		reg = <0x10100000 0x4000>;
		interrupts = <GIC_SPI 124 IRQ_TYPE_LEVEL_HIGH>,
		             <GIC_SPI 125 IRQ_TYPE_LEVEL_HIGH>,
		             <GIC_SPI 126 IRQ_TYPE_LEVEL_HIGH>;
		interrupt-names = "JOB", "MMU", "GPU";
		clocks = <&clk_fbus FBUS_GPU>;
		clock-names = "mali_clk";
	};

	gpu_opp_table: opp_table0 {
		compatible = "operating-points-v2", "operating-points-v2-mali";
	};

	telechips,ion {
		compatible = "telechips,tcc-ion";
		#address-cells = <1>;
		#size-cells = <0>;
/*
		ion-heap@0 {
			reg = <0>;
			telechips,ion-heap-name = "ion_noncontig_heap";
		};

		ion-heap@1 {
			reg = <1>;
			telechips,ion-heap-name = "ion_contig_heap";
		};
*/
		ion-heap@2 {
			reg = <2>;
			telechips,ion-heap-name = "ion_carveout_heap";
		};
	};

	overlaymixer:overlaymixer@1A100000 {
	/*	compatible = "vivante.gc";
		reg = <0x1A100000 0x1000>;
		interrupts = <GIC_SPI 95 IRQ_TYPE_LEVEL_HIGH>;
		clocks =<&clk_fbus FBUS_G2D>;
		status ="disabled";
	*/
	};

	cifport: cifport@1238000c {
		compatible = "telechips,cif-port";
		reg = <0x1238000c 0x4>;
		status = "disabled";
	};

	lvds@12380040 {
		compatible = "telechips,lvds_phy";
		reg = <0x12380040 0x64>;
		clocks = <&clk_isoip_ddi ISOIP_DDB_LVDS>;
		statue = "disable";
	};

	/*
	 * Display Bus Block
	 */
	vioc_config:vioc_config@1200a000{
		compatible = "telechips,vioc_config";
		reg = <0x1200a000 0x1000>;
		status = "disabled";
	};

	vioc_intr:vioc_intr@1200a400{
		compatible = "telechips,vioc_intr";
		interrupts = <GIC_SPI VIOC0_IRQI IRQ_TYPE_LEVEL_HIGH>,
			     <GIC_SPI VIOC1_IRQI IRQ_TYPE_LEVEL_HIGH>,
			     <GIC_SPI VIOC2_IRQI IRQ_TYPE_LEVEL_HIGH>,
			     <GIC_SPI VIOC3_IRQI IRQ_TYPE_LEVEL_HIGH>;
		status = "disabled";
	};

	vioc_vin_demux:vioc_vin_demux@1200a800{
		compatible = "telechips,vioc_vin_demux";
		reg = <0x1200a800 0x1000>;
		status = "disabled";
	};

	ddi_config:ddi_config@12380000 {
		compatible = "telechips,ddi_config";
		reg = <0x12380000 0x70>;
		status = "disabled";
	};

	ddi_nexguard:ddi_nexguard@124C0000 {
		compatible = "telechips,ddi_nexguard";
		reg = <0x124C0000 0x40>;
		status = "disabled";
	};

	output_config: output_config@12100200 {
		compatible = "telechips,output_config";
		reg = <0x12100200 0x10>;
		status = "disabled";
	};

	vioc_disp:vioc_disp@12000000{
		compatible = "telechips,vioc_disp";
		reg = <0x12000000 0x100 0x12000100 0x100>;
		interrupts = <GIC_SPI VIOC0_IRQI IRQ_TYPE_LEVEL_HIGH>, <GIC_SPI VIOC1_IRQI IRQ_TYPE_LEVEL_HIGH>;
		clocks = <&clk_ddi DDIBUS_VIOC>, <&clk_peri PERI_LCD0>, <&clk_peri PERI_LCD1>;
		clock-names = "ddi-clk", "disp0-clk", "disp1-clk";
		status = "disabled";
	};

	vioc_display0:vioc_display0@12000000{
		compatible = "telechips,vioc_display0";
		reg = <0x12000000 0x100>;
		interrupts = <GIC_SPI VIOC0_IRQI IRQ_TYPE_LEVEL_HIGH>;
		clocks = <&clk_ddi DDIBUS_VIOC &clk_peri PERI_LCD0>;
		disp_number = <0>;
	};

	vioc_display1:vioc_display1@12000000{
		compatible = "telechips,vioc_display1";
		reg = <0x12000100 0x100>;
		interrupts = <GIC_SPI VIOC1_IRQI IRQ_TYPE_LEVEL_HIGH>;
		clocks = <&clk_ddi DDIBUS_VIOC &clk_peri PERI_LCD1>;
		disp_number = <1>;
	};

	vioc_rdma:vioc_rdma@12000400{
		compatible = "telechips,vioc_rdma";
		status = "disabled";
		reg = <0x12000400 0x100 0x12000500 0x100 0x12000600 0x100 0x12000700 0x100
				0x12000800 0x100 0x12000900 0x100 0x12000a00 0x100  0x12000b00 0x100
				0x12000c00 0x100 0x12000d00 0x100 0x12000e00 0x100  0x12000f00 0x100
				0x12001000 0x100 0x12001100 0x100 0x12001200 0x100  0x12001300 0x100
				0x12001400 0x100  0x12001500 0x100>;
		interrupts = <GIC_SPI VIOC0_IRQI IRQ_TYPE_LEVEL_HIGH>,
			     <GIC_SPI VIOC0_IRQI IRQ_TYPE_LEVEL_HIGH>,
			     <GIC_SPI VIOC0_IRQI IRQ_TYPE_LEVEL_HIGH>,
			     <GIC_SPI VIOC0_IRQI IRQ_TYPE_LEVEL_HIGH>,
			     <GIC_SPI VIOC0_IRQI IRQ_TYPE_LEVEL_HIGH>,
			     <GIC_SPI VIOC0_IRQI IRQ_TYPE_LEVEL_HIGH>,
			     <GIC_SPI VIOC0_IRQI IRQ_TYPE_LEVEL_HIGH>,
			     <GIC_SPI VIOC0_IRQI IRQ_TYPE_LEVEL_HIGH>,
			     <GIC_SPI VIOC0_IRQI IRQ_TYPE_LEVEL_HIGH>,
			     <GIC_SPI VIOC0_IRQI IRQ_TYPE_LEVEL_HIGH>,
			     <GIC_SPI VIOC0_IRQI IRQ_TYPE_LEVEL_HIGH>,
			     <GIC_SPI VIOC0_IRQI IRQ_TYPE_LEVEL_HIGH>,
			     <GIC_SPI VIOC0_IRQI IRQ_TYPE_LEVEL_HIGH>,
			     <GIC_SPI VIOC0_IRQI IRQ_TYPE_LEVEL_HIGH>,
			     <GIC_SPI VIOC0_IRQI IRQ_TYPE_LEVEL_HIGH>,
			     <GIC_SPI VIOC0_IRQI IRQ_TYPE_LEVEL_HIGH>,
			     <GIC_SPI VIOC0_IRQI IRQ_TYPE_LEVEL_HIGH>,
			     <GIC_SPI VIOC0_IRQI IRQ_TYPE_LEVEL_HIGH>;
	};

	vioc_wmix:vioc_wmix@12001800{
		compatible = "telechips,vioc_wmix";
		reg = <0x12001800 0x100 0x12001900 0x100 0x12001a00 0x100 0x12001b00 0x100
				0x12001c00 0x100 0x12001d00 0x100 0x12001e00 0x100>;
		interrupts = <GIC_SPI VIOC0_IRQI IRQ_TYPE_LEVEL_HIGH>,
			     <GIC_SPI VIOC0_IRQI IRQ_TYPE_LEVEL_HIGH>,
			     <GIC_SPI VIOC0_IRQI IRQ_TYPE_LEVEL_HIGH>,
			     <GIC_SPI VIOC0_IRQI IRQ_TYPE_LEVEL_HIGH>,
			     <GIC_SPI VIOC0_IRQI IRQ_TYPE_LEVEL_HIGH>,
			     <GIC_SPI VIOC0_IRQI IRQ_TYPE_LEVEL_HIGH>,
			     <GIC_SPI VIOC0_IRQI IRQ_TYPE_LEVEL_HIGH>;
	};

	vioc_scaler:vioc_scaler@12002000{
		compatible = "telechips,scaler";
		reg = <0x12002000 0x100 0x12002100 0x100 0x12002200 0x100 0x12002300 0x100 0x12002400 0x100 0x12002500 0x100>;
		status = "disabled";
	};

	vioc_wdma:vioc_wdma@12002800{
		compatible = "telechips,vioc_wdma";
		reg = <0x12002800 0x700 0x12002900 0x100 0x12002a00 0x100 0x12002b00 0x100
				0x12002c00 0x100 0x12002d00 0x100 0x12002e00 0x100  0x12002f00 0x100
				0x12003000 0x100 >;
		interrupts = <GIC_SPI VIOC2_IRQI IRQ_TYPE_LEVEL_HIGH>,
			     <GIC_SPI VIOC2_IRQI IRQ_TYPE_LEVEL_HIGH>,
			     <GIC_SPI VIOC2_IRQI IRQ_TYPE_LEVEL_HIGH>,
			     <GIC_SPI VIOC2_IRQI IRQ_TYPE_LEVEL_HIGH>,
			     <GIC_SPI VIOC2_IRQI IRQ_TYPE_LEVEL_HIGH>,
			     <GIC_SPI VIOC2_IRQI IRQ_TYPE_LEVEL_HIGH>,
			     <GIC_SPI VIOC2_IRQI IRQ_TYPE_LEVEL_HIGH>,
			     <GIC_SPI VIOC2_IRQI IRQ_TYPE_LEVEL_HIGH>,
			     <GIC_SPI VIOC2_IRQI IRQ_TYPE_LEVEL_HIGH>;
	};

	vioc_vin:vioc_vin@12004000{
		compatible = "telechips,vioc_vin";
		reg = <0x12004000 0x400 0x12005000 0x400 0x12006000 0x400 0x12007000 0x400
				0x12004400 0x600 0x12005400 0x600 0x12006400 0x600 0x12007400 0x600>;
		interrupts = <GIC_SPI VIOC0_IRQI IRQ_TYPE_LEVEL_HIGH>,
			     <GIC_SPI VIOC0_IRQI IRQ_TYPE_LEVEL_HIGH>,
			     <GIC_SPI VIOC0_IRQI IRQ_TYPE_LEVEL_HIGH>,
			     <GIC_SPI VIOC0_IRQI IRQ_TYPE_LEVEL_HIGH>,
			     <GIC_SPI VIOC0_IRQI IRQ_TYPE_LEVEL_HIGH>,
			     <GIC_SPI VIOC0_IRQI IRQ_TYPE_LEVEL_HIGH>,
			     <GIC_SPI VIOC0_IRQI IRQ_TYPE_LEVEL_HIGH>,
			     <GIC_SPI VIOC0_IRQI IRQ_TYPE_LEVEL_HIGH>,
			     <GIC_SPI VIOC0_IRQI IRQ_TYPE_LEVEL_HIGH>;

	};

	vioc_dv_in: vioc_dv_in@12008000{
		compatible = "telechips,vioc_dv_in";
		status = "disabled";
		reg = <0x12008000 0x100>;
	};

	viqe_madi: viqe_madi@12600000{
		compatible = "telechips,viqe_madi";
		status = "disabled";
		reg = <0x12600000 0xA000>;
	};

	vioc_viqe: vioc_viqe@1200d000{
		compatible = "telechips,vioc_viqe";
		status = "disabled";
		reg = <0x1200d000 0x1000 0x12010000 0x1000>;
	};

	vioc_lut: vioc_lut@12009000{
		compatible = "telechips,vioc_lut";
		reg = <0x12009000 0x800>;
		dev_max = <1>; /* 0: DEV0, 1: DEV1 and 2: DEV2 */
		vioc_max = <4>; /* 3: VIOC_LUT0, 4: VIOC_LUT1, 5: VIOC_LUT2 and 6: VIOC_LUT3 */
		status = "okay";
	};

	vioc_deintls: vioc_deintls@12003800{
		compatible = "telechips,vioc_deintls";
		reg = <0x12003800 0x100>;
		status = "disabled";
	};

	vioc_rdma_arbitor: vioc_rdma_arbitor@12003f00{
		reg = <0x12003f00 0x20 0x12003f20 0x20 0x12003f40 0x20 0x12003f60 0x20>;
		arbitor_num = <4>;
	};

	vioc_mc@12009000 {
		compatible = "telechips,vioc_mc";
		reg = <0x12001600 0x100 0x12001700 0x100>;
		status = "disabled";
	};

	vioc_sar: vioc_sar@0 {
		compatible = "telechips,vioc_sar";
		reg = <0x1201C000 0x100 0x1201C400 0x100 0x1201C800 0x100>;
		reg-names = "sar-if", "sar", "sar-in";
		clocks = <&clk_ddi DDIBUS_SAR &clk_peri PERI_SAR>;
		status = "okay";
	};

	vioc_pixel_mapper: vioc_pixel_mapper {
	   compatible = "telechips,vioc_pixel_mapper";
	   reg = <0x1201A000 0x800 0x1201B000 0x800>;
	   status = "okay";
	};

	vioc_2d_filter: vioc_2d_filter {
	   compatible = "telechips,vioc_filter2D";
	   reg = <0x12020200 0x100 0x12020300 0x100>;
	   status = "okay";
	};


	vioc_chroma_interpolator: vioc_chroma_Interpolator {
	   compatible = "telechips,vioc_chroma_interpolator";
	   reg = <0x12020000 0x100 0x12020100 0x100>;
	   status = "okay";
	};

	chroma_Interpolator_drv {
	   compatible = "telechips,chromainterpolator_drv";
	   status = "okay";
	};


	vioc_disp_dv@12001F00{
		compatible = "telechips,vioc_disp_dv";
		reg = <0x12001F00 0x40000 0x12003100 0x40000 0x12003D00 0x40000 0x12003E00 0x40000>;
		status = "disabled";
	};

	vioc_vedr@12001F00{
		compatible = "telechips,vioc_vedr";
		clocks = <&clk_peri PERI_LCD0>;
		reg = <0x12500000 0x40000 0x12540000 0x40000 0x12580000 0x40000 0x125C0000 0x40000>;
		status = "disabled";
	};

	vioc_afbc_dec:vioc_afbc_dec@12016000{
		compatible = "telechips,vioc_afbc_dec";
		status = "disabled";
		reg = <0x12016000 0x100 0x12017000 0x100>;
	};


	fbdisplay: fbdisplay@12000000 {
		compatible = "telechips,vioc-fb";
		status = "disabled";
		reg = <0x12000000 0x10000>;
		telechips,fbdisplay_num = <1>;
		telechips,rdma_arbitor=<&vioc_rdma_arbitor>;
		memory-region = <&pmap_fb_video &pmap_fb1_video>;

		fbdisplay0:fbdisplay0@12000000 {
			telechips,disp = <&vioc_disp VIOC_DISP0>;
			telechips,wmixer = <&vioc_wmix VIOC_WMIX0>;
			telechips,rdma = <&vioc_rdma VIOC_RDMA00 VIOC_RDMA01 VIOC_RDMA02 VIOC_RDMA03>;
			telechips,wdma = <&vioc_wdma VIOC_WDMA00>;
		};


		fbdisplay1:fbdisplay1@12000100{
			telechips,disp = <&vioc_disp VIOC_DISP1>;
			telechips,wmixer = <&vioc_wmix VIOC_WMIX1>;
			telechips,rdma = <&vioc_rdma VIOC_RDMA04 VIOC_RDMA05 VIOC_RDMA07>;
			telechips,wdma = <&vioc_wdma VIOC_WDMA01>;
		};
	};

	fb0: fb@0 {
		compatible = "telechips,fb";
		status = "disabled";
		memory-region = <&pmap_fb_video>;
		xres = <1920>;
		yres = <720>;
		bpp = <32>;
		mode = <FBX_TRIPLE>;
		update-type = <FBX_RDMA_UPDATE>;
		device-priority = <FBX_DEVICE_LVDS>;
		telechips,disp = <&vioc_disp VIOC_DISP0>;
		telechips,wmixer = <&vioc_wmix VIOC_WMIX0>;
		telechips,rdma = <&vioc_rdma VIOC_RDMA00>;
	};

	fb1: fb@1 {
		compatible = "telechips,fb";
		status = "disabled";
		memory-region = <&pmap_fb1_video>;
		xres = <1920>;
		yres = <720>;
		bpp = <32>;
		mode = <FBX_TRIPLE>;
		update-type = <FBX_RDMA_UPDATE>;
		device-priority = <FBX_DEVICE_HDMI>;
		telechips,disp = <&vioc_disp VIOC_DISP1>;
		telechips,wmixer = <&vioc_wmix VIOC_WMIX1>;
		telechips,rdma = <&vioc_rdma VIOC_RDMA04>;
	};

	fb2: fb@2 {
		compatible = "telechips,fb";
		status = "disabled";
		memory-region = <&pmap_fb2_video>;
		xres = <800>;
		yres = <480>;
		bpp = <32>;
		mode = <FBX_TRIPLE>;
		update-type = <FBX_OVERLAY_UPDATE>;
		device-priority = <FBX_DEVICE_LVDS>;
		telechips,disp = <&vioc_disp VIOC_DISP0>;
		telechips,wmixer = <&vioc_wmix VIOC_WMIX0>;
		telechips,rdma = <&vioc_rdma VIOC_RDMA01>;
	};

	panel: panel {};

	tcc_vsync: tcc_vsync_drv {};

	tcc_overlay: tcc_overlay_drv {
		compatible = "telechips,tcc_overlay";
		fbdisplay-overlay = <&fbdisplay>;
		rdmas = <&vioc_rdma VIOC_RDMA00 VIOC_RDMA01 VIOC_RDMA02 VIOC_RDMA03 VIOC_RDMA04 VIOC_RDMA05 VIOC_RDMA07>;
		wmixs = <&vioc_wmix VIOC_WMIX0 VIOC_WMIX1>;
		status = "okay";
	};

	tcc_viqe: tcc_video_viqe {
		compatible = "telechips,tcc_viqe";
		status = "disabled";

		tcc_viqe_viqe_common {
			telechips,viqe,0 = <&vioc_viqe VIOC_VIQE0>;
			telechips,viqe,1 = <&vioc_viqe VIOC_VIQE1>;
			vioc_deintls = <VIOC_DEINTLS0>;
			board_num=<0>;
		};

		tcc_video_viqe_lcd {
			telechips,wmixer = <&vioc_wmix VIOC_WMIX1>;
			telechips,rdma,60 = <&vioc_rdma VIOC_RDMA07>;
			telechips,disp = <&vioc_disp VIOC_DISP1>;
			telechips,sc = <&vioc_scaler VIOC_SCALER1>;
			viqe_rdma_num_60 = <VIOC_VIQE_RDMA_07>;
			sc_rdma_num_60 = <VIOC_SC_RDMA_07>;
		};

		tcc_video_viqe_external {
			telechips,wmixer = <&vioc_wmix VIOC_WMIX0>;
			telechips,rdma,60 = <&vioc_rdma VIOC_RDMA03>;
			telechips,disp = <&vioc_disp VIOC_DISP0>;
			telechips,sc = <&vioc_scaler VIOC_SCALER1>;
			viqe_rdma_num_60 = <VIOC_VIQE_RDMA_03>;
			sc_rdma_num_60 = <VIOC_SC_RDMA_03>;
		};

		tcc_video_viqe_external_sub {
			telechips,wmixer = <&vioc_wmix VIOC_WMIX0>;
			telechips,rdma,60 = <&vioc_rdma VIOC_RDMA02>;
			telechips,disp = <&vioc_disp VIOC_DISP0>;
			telechips,sc = <&vioc_scaler VIOC_SCALER3>;
			viqe_rdma_num_60 = <VIOC_VIQE_RDMA_02>;
			sc_rdma_num_60 = <VIOC_SC_RDMA_02>;
		};

		tcc_video_main_m2m{
			main_rdma_num_m2m = <VIOC_VIQE_RDMA_16>;
			telechips,main_rdma,m2m = <&vioc_rdma VIOC_RDMA16>;
		};

		tcc_video_sub_m2m {
			sub_rdma_num_m2m = <VIOC_VIQE_RDMA_07>;
			telechips,sub_rdma,m2m = <&vioc_rdma VIOC_RDMA07>;
		};

		tcc_video_scaler_main_m2m {
			clocks = <&clk_ddi DDIBUS_VIOC>;
			m2m_sc_rdma = <&vioc_rdma VIOC_RDMA16>;
			m2m_sc_scaler = <&vioc_scaler VIOC_SCALER1>;	/* id:1, path:17 */
			m2m_sc_wmix = <&vioc_wmix VIOC_WMIX5>;	/* id:5, path:6 */
			m2m_sc_wdma = <&vioc_wdma VIOC_WDMA06>;
			m2m_sc_scaler_path = <VIOC_SC_RDMA_16>;
			m2m_sc_settop_support = <1>;
		};

		tcc_video_scaler_sub_m2m {
			clocks = <&clk_ddi DDIBUS_VIOC>;
			m2m_sc_rdma = <&vioc_rdma VIOC_RDMA07>;
			m2m_sc_scaler = <&vioc_scaler VIOC_SCALER3>;	/* id:3, path:7 */
			m2m_sc_wmix = <&vioc_wmix VIOC_WMIX1>;	/* id:1, path:3 */
			m2m_sc_wdma = <&vioc_wdma VIOC_WDMA01>;
			m2m_sc_scaler_path = <VIOC_SC_RDMA_07>;
			m2m_sc_settop_support = <1>;
		};
	};

	vout_drv0: vout_drv@0 {
	    compatible = "telechips,v4l2_vout";
	    reg = <0x0 0x0>;						/* Dummy regs. */
	    clocks = <&clk_ddi DDIBUS_VIOC>;

	    rdma = <&vioc_rdma VIOC_RDMA03>;
	    wmix = <&vioc_wmix VIOC_WMIX0>;
	    disp = <&vioc_disp VIOC_DISP0>;

	    subplane_rdma = <&vioc_rdma VIOC_RDMA02>;
	    m2m_subplane_rdma = <&vioc_rdma VIOC_RDMA10>;
	    m2m_rdma = <&vioc_rdma VIOC_RDMA11>;
	    m2m_wmix	= <&vioc_wmix VIOC_WMIX2>;
	    m2m_wdma = <&vioc_wdma VIOC_WDMA02>;

	    deintl_block = <&vioc_viqe VIOC_VIQE0>;
	    scaler = <&vioc_scaler VIOC_SCALER1>;

	    status = "disabled";
	};

	vout_drv1: vout_drv@1 {
	    compatible = "telechips,v4l2_vout";
	    reg = <0x1 0x0>;						/* Dummy regs. */
	    clocks = <&clk_ddi DDIBUS_VIOC>;

	    rdma = <&vioc_rdma VIOC_RDMA07>;
	    wmix = <&vioc_wmix VIOC_WMIX1>;
	    disp = <&vioc_disp VIOC_DISP1>;

	    subplane_rdma = <&vioc_rdma VIOC_RDMA05>;
	    m2m_subplane_rdma = <&vioc_rdma VIOC_RDMA13>;
	    m2m_rdma = <&vioc_rdma VIOC_RDMA12>;
	    m2m_wmix	= <&vioc_wmix VIOC_WMIX3>;
	    m2m_wdma = <&vioc_wdma VIOC_WDMA03>;

	    deintl_block = <&vioc_deintls VIOC_DEINTLS0>;
	    scaler = <&vioc_scaler VIOC_SCALER3>;

	    status = "disabled";
	};

	tcc_tve: tve@12200000 {
		status = "disabled";
		compatible = "telechips,tcc-tve";
		reg = <0x12200000 0x100 0x12200800 0x10 0x12202000 0x100>;		/* 1st & 2nd is TVO, 3rd is BVO */
		clocks = <&clk_ddi DDIBUS_NTSCPAL &clk_isoip_ddi ISOIP_DDB_VDAC>;
	};

	composite: composite {
		status = "disabled";
		compatible = "telechips,tcc-composite";
		clocks = <&clk_peri PERI_LCD0 &clk_peri PERI_LCD1>;
		vioc-frequency = <27000000>;
		scaler = <&vioc_scaler VIOC_SCALER3>;
		config = <&vioc_config>;
		ddicfg = <&ddi_config>;
	};

	component: component {
		status = "disabled";
		compatible = "telechips,tcc-component";
		clocks = <&clk_peri PERI_LCD0 &clk_peri PERI_LCD1>;
		vioc-frequency = <74250000>;
		scaler = <&vioc_scaler VIOC_SCALER3>;
		config = <&vioc_config>;
		ddicfg = <&ddi_config>;
		pinctrl-names = "default", "idle";
		pinctrl-0 = <&lcd_lpxclk &lcd_lhsync &lcd_lvsync &lcd_lacbias &lcd_lpd >;
		pinctrl-1 = <&lcd_lpxclk_idle &lcd_lhsync_idle &lcd_lvsync_idle &lcd_lacbias_idle &lcd_lpd_idle>;
	};

	output_starter: output_starter {
		status = "disabled";
		compatible = "telechips,tcc-output-starter";
		scaler = <&vioc_scaler VIOC_SCALER2>;
		ddicfg = <&ddi_config>;
		tve = <&tcc_tve>;

		composite_starter {
			label = "composite output starter";
			clocks = <&clk_peri PERI_LCD0>, <&clk_peri PERI_LCD1>;
			clock-names = "lcdc0-clk", "lcdc1-clk";
			lcdc-clock-frequency = <27000000>;
		};

		component_starter {
			label = "component output starter";
			clocks = <&clk_peri PERI_LCD0>, <&clk_peri PERI_LCD1>;
			clock-names = "lcdc0-clk", "lcdc1-clk";
			lcdc-clock-frequency = <74250000>;
		};
	};

	jpeg_enc {
		compatible = "telechips-jpegenc";
		status = "disabled";
		clocks = <&clk_fbus FBUS_VBUS &clk_vpu VIDEOBUS_JPEG>;
		jpu_base_addr = <0x75300000>;
	};

	/*
	 * Video Bus Block
	 */

	vpu_dev_mgr {
		compatible = "telechips,vpu_dev_mgr";
		reg = <0x15000000 0x4000>;
		interrupts = <GIC_SPI 131 IRQ_TYPE_LEVEL_HIGH>;
		clocks = <&clk_fbus FBUS_VBUS &clk_fbus FBUS_BODA &clk_vpu VIDEOBUS_BODA_BUS &clk_vpu VIDEOBUS_BODA_CORE>;
	};

	jpu_dev_mgr {
	    compatible = "telechips,jpu_dev_mgr";
	    reg = <0x15180000 0x1000>;
	    interrupts = <GIC_SPI 132 IRQ_TYPE_LEVEL_HIGH>;
	    clocks = <&clk_fbus FBUS_VBUS &clk_vpu VIDEOBUS_JPEG>;
	};

	vpu_4k_d2_dev_mgr {
		compatible = "telechips,vpu_4k_d2_dev_mgr";
		reg = <0x15200000 0xA000>;
		interrupts = <GIC_SPI 133 IRQ_TYPE_LEVEL_HIGH>;
		clocks = <&clk_fbus FBUS_VBUS &clk_fbus FBUS_CHEVC &clk_fbus FBUS_BHEVC &clk_vpu VIDEOBUS_HEVC_BUS &clk_vpu VIDEOBUS_HEVC_CORE>;
	};

	/*
	 * Misc. Devices
	 */

	viqe_madi_drv: viqe_madi_drv@1 {
	   compatible = "telechips,viqe_madi";
	   reg = <0x1 0x0>;
	   interrupts = <GIC_SPI 122 IRQ_TYPE_LEVEL_HIGH>;
	   clocks = <&clk_ddi DDIBUS_MADI &clk_peri PERI_DEINTERLACER>;
	   status = "okay";
	};

	scaler_drv_common: scaler_drv_common@1 {
		compatible = "telechips,scaler_drv_common";
		reg = <0x1 0x0>;
		clocks = <&clk_ddi DDIBUS_VIOC>;
		interrupts = <GIC_SPI VIOC0_IRQI IRQ_TYPE_LEVEL_HIGH>;
		status = "okay";
	};


	scaler_drv1: scaler_drv@1 {
		compatible = "telechips,scaler_drv";
		reg = <0x1 0x0>;
		clocks = <&clk_ddi DDIBUS_VIOC>;
		status = "disabled";
	};

	scaler_drv3: scaler_drv@3 {
		compatible = "telechips,scaler_drv";
		reg = <0x3 0x0>;
		clocks = <&clk_ddi DDIBUS_VIOC>;
		status = "disabled";
	};

	attach_drv0: attach_drv@0 {
		compatible = "telechips,attach_drv";
		clocks = <&clk_ddi DDIBUS_VIOC>;
		scaler = <&vioc_scaler VIOC_SCALER0>;
		wdma = <&vioc_wdma VIOC_WDMA00>;
		wmix = <&vioc_wmix VIOC_WMIX1>;
		rdma = <&vioc_rdma VIOC_RDMA05>;
		status = "okay";
	};

	attach_drv1: attach_drv@1 {
		compatible = "telechips,attach_drv";
		clocks = <&clk_ddi DDIBUS_VIOC>;
		scaler = <&vioc_scaler VIOC_SCALER1>;
		wdma = <&vioc_wdma VIOC_WDMA01>;
		wmix = <&vioc_wmix VIOC_WMIX0>;
		rdma = <&vioc_rdma VIOC_RDMA01>;
		status = "okay";
	};

	wmixer_drv0: wmixer_drv@0 {
		compatible = "telechips,wmixer_drv";
		reg = <0x0 0x0>;	/* Dummy regs. */
		clocks = <&clk_ddi DDIBUS_VIOC>;
		rdmas = <&vioc_rdma VIOC_RDMA17>;
		wmixs = <&vioc_wmix VIOC_WMIX6>;	/* id:5, path:- TODO: WMIX_MAX occurs error*/
		wdmas = <&vioc_wdma VIOC_WDMA08>;
		status = "disabled";
	};

	wmixer_drv1: wmixer_drv@1 {
		compatible = "telechips,wmixer_drv";
		reg = <0x1 0x0>;	/* Dummy regs. */
		clocks = <&clk_ddi DDIBUS_VIOC>;
		rdmas = <&vioc_rdma VIOC_RDMA13>;
		scalers = <&vioc_scaler VIOC_SCALER3>;	/* id:0, path:19 */
		wmixs = <&vioc_wmix VIOC_WMIX3>;	/* id:3, path:- TODO: WMIX_MAX occurs error*/
		wdmas = <&vioc_wdma VIOC_WDMA03>;
		status = "disabled";
	};

	wdma_drv0: wdma_drv@0 {
		compatible = "telechips,tcc_wdma";
		clocks = <&clk_ddi DDIBUS_VIOC>;
		wdma-fbdisplay = <&fbdisplay>;
		scalers = <&vioc_scaler VIOC_SCALER0>, <&vioc_scaler VIOC_SCALER0>;       /* id:1, path:20 (wdma 0 path), 21(wdma 1 path) */
		wdmas = <&vioc_wdma VIOC_WDMA00>, <&vioc_wdma VIOC_WDMA01>;   /* id:1, path: wmix output mixed pah */
		wmixs = <&vioc_wmix VIOC_WMIX0>, <&vioc_wmix VIOC_WMIX1>;      /* id:1, path: input rdma mixed path */
		status = "okay";
	};

	hdmi_tx_20: hdmi_tx_20@12400000 {
		compatible = "telechips,dw-hdmi-tx";
		/* Register */
		reg = <0x12400000 0x20000 0x12440000 0x1000 0x12480000 0x1000 0x163C0000 0x10 0x16051000 0x00000100>;
		reg-names = "hdmi_link", "hdcp_2.2", "hdmi_phy", "i2c_port_cfg", "hdmi_io_bus";
		/* Interrupt */
		interrupts = <GIC_SPI 119 IRQ_TYPE_LEVEL_HIGH>,
				<GIC_SPI 120 IRQ_TYPE_LEVEL_HIGH>,
				<GIC_SPI 121 IRQ_TYPE_LEVEL_HIGH>;
		interrupt-names = "hdmi_link", "hdcp_2.2", "hdmi_cec";
		/* Clocks */
		clocks = <&clk_peri PERI_HDMI_27MHZ>,
				<&clk_peri PERI_HDMI_SPDIF>,
				<&clk_peri PERI_HDMI_PHY>,
				<&clk_peri PERI_HDMI_CEC>,
			 	<&clk_peri PERI_HDMI_HDCP14>,
			 	<&clk_peri PERI_HDMI_HDCP22>,
			 	<&clk_ddi DDIBUS_HDMI>,
			 	<&clk_isoip_ddi ISOIP_DDB_HDMI>;
		clock-names = "hdmi_ref_clk",
				"hdmi_spdif_clk",
				"hdmi_apb_clk",
				"hdmi_cec",
				"hdmi_hdcp14",
				"hdmi_hdcp22",
				"hdmi_ddibus",
				"hdmi_isoip_ddibus";
		clock-frequency = <50000000>;
		/* Pinctrl and gpio */
		pinctrl-names = "default";
		pinctrl-0 = <&hdmi_hpd &hdmi_i2c>;
		gpios = <&gphdmi 1 0>;
		/* DDC */
		hdmi_i2c_port_mapping = <0xc 0xf 0xe>; /* offset mask value */

		/* Source Product Description */
		vendor_name = "TCC";
		product_description = "TCC8xxx";
		source_information = <1>; /* Digital STB */

		audio_if_selection_ofst = <0x58>;
		verbose = <0>; // 0 disable, 1 basic, 2 io
		status = "okay";
	};

	hdmi_cec_20: hdmi_cec_20@16053000 {
		compatible = "telechips,dw-hdmi-cec";
		reg = <0x16053000 0x100 0x16053400 0x400 0x16051054 0x4>;
		reg-names = "cec_controller", "cec_irq_controller", "cec_clock_select";
		interrupts = <GIC_SPI 70 IRQ_TYPE_LEVEL_HIGH>, 		/* CEC1 Interrupt */
				<GIC_SPI 71 IRQ_TYPE_LEVEL_HIGH>;	/* CEC1 WAKEUP Interrupt */
		clocks = <&clk_io IOBUS_CEC1>;
		clock-names = "iobus_cfg_cec";
		pinctrl-names = "default";
		pinctrl-0 = <&hdmi_cec>;
		status = "disabled";
	};

	hdmi_hdcp: hdmi_hdcp@12440000 {
		compatible = "telechips,dw-hdcp";
		reg = <0x12400000 0x20000 0x12440000 0x1000 0x163C0000 0x10>;
		reg-names = "hdmi_link", "hdcp_2.2", "i2c_port_cfg";
		interrupts = <GIC_SPI 119 IRQ_TYPE_LEVEL_HIGH>,
				<GIC_SPI 120 IRQ_TYPE_LEVEL_HIGH>;
		interrupt-names = "hdmi_link", "hdcp_2.2";
		memory-region = <&reserved_dw_esm>;
	};

	/* eMMC Boot */
	sdhc1: sdhc@16450000 {
		compatible = "telechips,tcc-sdhc";
		reg = <0x16450000 0x100>, <0x16470050 0x50>, <0x16494014 0x4>, <0x164700FC 0x4>;
		interrupts = <GIC_SPI 75 IRQ_TYPE_LEVEL_HIGH>;
		clocks = <&clk_peri PERI_SDMMC1 &clk_io IOBUS_SDMMC1>;
		clock-names = "mmc_fclk", "mmc_hclk";
		max-frequency = <50000000>;
		bus-width = <4>;
		status = "disabled";

		tcc-mmc-clk-out-tap = <0>;
		tcc-mmc-cmd-tap = <0>;
		tcc-mmc-data-tap = <0>;
	};

	sdhc0: sdhc@16440000 {
		compatible = "telechips,tcc-sdhc";
		reg = <0x16440000 0x100>, <0x16470000 0x50>, <0x16494010 0x4>, <0x164700FC 0x4>;
		interrupts = <GIC_SPI 74 IRQ_TYPE_LEVEL_HIGH>;
		clocks = <&clk_peri PERI_SDMMC0 &clk_io IOBUS_SDMMC0>;
		clock-names = "mmc_fclk", "mmc_hclk";
		max-frequency = <50000000>;
		bus-width = <4>;
		status = "disabled";

		tcc-mmc-clk-out-tap = <0>;
		tcc-mmc-cmd-tap = <0>;
		tcc-mmc-data-tap = <0>;
	};

	sdhc2: sdhc@16460000 {
		compatible = "telechips,tcc-sdhc";
		reg = <0x16460000 0x100>, <0x164700A0 0x50>, <0x0 0x0>/*dummy*/, <0x164700FC 0x4>;
		interrupts = <GIC_SPI 76 IRQ_TYPE_LEVEL_HIGH>;
		clocks = <&clk_peri PERI_SDMMC2 &clk_io IOBUS_SDMMC2>;
		clock-names = "mmc_fclk", "mmc_hclk";
		max-frequency = <50000000>;
		bus-width = <4>;
		status = "disabled";

		tcc-mmc-clk-out-tap = <0>;
		tcc-mmc-cmd-tap = <0>;
		tcc-mmc-data-tap = <0>;
	};

	vqmmc_emmc: vqmmc_emmc {};

	vqmmc_sd: vqmmc_sd {};

	vqmmc_sdio: vqmmc_sdio {};

	nand: nand@16400000 {
		compatible = "telechips,nand-v8";
		reg = <0x16400000 0x13ff>;
		interrupts = <GIC_SPI 48 IRQ_TYPE_LEVEL_HIGH>;
		status = "disabled";
	};

	remote: remote@16040000 {
		compatible = "telechips,tccxxxx-remote";
		reg = <0x16040000 0x100>, <0x14400128 0x4>;
		interrupts = <GIC_SPI 188 IRQ_TYPE_LEVEL_HIGH>;
		clocks = <&clk_peri PERI_RMT &clk_io IOBUS_REMOCON>;
		clock-frequency = <24000000>;
		status = "disabled";
	};

	adc: adc@16050000 {
		compatible = "telechips,adc";
		reg = <0x16050000 0x24 0x1440000C 0x4>;
		clocks = <&clk_peri PERI_TSADC &clk_io IOBUS_TSADC &clk_isoip_top ISOIP_TOP_TSADC>;
		clock-frequency = <12000000>;
		ckin-frequency  = <1000000>;
		adc-12bit-resolution;
		adc-delay = <150>;
		adc-board-ver = <8>;
		status = "disabled";
	};

	tsadc@16050000 {	/* ADC Touch Screen */
		compatible = "telechips,tsadc";
		reg = <0x16050000 0x24>;
		int-gpios = <&gpadc 6 0>;	/* for using TSADC_UPDOWN extint soruce */
		status = "disabled";
	};

	/*
	 * HSIO Bus Block
	 */

	gmac: gmac@11C00000{
		compatible = "telechips,gmac";
		reg = <0x11C00000 0x3000 0x11DA0000 0x100>;
		interrupts = <GIC_SPI 139 IRQ_TYPE_LEVEL_HIGH>;
		status = "disabled";
		index = <1>;
		clocks = <&clk_peri PERI_GMAC &clk_fbus FBUS_HSIO &clk_peri PERI_GMAC_PTP &clk_hsio HSIOBUS_GMAC>; //PERI_GMAC0, HSIOBUS, PERI_PTP0, HCLK_GMAC
		clock-names = "gmac-pclk", "hsio-clk", "ptp-pclk", "gmac-hclk";
	};

	rtc {
		compatible = "telechips,rtc";
		reg = <0x16480000 0x50>;
		clocks = <&clk_io IOBUS_RTC &clk_isoip_top ISOIP_TOP_RTC>;
		interrupts = <GIC_SPI 73 0>;
	};

	/*
	 * CM Bus Block
	 */
	hwdemux: cmbus@19000000 {
		status = "disabled";
	};

	tcc_nsk_sc: tcc_nsk_sc@16671000 {};
        pwm:pwm@16050000 { /* pwm */
                compatible = "telechips,pwm";
                reg = <0x16030000 0x70 0x1605104C 0x4>;
                tcc,pwm-number = <4>;
                #pwm-cells = <2>;
                clocks = <&clk_peri PERI_PDM &clk_io IOBUS_PWM >;
				clock-frequency = <400000000>; /* Hz */
				status = "okay";
        };


		pwm_led_a {
			pinctrl-names = "default";

			led_a {
					pwms = <&pwm 0 500000000>;
					max-brightness = <255>;
					linux,default-trigger = "default-on";
			};
	 };


	tcc-restart {
		compatible = "telechips,restart";
		reg = <0x14400000 0x1A0 0xF0009FFC 0x4>;
		status = "okay";
	};

/*  for mailbox test
	mboxtest {
		compatible = "mailbox-test";
		mbox-names = "mboxtest";
		mboxes = <&mbox 0>;
	};
*/
	sp {
		compatible = "telechips,sp";
		reg = <0x19080000 0x10000 0x19100000 0x32>;
		mbox-names = "sp-mbox";
		mboxes = <&cmbox 0>;
		memory-region = <&reserved_secure_tsv>;
	};

	tcc-mbox-audio {
		compatible = "telechips,mailbox-audio";
		mbox-names = "tcc-mbox-audio";
		mboxes = <&mbox 0>;
	};

	firmware {
		optee {
			compatible = "linaro,optee-tz";
			method = "smc";
		};

		firmware_android: android {};
	};

        cpu_id: cpu-id@14200290 {
                compatible = "telechips,tcc-cpu-id";
                reg = <0x14200290 0x4 0x14200298 0x4 0x1420029C 0x4 0x14400014 0x4>;
                status = "okay";
        };

        dram_monitor: dram_monitor{
                compatible = "telechips,dram-tool";
                reg = <0x13300000 0x4 0x13400000 0x4>;
                //status = "okay";
        };

	vdd_cpu: cpu0-regulators {};

	mali_regulators: mali-regulators {};

	thermal: thermal@14700000 {};

	gpio_leds: gpio_leds {};

	gpio_keys: gpio_keys {};

	gpio_keys_polled: gpio_keys_polled {};

	tcm3800: tcm3800 {};

	tcc_bluetooth: tcc_bluetooth {};

	smartcard: smartcard {};

	sound: sound@0 {};

	wm8524: wm8524@0 {};
};
