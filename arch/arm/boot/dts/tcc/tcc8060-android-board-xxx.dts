// SPDX-License-Identifier: (GPL-2.0-or-later OR MIT)
/*
 * Copyright (C) Telechips Inc.
 * Device tree for Telechips TCC8060 AVN board
 */

#ifndef DT_OVERLAY
/dts-v1/;
#endif

#include "tcc8060-android-avn.dtsi"


/ {
	/* Describe here after remove this statement if you have something to be override. */
};
