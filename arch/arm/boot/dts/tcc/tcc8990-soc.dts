// SPDX-License-Identifier: (GPL-2.0+ OR MIT)
/*
 * Telechips SoC series device tree overlay source
 *
 * Copyright (C) 2018 Telechips Inc.
 */

/dts-v1/;

#include "tcc-pmap-899x-android-customized.dtsi"

#include "tcc8990.dtsi"

/ {
};
