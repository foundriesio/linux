
#include "tcc8980-android-stb-v02.dts"

/ {
	sdhc@16440000 { // Wi-Fi tcm3830
		pinctrl-0 = <&sd0_2_4_idle>;
		pinctrl-1 = <&sd0_2_clk &sd0_2_cmd &sd0_2_bus4>;

		channel-mux = <2>; // 0b10, gpsd1
	};
};
