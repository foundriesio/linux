// SPDX-License-Identifier: (GPL-2.0-or-later OR MIT)
/*
 * Copyright (C) Telechips Inc.
 */

/dts-v1/;
/plugin/;

#define DT_OVERLAY

#include <dt-bindings/interrupt-controller/arm-gic.h>
#include <dt-bindings/clock/telechips,tcc899x-clks.h>
#include <dt-bindings/soc/tcc899x-pm.h>
#include <dt-bindings/display/tcc899x-vioc.h>
#include <dt-bindings/power/telechips,boot-mode.h>
#include <dt-bindings/gpio/gpio.h>

#include "tcc-pmap-899x-android-customized.dtsi"

#include <dt-bindings/pmap/tcc899x/pmap-tcc899x-android-ivi.h>
#include "tcc-pmap-common.dtsi"

#include "tcc8990-android-lpd4322-v0.1.dts"

