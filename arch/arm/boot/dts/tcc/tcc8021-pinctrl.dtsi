/*
 * Device tree for Telechips TCC8020 pinctrl
 *
 * Copyright (C) 2016 Telechips Inc. - http://www.telechips.com
 *
 * This file is dual-licensed: you can use it either under the terms
 * of the GPL or the X11 license, at your option. Note that this dual
 * licensing only applies to this file, and not this project as a
 * whole.
 *
 *  a) This file is free software; you can redistribute it and/or
 *     modify it under the terms of the GNU General Public License as
 *     published by the Free Software Foundation; either version 2 of the
 *     License, or (at your option) any later version.
 *
 *     This file is distributed in the hope that it will be useful,
 *     but WITHOUT ANY WARRANTY; without even the implied warranty of
 *     MERCHANTABILITY or FITNESS FOR A PARTICULAR PURPOSE.  See the
 *     GNU General Public License for more details.
 *
 * Or, alternatively,
 *
 *  b) Permission is hereby granted, free of charge, to any person
 *     obtaining a copy of this software and associated documentation
 *     files (the "Software"), to deal in the Software without
 *     restriction, including without limitation the rights to use,
 *     copy, modify, merge, publish, distribute, sublicense, and/or
 *     sell copies of the Software, and to permit persons to whom the
 *     Software is furnished to do so, subject to the following
 *     conditions:
 *
 *     The above copyright notice and this permission notice shall be
 *     included in all copies or substantial portions of the Software.
 *
 *     THE SOFTWARE IS PROVIDED "AS IS", WITHOUT WARRANTY OF ANY KIND,
 *     EXPRESS OR IMPLIED, INCLUDING BUT NOT LIMITED TO THE WARRANTIES
 *     OF MERCHANTABILITY, FITNESS FOR A PARTICULAR PURPOSE AND
 *     NONINFRINGEMENT. IN NO EVENT SHALL THE AUTHORS OR COPYRIGHT
 *     HOLDERS BE LIABLE FOR ANY CLAIM, DAMAGES OR OTHER LIABILITY,
 *     WHETHER IN AN ACTION OF CONTRACT, TORT OR OTHERWISE, ARISING
 *     FROM, OUT OF OR IN CONNECTION WITH THE SOFTWARE OR THE USE OR
 *     OTHER DEALINGS IN THE SOFTWARE.
 */

&pinctrl {
	gpa: gpa {
		gpio-controller;
		#gpio-cells = <2>;
		reg = <0x0 0 17>;
	};

	gpb: gpb {
		gpio-controller;
		#gpio-cells = <2>;
		reg = <0x40 0 30>;
	};

	gpc: gpc {
		gpio-controller;
		#gpio-cells = <2>;
		reg = <0x80 0 30>;
	};

	gpd: gpd {
		gpio-controller;
		#gpio-cells = <2>;
		reg = <0xc0 0 22>;
	};

	gpe: gpe {
		gpio-controller;
		#gpio-cells = <2>;
		reg = <0x100 0 32>;
	};

	gpf: gpf {
		gpio-controller;
		#gpio-cells = <2>;
		reg = <0x140 0 32>;
	};

	gpg: gpg {
		gpio-controller;
		#gpio-cells = <2>;
		reg = <0x180 0 20>;
	};

	gph: gph {
		gpio-controller;
		#gpio-cells = <2>;
		reg = <0x400 0 12>;
	};

	gpk: gpk {
		gpio-controller;
		#gpio-cells = <2>;
		reg = <0x440 0 32>;
	};

	gpsd0: gpsd0 {
		gpio-controller;
		#gpio-cells = <2>;
		reg = <0x240 0 11>;
	};

	gpadc: gpadc {  /* dummy regs. */
		gpio-controller;
		#gpio-cells = <2>;
		reg = <0x480 2 32>; /* use 2~9 pins */
	};

	nand_databus8: nand_databus8 {
		telechips,pins = "gpa-0", "gpa-1", "gpa-2", "gpa-3",
				 "gpa-4", "gpa-5", "gpa-6", "gpa-7";
		telechips,pin-function = <1>;
	};

	nand_cle: nand_cle {
		telechips,pins = "gpa-8";
		telechips,pin-function = <1>;
	};

	nand_ale: nand_ale {
		telechips,pins = "gpa-9";
		telechips,pin-function = <1>;
	};

	nand_oe: nand_oe {
		telechips,pins = "gpa-10";
		telechips,pin-function = <1>;
	};

	nand_we: nand_we {
		telechips,pins = "gpa-11";
		telechips,pin-function = <1>;
	};

	nand_cs0: nand_cs0 {
		telechips,pins = "gpa-12";
		telechips,pin-function = <1>;
	};

	nand_rdy: nand_rdy {
		telechips,pins = "gpa-16";
		telechips,pin-function = <1>;
	};

	nand_wp: nand_wp {
		telechips,pins = "gpa-15";
		telechips,pin-function = <1>;
	};

	sd0_a_pow: sd0_a_pow {
		telechips,pins = "gpa-6";
		telechips,pin-function = <2>;
		telechips,drive-strength = <3>;
	};

	sd0_a_clk: sd0_a_clk {
		telechips,pins = "gpa-7";
		telechips,pin-function = <2>;
		telechips,drive-strength = <3>;
	};

	sd0_a_cmd: sd0_a_cmd {
		telechips,pins = "gpa-8";
		telechips,pin-function = <2>;
		telechips,drive-strength = <3>;
	};

	sd0_a_bus1: sd0_a_bus1 {
		telechips,pins = "gpa-9";
		telechips,pin-function = <2>;
		telechips,drive-strength = <3>;
	};

	sd0_a_bus4: sd0_a_bus4 {
		telechips,pins = "gpa-9", "gpa-10", "gpa-11", "gpa-12";
		telechips,pin-function = <2>;
		telechips,drive-strength = <3>;
	};

	sd0_a_bus4_idle: sd0_a_bus4_idle {
		telechips,pins = "gpa-7", "gpa-8", "gpa-9", "gpa-10", "gpa-11", "gpa-12";
		telechips,pin-function = <0>;
		telechips,pull-disable;
		telechips,output-low;
	};

	sd0_a_bus8: sd0_a_bus8 {
		telechips,pins = "gpa-9", "gpa-10", "gpa-11", "gpa-12",
		                 "gpa-13", "gpa-14", "gpa-15", "gpa-16";
		telechips,pin-function = <2>;
		telechips,drive-strength = <3>;
	};

	sd0_a_bus8_idle: sd0_a_bus8_idle {
		telechips,pins = "gpa-7", "gpa-8", "gpa-9", "gpa-10", "gpa-11", "gpa-12",
		                 "gpa-13", "gpa-14", "gpa-15", "gpa-16";
		telechips,pin-function = <0>;
		telechips,pull-disable;
		telechips,output-low;
	};

	sd0_c_pow: sd0_c_pow {
		telechips,pins = "gpc-10";
		telechips,pin-function = <3>;
		telechips,drive-strength = <3>;
	};

	sd0_c_clk: sd0_c_clk {
		telechips,pins = "gpc-0";
		telechips,pin-function = <3>;
		telechips,drive-strength = <3>;
	};

	sd0_c_cmd: sd0_c_cmd {
		telechips,pins = "gpc-1";
		telechips,pin-function = <3>;
		telechips,drive-strength = <3>;
	};

	sd0_c_bus1: sd0_c_bus1 {
		telechips,pins = "gpc-2";
		telechips,pin-function = <3>;
		telechips,drive-strength = <3>;
	};

	sd0_c_bus4: sd0_c_bus4 {
		telechips,pins = "gpc-2", "gpc-3", "gpc-4", "gpc-5";
		telechips,pin-function = <3>;
		telechips,drive-strength = <3>;
	};

	sd0_c_bus4_idle: sd0_c_bus4_idle {
		telechips,pins = "gpc-0", "gpc-1", "gpc-2", "gpc-3", "gpc-4", "gpc-5";
		telechips,pin-function = <0>;
		telechips,pull-disable;
		telechips,output-low;
	};

	sd0_c_bus8: sd0_c_bus8 {
		telechips,pins = "gpc-2", "gpc-3", "gpc-4", "gpc-5",
		                 "gpc-6", "gpc-7", "gpc-8", "gpc-9";
		telechips,pin-function = <3>;
		telechips,drive-strength = <3>;
	};

	sd0_c_bus8_idle: sd0_c_bus8_idle {
		telechips,pins = "gpc-0", "gpc-1", "gpc-2", "gpc-3", "gpc-4", "gpc-5",
		                 "gpc-6", "gpc-7", "gpc-8", "gpc-9";
		telechips,pin-function = <0>;
		telechips,pull-disable;
		telechips,output-low;
	};

	sd0_d_pow: sd0_d_pow {
		telechips,pins = "gpd-21";
		telechips,pin-function = <2>;
		telechips,drive-strength = <3>;
	};

	sd0_d_clk: sd0_d_clk {
		telechips,pins = "gpd-20";
		telechips,pin-function = <2>;
		telechips,drive-strength = <3>;
	};

	sd0_d_cmd: sd0_d_cmd {
		telechips,pins = "gpd-19";
		telechips,pin-function = <2>;
		telechips,drive-strength = <3>;
	};

	sd0_d_bus1: sd0_d_bus1 {
		telechips,pins = "gpd-18";
		telechips,pin-function = <2>;
		telechips,drive-strength = <3>;
	};

	sd0_d_bus4: sd0_d_bus4 {
		telechips,pins = "gpd-18", "gpd-17", "gpd-16", "gpd-15";
		telechips,pin-function = <2>;
		telechips,drive-strength = <3>;
	};

	sd0_d_bus4_idle: sd0_d_bus4_idle {
		telechips,pins = "gpd-20", "gpd-19", "gpd-18", "gpd-17", "gpd-16", "gpd-15";
		telechips,pin-function = <0>;
		telechips,pull-disable;
		telechips,output-low;
	};

	sd0_d_bus8: sd0_d_bus8 {
		telechips,pins = "gpd-18", "gpd-17", "gpd-16", "gpd-15",
		                 "gpd-14", "gpd-13", "gpd-12", "gpd-11";
		telechips,pin-function = <2>;
		telechips,drive-strength = <3>;
	};

	sd0_d_bus8_idle: sd0_d_bus8_idle {
		telechips,pins = "gpd-20", "gpd-19", "gpd-18", "gpd-17", "gpd-16", "gpd-15",
		                 "gpd-14", "gpd-13", "gpd-12", "gpd-11";
		telechips,pin-function = <0>;
		telechips,pull-disable;
		telechips,output-low;
	};

	sd1_a_pow: sd1_a_pow {
		telechips,pins = "gpa-6";
		telechips,pin-function = <3>;
		telechips,drive-strength = <3>;
	};

	sd1_a_clk: sd1_a_clk {
		telechips,pins = "gpa-7";
		telechips,pin-function = <3>;
		telechips,drive-strength = <3>;
	};

	sd1_a_cmd: sd1_a_cmd {
		telechips,pins = "gpa-8";
		telechips,pin-function = <3>;
		telechips,drive-strength = <3>;
	};

	sd1_a_bus1: sd1_a_bus1 {
		telechips,pins = "gpa-9";
		telechips,pin-function = <3>;
		telechips,drive-strength = <3>;
	};

	sd1_a_bus4: sd1_a_bus4 {
		telechips,pins = "gpa-9", "gpa-10", "gpa-11", "gpa-12";
		telechips,pin-function = <3>;
		telechips,drive-strength = <3>;
	};

	sd1_a_bus4_idle: sd1_a_bus4_idle {
		telechips,pins = "gpa-7", "gpa-8", "gpa-9", "gpd-10", "gpa-11", "gpa-12";
		telechips,pin-function = <0>;
		telechips,pull-disable;
		telechips,output-low;
	};

	sd1_a_bus8: sd1_a_bus8 {
		telechips,pins = "gpa-9", "gpa-10", "gpa-11", "gpa-12",
		                 "gpa-13", "gpa-14", "gpa-15", "gpa-16";
		telechips,pin-function = <3>;
		telechips,drive-strength = <3>;
	};

 	sd1_a_bus8_idle: sd1_a_bus8_idle {
		telechips,pins = "gpa-7", "gpa-8", "gpa-9", "gpa-10", "gpa-11", "gpa-12",
		                 "gpa-13", "gpa-14", "gpa-15", "gpa-16";
		telechips,pin-function = <0>;
		telechips,pull-disable;
		telechips,output-low;
	};

	sd1_b_pow: sd1_b_pow {
		telechips,pins = "gpb-29";
		telechips,pin-function = <3>;
		telechips,drive-strength = <3>;
	};

	sd1_b_clk: sd1_b_clk {
		telechips,pins = "gpb-28";
		telechips,pin-function = <3>;
		telechips,drive-strength = <3>;
	};

	sd1_b_cmd: sd1_b_cmd {
		telechips,pins = "gpb-19";
		telechips,pin-function = <3>;
		telechips,drive-strength = <3>;
	};

	sd1_b_bus1: sd1_b_bus1 {
		telechips,pins = "gpb-20";
		telechips,pin-function = <3>;
		telechips,drive-strength = <3>;
	};

	sd1_b_bus4: sd1_b_bus4 {
		telechips,pins = "gpb-20", "gpb-21", "gpb-22", "gpb-23";
		telechips,pin-function = <3>;
		telechips,drive-strength = <3>;
	};

	sd1_b_bus4_idle: sd1_b_bus4_idle {
		telechips,pins = "gpb-28", "gpb-19", "gpb-20", "gpb-21", "gpb-22", "gpb-23";
		telechips,pin-function = <0>;
		telechips,pull-disable;
		telechips,output-low;
	};

	sd1_b_bus8: sd1_b_bus8 {
		telechips,pins = "gpb-20", "gpb-21", "gpb-22", "gpb-23",
		                 "gpb-24", "gpb-25", "gpb-26", "gpb-27";
		telechips,pin-function = <3>;
		telechips,drive-strength = <3>;
	};

 	sd1_b_bus8_idle: sd1_b_bus8_idle {
		telechips,pins = "gpb-28", "gpb-19", "gpb-20", "gpb-21", "gpb-22", "gpb-23",
		                 "gpb-24", "gpb-25", "gpb-26", "gpb-27";
		telechips,pin-function = <0>;
		telechips,pull-disable;
		telechips,output-low;
	};

	sd1_g_pow: sd1_g_pow {
		telechips,pins = "gpg-16";
		telechips,pin-function = <5>;
		telechips,drive-strength = <3>;
	};

	sd1_g_clk: sd1_g_clk {
		telechips,pins = "gpg-6";
		telechips,pin-function = <5>;
		telechips,drive-strength = <3>;
	};

	sd1_g_cmd: sd1_g_cmd {
		telechips,pins = "gpg-7";
		telechips,pin-function = <5>;
		telechips,drive-strength = <3>;
	};

	sd1_g_bus1: sd1_g_bus1 {
		telechips,pins = "gpg-8";
		telechips,pin-function = <5>;
		telechips,drive-strength = <3>;
	};

	sd1_g_bus4: sd1_g_bus4 {
		telechips,pins = "gpg-8", "gpg-9", "gpg-10", "gpg-11";
		telechips,pin-function = <5>;
		telechips,drive-strength = <3>;
	};

	sd1_g_bus4_idle: sd1_g_bus4_idle {
		telechips,pins = "gpg-6", "gpg-7", "gpg-8", "gpg-9", "gpg-10", "gpg-11";
		telechips,pin-function = <0>;
		telechips,pull-disable;
		telechips,output-low;
	};

	sd1_g_bus8: sd1_g_bus8 {
		telechips,pins = "gpg-8", "gpg-9", "gpg-10", "gpg-11",
		                 "gpg-12", "gpg-13", "gpg-14", "gpg-15";
		telechips,pin-function = <5>;
		telechips,drive-strength = <3>;
	};

 	sd1_g_bus8_idle: sd1_g_bus8_idle {
		telechips,pins = "gpg-6", "gpg-7", "gpg-8", "gpg-9", "gpg-10", "gpg-11",
		                 "gpg-12", "gpg-13", "gpg-14", "gpg-15";
		telechips,pin-function = <0>;
		telechips,pull-disable;
		telechips,output-low;
	};

	sd2_b_pow: sd2_b_pow {
		telechips,pins = "gpb-10";
		telechips,pin-function = <3>;
		telechips,drive-strength = <3>;
	};

	sd2_b_clk: sd2_b_clk {
		telechips,pins = "gpb-0";
		telechips,pin-function = <3>;
		telechips,drive-strength = <3>;
	};

	sd2_b_cmd: sd2_b_cmd {
		telechips,pins = "gpb-1";
		telechips,pin-function = <3>;
		telechips,drive-strength = <3>;
	};

	sd2_b_bus1: sd2_b_bus1 {
		telechips,pins = "gpb-2";
		telechips,pin-function = <3>;
		telechips,drive-strength = <3>;
	};

	sd2_b_bus4: sd2_b_bus4 {
		telechips,pins = "gpb-2", "gpb-3", "gpb-4", "gpb-5";
		telechips,pin-function = <3>;
		telechips,drive-strength = <3>;
	};

	sd2_b_bus4_idle: sd2_b_bus4_idle {
		telechips,pins = "gpb-0", "gpb-1", "gpb-2", "gpb-3", "gpb-4", "gpb-5";
		telechips,pin-function = <0>;
		telechips,pull-disable;
		telechips,output-low;
	};

	sd2_b_bus8: sd2_b_bus8 {
		telechips,pins = "gpb-2", "gpb-3", "gpb-4", "gpb-5",
		                 "gpb-6", "gpb-7", "gpb-8", "gpb-9";
		telechips,pin-function = <3>;
		telechips,drive-strength = <3>;
	};

	sd2_b_bus8_idle: sd2_b_bus8_idle {
		telechips,pins = "gpb-0", "gpb-1", "gpb-2", "gpb-3", "gpb-4", "gpb-5",
		                 "gpb-6", "gpb-7", "gpb-8", "gpb-9";
		telechips,pin-function = <0>;
		telechips,pull-disable;
		telechips,output-low;
	};

	sd2_f_pow: sd2_f_pow {
		telechips,pins = "gpf-15";
		telechips,pin-function = <2>;
		telechips,drive-strength = <3>;
	};

	sd2_f_clk: sd2_f_clk {
		telechips,pins = "gpf-16";
		telechips,pin-function = <2>;
		telechips,drive-strength = <3>;
	};

	sd2_f_cmd: sd2_f_cmd {
		telechips,pins = "gpf-17";
		telechips,pin-function = <2>;
		telechips,drive-strength = <3>;
	};

	sd2_f_bus1: sd2_f_bus1 {
		telechips,pins = "gpf-18";
		telechips,pin-function = <2>;
		telechips,drive-strength = <3>;
	};

	sd2_f_bus4: sd2_f_bus4 {
		telechips,pins = "gpf-18", "gpf-19", "gpf-20", "gpf-21";
		telechips,pin-function = <2>;
		telechips,drive-strength = <3>;
	};

	sd2_f_bus4_idle: sd2_f_bus4_idle {
		telechips,pins = "gpf-16", "gpf-17", "gpf-18", "gpf-19", "gpf-20", "gpf-21";
		telechips,pin-function = <0>;
		telechips,pull-disable;
		telechips,output-low;
	};

	sd2_f_bus8: sd2_f_bus8 {
		telechips,pins = "gpf-18", "gpf-19", "gpf-20", "gpf-21",
		                 "gpf-22", "gpf-23", "gpf-24", "gpf-25";
		telechips,pin-function = <2>;
		telechips,drive-strength = <3>;
	};

	sd2_f_bus8_idle: sd2_f_bus8_idle {
		telechips,pins = "gpf-16", "gpf-17", "gpf-18", "gpf-19", "gpf-20", "gpf-21",
		                 "gpf-22", "gpf-23", "gpf-24", "gpf-25";
		telechips,pin-function = <0>;
		telechips,pull-disable;
		telechips,output-low;
	};

	sd2_gpsd0_pow: sd2_gpsd0_pow {
		telechips,pins = "gpsd0-10";
		telechips,pin-function = <1>;
		telechips,drive-strength = <3>;
	};

	sd2_gpsd0_clk: sd2_gpsd0_clk {
		telechips,pins = "gpsd0-0";
		telechips,pin-function = <1>;
		telechips,drive-strength = <3>;
	};

	sd2_gpsd0_cmd: sd2_gpsd0_cmd {
		telechips,pins = "gpsd0-1";
		telechips,pin-function = <1>;
		telechips,drive-strength = <3>;
	};

	sd2_gpsd0_bus1: sd2_gpsd0_bus1 {
		telechips,pins = "gpsd0-2";
		telechips,pin-function = <1>;
		telechips,drive-strength = <3>;
	};

	sd2_gpsd0_bus4: sd2_gpsd0_bus4 {
		telechips,pins = "gpsd0-2", "gpsd0-3", "gpsd0-4", "gpsd0-5";
		telechips,pin-function = <1>;
		telechips,drive-strength = <3>;
	};

	sd2_gpsd0_bus4_idle: sd2_gpsd0_bus4_idle {
		telechips,pins = "gpsd0-0", "gpsd0-1", "gpsd0-2", "gpsd0-3", "gpsd0-4", "gpsd0-5";
		telechips,pin-function = <0>;
		telechips,pull-disable;
		telechips,output-low;
	};

	sd2_gpsd0_bus8: sd2_gpsd0_bus8 {
		telechips,pins = "gpsd0-2", "gpsd0-3", "gpsd0-4", "gpsd0-5",
		                 "gpsd0-6", "gpsd0-7", "gpsd0-8", "gpsd0-9";
		telechips,pin-function = <1>;
		telechips,drive-strength = <3>;
	};

	sd2_gpsd0_bus8_idle: sd2_gpsd0_bus8_idle {
		telechips,pins = "gpsd0-0", "gpsd0-1", "gpsd0-2", "gpsd0-3", "gpsd0-4", "gpsd0-5",
		                 "gpsd0-6", "gpsd0-7", "gpsd0-8", "gpsd0-9";
		telechips,pin-function = <0>;
		telechips,pull-disable;
		telechips,output-low;
	};

	out5_clk: out5_clk {
		telechips,pins = "gpsd0-10";
		telechips,pin-function = <2>;
		telechips,drive-strength = <3>;
	}; // ext32.768 clock

	i2c0_bus: i2c0_bus {
		telechips,pins = "gpc-14", "gpa-15";
		telechips,pin-function = <15>;
	};

	i2c1_bus: i2c1_bus {
		telechips,pins = "gpc-16", "gpc-17";
		telechips,pin-function = <15>;
	};

	i2c2_bus: i2c2_bus {
		telechips,pins = "gpd-0", "gpd-1";
		telechips,pin-function = <15>;
	};

	i2c3_bus: i2c3_bus {
		telechips,pins = "gpd-2", "gpd-3";
		telechips,pin-function = <15>;
	};

	i2c4_bus: i2c4_bus {
		telechips,pins = "gpe-14", "gpe-15";
		telechips,pin-function = <15>;
	};

	i2c5_bus: i2c5_bus {
		telechips,pins = "gpg-18", "gpg-19";
		telechips,pin-function = <15>;
	};

	gpsb0_bus: gpsb0_bus {
		telechips,pins = "gpe-0", "gpe-1", "gpe-2", "gpe-3";
		telechips,pin-function = <15>;
	};

	gpsb1_bus: gpsb1_bus {
		telechips,pins = "gpe-4", "gpe-5", "gpe-6", "gpe-7";
		telechips,pin-function = <15>;
	};

	gpsb2_bus: gpsb2_bus {
		telechips,pins = "gpb-0", "gpb-1", "gpb-2", "gpb-3";
		telechips,pin-function = <15>;
	};

	gpsb3_bus: gpsb3_bus {
		telechips,pins = "gpb-17", "gpb-18", "gpb-19", "gpb-20";
		telechips,pin-function = <15>;
	};

	gpsb4_bus: gpsb4_bus {
		telechips,pins = "gpc-0", "gpc-1", "gpc-2", "gpc-3";
		telechips,pin-function = <15>;
	};

	gpsb5_bus: gpsb5_bus {
		telechips,pins = "gpc-26", "gpc-27", "gpc-28", "gpc-29";
		telechips,pin-function = <15>;
	};

	gpsb6_bus: gpsb6_bus {
		telechips,pins = "gpc-4", "gpc-5", "gpc-6", "gpc-7";
		telechips,pin-function = <15>;
	};

	gpsb6_bus_idle: gpsb6_bus_idle {
		telechips,pins = "gpe-4", "gpe-5", "gpe-6", "gpe-7";
		telechips,pin-function = <0>;
		telechips,output-low;
	};

	gpsb6_bus_spi: gpsb6_bus_spi {
		telechips,pins = "gpe-4", "gpe-5", "gpe-6", "gpe-7";
		telechips,pin-function = <15>;
	};

	gpsb6_bus_tsif: gpsb6_bus_tsif {
		telechips,pins = "gpe-4", "gpe-5", "gpe-6", "gpe-7";
		telechips,pin-function = <15>;
		telechips,input-enable;
	};

	gpsb7_bus: gpsb7_bus {
		telechips,pins = "gpc-0", "gpc-1", "gpc-2", "gpc-3";
		telechips,pin-function = <15>;
	};

	gpsb7_bus_idle: gpsb7_bus_idle {
		telechips,pins = "gpe-0", "gpe-1", "gpe-2", "gpe-3";
		telechips,pin-function = <0>;
		telechips,output-low;
	};

	gpsb7_bus_spi: gpsb7_bus_spi {
		telechips,pins = "gpe-0", "gpe-1", "gpe-2", "gpe-3";
		telechips,pin-function = <15>;
	};

	gpsb7_bus_tsif: gpsb7_bus_tsif {
		telechips,pins = "gpe-0", "gpe-1", "gpe-2", "gpe-3";
		telechips,pin-function = <15>;
		telechips,input-enable;
	};

	ts6_idle: ts6_idle {
		telechips,pins = "gpe-0", "gpe-1", "gpe-2", "gpe-3";
		telechips,pin-function = <0>;
		telechips,output-low;
	};

	ts6_active: ts6_active {
		telechips,pins = "gpe-0", "gpe-1", "gpe-2", "gpe-3";
		telechips,pin-function = <1>;
		telechips,input-enable;
	};

	uart0_data: uart0_data {
		telechips,pins = "gpb-5", "gpb-4";
		telechips,pin-function = <6>;
	};

	uart0_rtscts: uart0_rtscts {
		telechips,pins = "gpb-3", "gpb-2";
		telechips,pin-function = <4>;
	};

	uart1_data: uart1_data {
		telechips,pins = "gpa-7", "gpa-6";
		telechips,pin-function = <4>;
	};

	uart1_rtscts: uart1_rtscts {
		telechips,pins = "gpb-9", "gpb-8";
		telechips,pin-function = <4>;
	};

	uart2_data: uart2_data {
		telechips,pins = "gpb-13", "gpb-12";
		telechips,pin-function = <4>;
	};

	uart2_rtscts: uart2_rtscts {
		telechips,pins = "gpb-11", "gpb-10";
		telechips,pin-function = <4>;
	};

	uart3_data: uart3_data {
		telechips,pins = "gpb-16", "gpb-15";
		telechips,pin-function = <4>;
	};

	uart3_rtscts: uart3_rtscts {
		telechips,pins = "gpb-18", "gpb-17";
		telechips,pin-function = <4>;
	};

	uart4_data: uart4_data {
		telechips,pins = "gpb-22", "gpb-21";
		telechips,pin-function = <4>;
	};

	uart4_rtscts: uart4_rtscts {
		telechips,pins = "gpb-20", "gpb-19";
		telechips,pin-function = <4>;
	};

	uart5_data: uart5_data {
		telechips,pins = "gpb-28", "gpb-27";
		telechips,pin-function = <4>;
	};

	uart5_rtscts: uart5_rtscts {
		telechips,pins = "gpb-26", "gpb-25";
		telechips,pin-function = <4>;
	};

	uart6_data: uart6_data {
		telechips,pins = "gpc-5", "gpc-4";
		telechips,pin-function = <3>;
	};

	uart6_rtscts: uart6_rtscts {
		telechips,pins = "gpc-3", "gpe-2";
		telechips,pin-function = <3>;
	};

	uart7_data: uart7_data {
		telechips,pins = "gpc-7", "gpc-6";
		telechips,pin-function = <3>;
	};

	uart7_rtscts: uart7_rtscts {
		telechips,pins = "gpc-9", "gpc-8";
		telechips,pin-function = <3>;
	};

	uart8_data: uart8_data {
		telechips,pins = "gpc-13", "gpc-12";
		telechips,pin-function = <3>;
	};

	uart8_rtscts: uart8_rtscts {
		telechips,pins = "gpc-11", "gpc-10";
		telechips,pin-function = <3>;
	};

	uart9_data: uart9_data {
		telechips,pins = "gpc-19", "gpc-18";
		telechips,pin-function = <15>;
	};

	uart9_rtscts: uart9_rtscts {
		telechips,pins = "gpc-21", "gpc-20";
		telechips,pin-function = <15>;
	};

	uart10_data: uart10_data {
		telechips,pins = "gpc-25", "gpc-24";
		telechips,pin-function = <3>;
	};

	uart10_rtscts: uart10_rtscts {
		telechips,pins = "gpc-23", "gpc-22";
		telechips,pin-function = <3>;
	};

	uart11_data: uart11_data {
		telechips,pins = "gpd-5", "gpd-4";
		telechips,pin-function = <2>;
	};

	uart11_rtscts: uart11_rtscts {
		telechips,pins = "gpd-7", "gpd-6";
		telechips,pin-function = <2>;
	};

	uart12_data: uart12_data {
		telechips,pins = "gpf-31", "gpf-30";
		telechips,pin-function = <15>;
	};

	uart12_rtscts: uart12_rtscts {
		telechips,pins = "gpf-29", "gpf-28";
		telechips,pin-function = <2>;
	};

	uart13_data: uart13_data {
		telechips,pins = "gpk-23", "gpk-22";
		telechips,pin-function = <1>;
	};

	smartcard_bus: smartcard_bus {
		telechips,pins = "gpb-4", "gpb-5";
		telechips,pin-function = <15>;
	};

	sfmc_databus8: sfmc_databus8 {
		telechips,pins = "gph-0", "gph-1", "gph-2", "gph-3",
		                 "gph-4", "gph-5", "gph-6", "gph-7";
		telechips,pin-function = <1>;
	};

	sfmc_databus4: sfmc_databus4 {
		telechips,pins = "gph-0", "gph-1", "gph-2", "gph-3";
		telechips,pin-function = <1>;
	};

	sfmc_clkcs: sfmc_clkcs {
		telechips,pins = "gph-8", "gph-9";
		telechips,pin-function = <1>;
	};

/***************************************************************/
/* Remote Controller & GMAC
/***************************************************************/

	gmac1_mdc: gmac1_mdc {
		telechips,pins = "gpc-1";
		telechips,pin-function = <1>;
	};

	gmac1_mdio: gmac1_mdio {
		telechips,pins = "gpc-2";
		telechips,pin-function = <1>;
	};

	gmac1_txclk: gmac1_txclk {
		telechips,pins = "gpc-0";
		telechips,pin-function = <1>;
		telechips,drive-strength = <3>;
	};

	gmac1_txen: gmac1_txen {
		telechips,pins = "gpc-7";
		telechips,pin-function = <1>;
		telechips,drive-strength = <3>;
	};

	gmac1_txd0: gmac1_txd0 {
		telechips,pins = "gpc-5";
		telechips,pin-function = <1>;
		telechips,drive-strength = <3>;
	};

	gmac1_txd1: gmac1_txd1 {
		telechips,pins = "gpc-6";
		telechips,pin-function = <1>;
		telechips,drive-strength = <3>;
	};

	gmac1_txd2: gmac1_txd2{
		telechips,pins = "gpc-12";
		telechips,pin-function = <1>;
		telechips,drive-strength = <3>;
	};

	gmac1_txd3: gmac1_txd3{
		telechips,pins = "gpc-13";
		telechips,pin-function = <1>;
		telechips,drive-strength = <3>;
	};

	gmac1_txd4: gmac1_txd4 {
		telechips,pins = "gpc-22";
		telechips,pin-function = <1>;
		telechips,drive-strength = <1>;
	};

	gmac1_txd5: gmac1_txd5 {
		telechips,pins = "gpc-23";
		telechips,pin-function = <1>;
		telechips,drive-strength = <1>;
	};

	gmac1_txd6: gmac1_txd6{
		telechips,pins = "gpc-24";
		telechips,pin-function = <1>;
		telechips,drive-strength = <1>;
	};

	gmac1_txd7: gmac1_txd7{
		telechips,pins = "gpc-25";
		telechips,pin-function = <1>;
		telechips,drive-strength = <1>;
	};

	gmac1_rxclk: gmac1_rxclk {
		telechips,pins = "gpc-26";
		telechips,pin-function = <1>;
	};

	gmac1_rxdv: gmac1_rxdv {
		telechips,pins = "gpc-8";
		telechips,pin-function = <1>;
	};

	gmac1_rxd0: gmac1_rxd0 {
		telechips,pins = "gpc-3";
		telechips,pin-function = <1>;
	};

	gmac1_rxd1: gmac1_rxd1 {
		telechips,pins = "gpc-4";
		telechips,pin-function = <1>;
	};

	gmac1_rxd2: gmac1_rxd2{
		telechips,pins = "gpc-10";
		telechips,pin-function = <1>;
	};

	gmac1_rxd3: gmac1_rxd3{
		telechips,pins = "gpc-11";
		telechips,pin-function = <1>;
	};

	gmac1_rxd4: gmac1_rxd4 {
		telechips,pins = "gpc-18";
		telechips,pin-function = <1>;
	};

	gmac1_rxd5: gmac1_rxd5 {
		telechips,pins = "gpc-19";
		telechips,pin-function = <1>;
	};

	gmac1_rxd6: gmac1_rxd6{
		telechips,pins = "gpc-20";
		telechips,pin-function = <1>;
	};

	gmac1_rxd7: gmac1_rxd7{
		telechips,pins = "gpc-21";
		telechips,pin-function = <1>;
	};

	gmac1_rxer: gmac1_rxer{
		telechips,pins = "gpc-14";
		telechips,pin-function = <1>;
	};

	gmac1_txer: gmac1_txer{
		telechips,pins = "gpc-15";
		telechips,pin-function = <1>;
		telechips,drive-strength = <1>;
	};

	gmac1_col: gmac1_col{
		telechips,pins = "gpc-16";
		telechips,pin-function = <1>;
	};

	gmac1_crs: gmac1_crs{
		telechips,pins = "gpc-17";
		telechips,pin-function = <1>;
	};

	cam4_clki: cam4_clki {
		telechips,pins = "gpf-0";
		telechips,pin-function = <1>;
		telechips,drive-strength = <3>;
	};

	cam4_hsync: cam4_hsync {
		telechips,pins = "gpf-1";
		telechips,pin-function = <1>;
		telechips,drive-strength = <3>;
	};

	cam4_vsync: cam4_vsync {
		telechips,pins = "gpf-2";
		telechips,pin-function = <1>;
		telechips,drive-strength = <3>;
	};

	cam4_data: cam4_data {
		telechips,pins = "gpf-3", "gpf-4", "gpf-5", "gpf-6",
				 "gpf-7", "gpf-8", "gpf-9", "gpf-10";
		telechips,pin-function = <1>;
		telechips,drive-strength = <3>;
	};

	cam4_clko: cam4_clko {
		telechips,pins = "gpf-11";
		telechips,pin-function = <11>;
		telechips,drive-strength = <3>;
	};

	cam4_de: cam4_de {
		telechips,pins = "gpf-12";
		telechips,pin-function = <1>;
	};

	// LinuxPltform uses cam4_flen to gear port. !!
	cam4_flen: cam4_flen {
		telechips,pins = "gpc-22";
		telechips,pin-function = <0>;
		telechips,drive-strength = <1>;
	};
	//

	tsc_default: tsc_default {
		telechips,pins = "gpd-8", "gpk-7";
		telechips,pin-function = <0>;
	};
	pmic_irq: pmic_irq {
		telechips,pins = "gpb-22";
		telechips,pin-function = <0>;
	};

	lcd_lpxclk: lcd_lpxclk {
		telechips,pins = "gpb-0";
		telechips,pin-function = <1>;
	};

	lcd_lpxclk_idle: lcd_lpxclk_idle {
		telechips,pins = "gpb-0";
		telechips,pin-function = <0>;
		telechips,output-low = <0>;
	};

	lcd_lhsync: lcd_lhsync {
		telechips,pins = "gpb-1";
		telechips,pin-function = <1>;
	};

	lcd_lhsync_idle: lcd_lhsync_idle {
		telechips,pins = "gpb-1";
		telechips,pin-function = <0>;
		telechips,output-low = <0>;
	};

	lcd_lvsync: lcd_lvsync {
		telechips,pins = "gpb-2";
		telechips,pin-function = <1>;
	};

	lcd_lvsync_idle: lcd_lvsync_idle {
		telechips,pins = "gpb-2";
		telechips,pin-function = <0>;
		telechips,output-low = <0>;
	};

	lcd_lacbias: lcd_lacbias {
		telechips,pins = "gpb-19";
		telechips,pin-function = <1>;
	};

	lcd_lacbias_idle: lcd_lacbias_idle {
		telechips,pins = "gpb-19";
		telechips,pin-function = <0>;
		telechips,output-low = <0>;
	};

	lcd_lpd: lcd_lpd {
		telechips,pins ="gpb-3", "gpb-4", "gpb-5", "gpb-6",
		                "gpb-7", "gpb-8", "gpb-9", "gpb-10",
		                "gpb-11", "gpb-12", "gpb-13", "gpb-14",
		                "gpb-15", "gpb-16", "gpb-17", "gpb-18",
		                "gpb-20", "gpb-21", "gpb-22", "gpb-23",
		                "gpb-24", "gpb-25", "gpb-26", "gpb-27";
		telechips,pin-function = <1>;
	};

	lcd_lpd_idle: lcd_lpd_idle {
		telechips,pins ="gpb-3", "gpb-4", "gpb-5", "gpb-6",
		                "gpb-7", "gpb-8", "gpb-9", "gpb-10",
		                "gpb-11", "gpb-12", "gpb-13", "gpb-14",
		                "gpb-15", "gpb-16", "gpb-17", "gpb-18",
		                "gpb-20", "gpb-21", "gpb-22", "gpb-23",
		                "gpb-24", "gpb-25", "gpb-26", "gpb-27";
		telechips,pin-function = <0>;
		telechips,output-low = <0>;
	};

	pwm_k_11: pwm_k_11 {
		telechips,pins = "gpk-11";
		telechips,pin-function = <15>;
		telechips,drive-strength = <3>;
		telechips,no-pull = <1>;
		telechips,input_buffer_disable;
		telechips,input-disable;
	};

	pwm_k_11_idle: pwm_k_11_idle {
		telechips,pins = "gpk-11";
		telechips,pin-function = <0>;
		telechips,output-low = <0>;
	};

	gfb157: gfb157 {
		telechips,pins = "gpf-26";
		telechips,pin-function = <15>;
		telechips,drive-strength = <1>;
	};

	gfb158: gfb158 {
		telechips,pins = "gpf-27";
		telechips,pin-function = <15>;
		telechips,drive-strength = <1>;
	};

	gfb163: gfb163 {
		telechips,pins = "gpg-0";
		telechips,pin-function = <15>;
		telechips,drive-strength = <1>;
	};

	gfb164: gfb164 {
		telechips,pins = "gpg-1";
		telechips,pin-function = <15>;
		telechips,drive-strength = <1>;
	};

	gfb165: gfb165 {
		telechips,pins = "gpg-2";
		telechips,pin-function = <15>;
		telechips,drive-strength = <1>;
	};

	gfb166: gfb166 {
		telechips,pins = "gpg-3";
		telechips,pin-function = <15>;
		telechips,drive-strength = <1>;
	};

	gfb167: gfb167 {
		telechips,pins = "gpg-4";
		telechips,pin-function = <15>;
		telechips,drive-strength = <1>;
	};

	gfb168: gfb168 {
		telechips,pins = "gpg-5";
		telechips,pin-function = <15>;
		telechips,drive-strength = <1>;
	};

	gfb169: gfb169 {
		telechips,pins = "gpg-6";
		telechips,pin-function = <15>;
		telechips,drive-strength = <1>;
	};

	gfb170: gfb170 {
		telechips,pins = "gpg-7";
		telechips,pin-function = <15>;
		telechips,drive-strength = <1>;
	};

	gfb171: gfb171 {
		telechips,pins = "gpg-8";
		telechips,pin-function = <15>;
		telechips,drive-strength = <1>;
	};

	gfb172: gfb172 {
		telechips,pins = "gpg-9";
		telechips,pin-function = <15>;
		telechips,drive-strength = <1>;
	};

	gfb173: gfb1173 {
		telechips,pins = "gpg-10";
		telechips,pin-function = <15>;
		telechips,drive-strength = <1>;
	};

	gfb174: gfb174 {
		telechips,pins = "gpg-11";
		telechips,pin-function = <15>;
		telechips,drive-strength = <1>;
	};

	gfb175: gfb175 {
		telechips,pins = "gpg-12";
		telechips,pin-function = <15>;
		telechips,drive-strength = <1>;
	};

	gfb176: gfb176 {
		telechips,pins = "gpg-13";
		telechips,pin-function = <15>;
		telechips,drive-strength = <1>;
	};

	gfb177: gfb177 {
		telechips,pins = "gpg-14";
		telechips,pin-function = <15>;
		telechips,drive-strength = <1>;
	};

	gfb178: gfb178 {
		telechips,pins = "gpg-15";
		telechips,pin-function = <15>;
		telechips,drive-strength = <1>;
	};

	gfb179: gfb179 {
		telechips,pins = "gpg-16";
		telechips,pin-function = <15>;
		telechips,drive-strength = <1>;
	};

	gfb180: gfb180 {
		telechips,pins = "gpg-17";
		telechips,pin-function = <15>;
		telechips,drive-strength = <1>;
	};

	gfb181: gfb181 {
		telechips,pins = "gpg-18";
		telechips,pin-function = <15>;
		telechips,drive-strength = <1>;
	};

	gfb182: gfb182 {
		telechips,pins = "gpg-19";
		telechips,pin-function = <15>;
		telechips,drive-strength = <1>;
	};
/***************************************************************/
};
