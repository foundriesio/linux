// SPDX-License-Identifier: (GPL-2.0+ OR MIT)
/*
 * Telechips SoC series device tree overlay source
 *
 * Copyright (C) 2020 Telechips Inc.
 */

/dts-v1/;
/plugin/;

#define DT_OVERLAY

#include <dt-bindings/interrupt-controller/arm-gic.h>
#include <dt-bindings/clock/telechips,tcc805x-clks.h>
#include <dt-bindings/display/tcc805x-vioc.h>
#include <dt-bindings/power/tcc805x,boot-mode.h>
#include <dt-bindings/gpio/gpio.h>

#include "tcc-pmap-805x-android-customized.dtsi"

#include "tcc-pmap-common.dtsi"

#include "tcc8060-android-board-xxx.dts"
