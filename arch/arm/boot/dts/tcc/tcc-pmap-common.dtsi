/*
 * Device tree for Telechips TCC899x family SoC
 *
 * Copyright (C) 2018 Telechips Inc. - http://www.telechips.com
 *
 * This file is dual-licensed: you can use it either under the terms
 * of the GPL or the X11 license, at your option. Note that this dual
 * licensing only applies to this file, and not this project as a
 * whole.
 *
 *  a) This file is free software; you can redistribute it and/or
 *     modify it under the terms of the GNU General Public License as
 *     published by the Free Software Foundation; either version 2 of the
 *     License, or (at your option) any later version.
 *
 *     This file is distributed in the hope that it will be useful,
 *     but WITHOUT ANY WARRANTY; without even the implied warranty of
 *     MERCHANTABILITY or FITNESS FOR A PARTICULAR PURPOSE.  See the
 *     GNU General Public License for more details.
 *
 * Or, alternatively,
 *
 *  b) Permission is hereby granted, free of charge, to any person
 *     obtaining a copy of this software and associated documentation
 *     files (the "Software"), to deal in the Software without
 *     restriction, including without limitation the rights to use,
 *     copy, modify, merge, publish, distribute, sublicense, and/or
 *     sell copies of the Software, and to permit persons to whom the
 *     Software is furnished to do so, subject to the following
 *     conditions:
 *
 *     The above copyright notice and this permission notice shall be
 *     included in all copies or substantial portions of the Software.
 *
 *     THE SOFTWARE IS PROVIDED "AS IS", WITHOUT WARRANTY OF ANY KIND,
 *     EXPRESS OR IMPLIED, INCLUDING BUT NOT LIMITED TO THE WARRANTIES
 *     OF MERCHANTABILITY, FITNESS FOR A PARTICULAR PURPOSE AND
 *     NONINFRINGEMENT. IN NO EVENT SHALL THE AUTHORS OR COPYRIGHT
 *     HOLDERS BE LIABLE FOR ANY CLAIM, DAMAGES OR OTHER LIABILITY,
 *     WHETHER IN AN ACTION OF CONTRACT, TORT OR OTHERWISE, ARISING
 *     FROM, OUT OF OR IN CONNECTION WITH THE SOFTWARE OR THE USE OR
 *     OTHER DEALINGS IN THE SOFTWARE.
 */

#include "tcc-pmap-video.dtsi"

#define TCC_ALIGN(value, base)   (((value)+((base)-1))&~((base)-1))

/*-----------------------------------------------------------
 * Secure Area 1 (CPU R/W, VPU X, GPU R/W, VIOC R)
 *-----------------------------------------------------------
 */
#ifndef FCE_NEW_PMAP_SUPPORT

#ifdef CONFIG_ANDROID
#ifdef CONFIG_VIOC_AFBCDEC
#define SIZE_FB_VIDEO                      (ARRAY_MBYTE((TCC_ALIGN(PRIMARY_FRAMEBUFFER_WIDTH, 16) * TCC_ALIGN(PRIMARY_FRAMEBUFFER_HEIGHT, 16) * 4 + TCC_ALIGN(PRIMARY_FRAMEBUFFER_WIDTH, 16) * TCC_ALIGN(PRIMARY_FRAMEBUFFER_HEIGHT, 16) / 16 ) * 3) + (ARRAY_MBYTE(SECONDARY_FRAMEBUFFER_WIDTH * SECONDARY_FRAMEBUFFER_HEIGHT * 4 * 3)) + (1*SZ_1MB))
#else
#define SIZE_FB_VIDEO			(ARRAY_MBYTE(PRIMARY_FRAMEBUFFER_WIDTH * PRIMARY_FRAMEBUFFER_HEIGHT * 4 * 3) + (ARRAY_MBYTE(SECONDARY_FRAMEBUFFER_WIDTH * SECONDARY_FRAMEBUFFER_HEIGHT * 4 * 3)))
#endif
#define SIZE_FB1_VIDEO			0x00000000
#define SIZE_FB2_VIDEO			0x00000000
#define SIZE_FB3_VIDEO			0x00000000
#else
#ifdef CONFIG_VIOC_PVRIC_FBDC
#define SIZE_FB_VIDEO                   (ARRAY_MBYTE(PRIMARY_FRAMEBUFFER_WIDTH * PRIMARY_FRAMEBUFFER_HEIGHT * 4 * 3) + (ARRAY_MBYTE(TCC_ALIGN(PRIMARY_FRAMEBUFFER_WIDTH * PRIMARY_FRAMEBUFFER_HEIGHT / 64, 256) * 3)))
#else
#define SIZE_FB_VIDEO			ARRAY_MBYTE(PRIMARY_FRAMEBUFFER_WIDTH * PRIMARY_FRAMEBUFFER_HEIGHT * 4 * 3) 
#endif
#ifdef CONFIG_FB_NEW
#define SIZE_FB1_VIDEO			ARRAY_MBYTE(SECONDARY_FRAMEBUFFER_WIDTH * SECONDARY_FRAMEBUFFER_HEIGHT * 4 * 3)
#define SIZE_FB2_VIDEO			ARRAY_MBYTE(TERTIARY_FRAMEBUFFER_WIDTH * TERTIARY_FRAMEBUFFER_HEIGHT * 4 * 3)
#define SIZE_FB3_VIDEO			0x00000000
#else
#define SIZE_FB1_VIDEO			0x00000000
#define SIZE_FB2_VIDEO			0x00000000
#define SIZE_FB3_VIDEO			0x00000000
#endif
#endif

////////////////////////////////////////////////////////////////////
#ifdef CONFIG_PMAP_TO_CMA
#define CMA_SIZE_FB_VIDEO			0x00000000//(SIZE_FB_VIDEO)
#define CMA_SIZE_FB1_VIDEO			0x00000000//(SIZE_FB1_VIDEO)
#define CMA_SIZE_FB2_VIDEO			0x00000000//(SIZE_FB2_VIDEO)
#define CMA_SIZE_FB3_VIDEO			0x00000000//(SIZE_FB3_VIDEO)

#define PMAP_SIZE_FB_VIDEO			(SIZE_FB_VIDEO)
#define PMAP_SIZE_FB1_VIDEO			(SIZE_FB1_VIDEO)
#define PMAP_SIZE_FB2_VIDEO			(SIZE_FB2_VIDEO)
#define PMAP_SIZE_FB3_VIDEO			(SIZE_FB3_VIDEO)
#else
#define CMA_SIZE_FB_VIDEO			0x00000000
#define CMA_SIZE_FB1_VIDEO			0x00000000
#define CMA_SIZE_FB2_VIDEO			0x00000000
#define CMA_SIZE_FB3_VIDEO			0x00000000

#define PMAP_SIZE_FB_VIDEO			(SIZE_FB_VIDEO)
#define PMAP_SIZE_FB1_VIDEO			(SIZE_FB1_VIDEO)
#define PMAP_SIZE_FB2_VIDEO			(SIZE_FB2_VIDEO)
#define PMAP_SIZE_FB3_VIDEO			(SIZE_FB3_VIDEO)
#endif
#endif

#define PMAP_SIZE_SECURE_AREA_1		( 0x1000 \
									+ PMAP_SIZE_FB_VIDEO \
									+ PMAP_SIZE_FB1_VIDEO \
									+ PMAP_SIZE_FB2_VIDEO \
									+ PMAP_SIZE_FB3_VIDEO \
									)

/*-----------------------------------------------------------
 * Secure Area 2 (CPU X, VPU X, GPU X, VIOC R/W)
 *-----------------------------------------------------------
 */

#ifndef FCE_NEW_PMAP_SUPPORT
#define SIZE_OVERLAY			ARRAY_MBYTE(SUPPORT_DISPLAY_MAX_WIDTH * SUPPORT_DISPLAY_MAX_HEIGHT * 2 * 3)

#ifdef CONFIG_PLATFORM_AVN
	#define SIZE_OVERLAY1 ARRAY_MBYTE(SUPPORT_DISPLAY_MAX_WIDTH * SUPPORT_DISPLAY_MAX_HEIGHT * 2 * 3)
#else
	#ifdef SUPPORT_VIDEO_PIP
	#define SIZE_OVERLAY1		ARRAY_MBYTE(SUPPORT_PIP_MAX_WIDTH * SUPPORT_PIP_MAX_HEIGHT * 2 * 3)
	#else
	#define SIZE_OVERLAY1		0x00000000
	#endif
#endif

#ifdef SUPPORT_ROTATION
#define SIZE_OVERLAY_ROT		ARRAY_MBYTE(SUPPORT_DISPLAY_MAX_WIDTH * SUPPORT_DISPLAY_MAX_HEIGHT * 2 * 2)
#else
#define SIZE_OVERLAY_ROT		0x00000000
#endif

#ifdef CONFIG_TCC_VIQE_MADI
#define SIZE_VIQE_MADI			ARRAY_MBYTE(((SUPPORT_VIQE_MAX_WIDTH * SUPPORT_VIQE_MAX_HEIGHT *2) + (SUPPORT_VIQE_MAX_WIDTH * SUPPORT_VIQE_MAX_HEIGHT / 8)) * 6)
#define SIZE_VIQE_TCC			ARRAY_MBYTE((SUPPORT_VIQE_MAX_WIDTH * (SUPPORT_VIQE_MAX_HEIGHT / 2 ) * 4 * 4 * 3) / 2)
#else
#define SIZE_VIQE_MADI			0
#define SIZE_VIQE_TCC			ARRAY_MBYTE((SUPPORT_VIQE_MAX_WIDTH * (SUPPORT_VIQE_MAX_HEIGHT / 2 ) * 4 * 4 * 3) / 2)
#endif
#if (SIZE_VIQE_MADI > SIZE_VIQE_TCC)
#define SIZE_VIQE0				(SIZE_VIQE_MADI)
#else
#define SIZE_VIQE0				(SIZE_VIQE_TCC)
#endif
#ifdef CONFIG_TCC_VIQE_FOR_SUB_M2M
#define SIZE_VIQE1				ARRAY_MBYTE((SUPPORT_VIQE_MAX_WIDTH * (SUPPORT_VIQE_MAX_HEIGHT / 2 ) * 4 * 4 * 3) / 2)
#else
#define SIZE_VIQE1				0x00000000
#endif

#if defined(CONFIG_TCC_DISPLAY_MODE_USE) || defined(CONFIG_TCC_ATTACH)
#define SIZE_OUTPUT_ATTACH		(ARRAY_MBYTE(SECONDARY_TARGET_WIDTH * SECONDARY_TARGET_HEIGHT* 4 * 3))
#else
#define SIZE_OUTPUT_ATTACH		0x00000000
#endif

#ifdef CONFIG_ANDROID
#define SIZE_V4L2_VOUT0			0x00000000
#define SIZE_V4L2_VOUT1			0x00000000
#else
#define SIZE_V4L2_VOUT0			ARRAY_MBYTE(SUPPORT_DISPLAY_MAX_WIDTH * SUPPORT_DISPLAY_MAX_HEIGHT * 2 * 3)
#if defined(CONFIG_ARCH_TCC805X)
#define SIZE_V4L2_VOUT1			ARRAY_MBYTE(SUPPORT_DISPLAY_MAX_WIDTH * SUPPORT_DISPLAY_MAX_HEIGHT * 2 * 3)
#else
#define SIZE_V4L2_VOUT1			0x00000000
#endif
#endif


#ifdef CONFIG_USE_FORCE_8BIT_OUT_LASTFRAME
#define BPP_FACTOR 1
#else
#define BPP_FACTOR 2 //10bit
#endif

#define SWAP_BUFFER_FB_WMIXER	ARRAY_MBYTE((((SUPPORT_VIDEO_MAX_WIDTH * 25 / 10) * SUPPORT_VIDEO_MAX_HEIGHT * 15 / 10) + 0x80000) * 2)
#define LAST_BUFFER_FB_WMIXER	ARRAY_MBYTE(SUPPORT_DISPLAY_MAX_WIDTH * SUPPORT_DISPLAY_MAX_HEIGHT * 2 * BPP_FACTOR)
#define EXT_BUFFER_FB_WMIXER	ARRAY_MBYTE(SUPPORT_DISPLAY_MAX_WIDTH * SUPPORT_DISPLAY_MAX_HEIGHT * 2 * BPP_FACTOR * 2)

#ifdef CONFIG_PLATFORM_AVN
	#ifdef CONFIG_ANDROID
	#define SIZE_FB_WMIXER		(EXT_BUFFER_FB_WMIXER)
	#else
	#define SIZE_FB_WMIXER		0x01000000
	#endif
#else
	#if (SWAP_BUFFER_FB_WMIXER > LAST_BUFFER_FB_WMIXER)
		#define SIZE_FB_WMIXER		(SWAP_BUFFER_FB_WMIXER)
	#else
		#define SIZE_FB_WMIXER		(LAST_BUFFER_FB_WMIXER)
	#endif
#endif

#ifdef CONFIG_PLATFORM_AVN
	#ifdef CONFIG_ANDROID
	#define SIZE_OSD		0x00000000
	#else
	#define SIZE_OSD		0x01d00000 //2560 * 1440 * 4 * 2
	#endif
#else
	#define SIZE_OSD		0x00000000
#endif


#define SIZE_VIDEO_DUAL		0x00000000

#if defined(CONFIG_TCC_DUAL_DISPLAY)
#define SIZE_DUAL_DISPLAY		ARRAY_MBYTE(SUPPORT_DISPLAY_MAX_WIDTH * SUPPORT_DISPLAY_MAX_HEIGHT * 2 * 3 * 2)
#else
#define SIZE_DUAL_DISPLAY		0x00000000
#endif

////////////////////////////////////////////////////////////////////////////////
#ifdef CONFIG_PMAP_TO_CMA
#define CMA_SIZE_OVERLAY			(SIZE_OVERLAY)
#define CMA_SIZE_OVERLAY1			(SIZE_OVERLAY1)
#define CMA_SIZE_OVERLAY_ROT		0x00000000//(SIZE_OVERLAY_ROT)
#define CMA_SIZE_VIQE0				(SIZE_VIQE0)
#define CMA_SIZE_VIQE1				0x00000000//(SIZE_VIQE1)
#define CMA_SIZE_OUTPUT_ATTACH		0x00000000//(SIZE_OUTPUT_ATTACH)
#define CMA_SIZE_V4L2_VOUT0			0x00000000//(SIZE_V4L2_VOUT0)
#define CMA_SIZE_V4L2_VOUT1			0x00000000//(SIZE_V4L2_VOUT1)
#define CMA_SIZE_VIDEO_DUAL			0x00000000//(SIZE_VIDEO_DUAL)
#define CMA_SIZE_FB_WMIXER			(SIZE_FB_WMIXER)

#define PMAP_SIZE_OVERLAY			0x00000000//SIZE_OVERLAY
#define PMAP_SIZE_OVERLAY1			0x00000000//SIZE_OVERLAY1
#define PMAP_SIZE_OVERLAY_ROT		SIZE_OVERLAY_ROT
#define PMAP_SIZE_VIQE0				0x00000000//SIZE_VIQE0
#define PMAP_SIZE_VIQE1				SIZE_VIQE1
#define PMAP_SIZE_OUTPUT_ATTACH		SIZE_OUTPUT_ATTACH
#define PMAP_SIZE_V4L2_VOUT0		SIZE_V4L2_VOUT0
#define PMAP_SIZE_V4L2_VOUT1		SIZE_V4L2_VOUT1
#define PMAP_SIZE_VIDEO_DUAL		SIZE_VIDEO_DUAL
#define PMAP_SIZE_DUAL_DISPLAY		SIZE_DUAL_DISPLAY
#define PMAP_SIZE_FB_WMIXER			0x00000000//SIZE_FB_WMIXER
#else
#define CMA_SIZE_OVERLAY			0x00000000
#define CMA_SIZE_OVERLAY1			0x00000000
#define CMA_SIZE_OVERLAY_ROT		0x00000000
#define CMA_SIZE_VIQE0				0x00000000
#define CMA_SIZE_VIQE1				0x00000000
#define CMA_SIZE_OUTPUT_ATTACH		0x00000000
#define CMA_SIZE_V4L2_VOUT0			0x00000000
#define CMA_SIZE_V4L2_VOUT1			0x00000000
#define CMA_SIZE_VIDEO_DUAL			0x00000000
#define CMA_SIZE_FB_WMIXER			0x00000000

#define PMAP_SIZE_OVERLAY			(SIZE_OVERLAY)
#define PMAP_SIZE_OVERLAY1			(SIZE_OVERLAY1)
#define PMAP_SIZE_OVERLAY_ROT		(SIZE_OVERLAY_ROT)
#define PMAP_SIZE_VIQE0				(SIZE_VIQE0)
#define PMAP_SIZE_VIQE1				(SIZE_VIQE1)
#define PMAP_SIZE_OUTPUT_ATTACH		(SIZE_OUTPUT_ATTACH)
#define PMAP_SIZE_V4L2_VOUT0		(SIZE_V4L2_VOUT0)
#define PMAP_SIZE_V4L2_VOUT1		(SIZE_V4L2_VOUT1)
#define PMAP_SIZE_OSD			(SIZE_OSD)
#define PMAP_SIZE_VIDEO_DUAL		(SIZE_VIDEO_DUAL)
#define PMAP_SIZE_DUAL_DISPLAY		(SIZE_DUAL_DISPLAY)
#define PMAP_SIZE_FB_WMIXER			(SIZE_FB_WMIXER)
#endif
#endif

#define PMAP_SIZE_SECURE_AREA_2		( 0x1000 \
									+ PMAP_SIZE_OVERLAY \
									+ PMAP_SIZE_OVERLAY1 \
									+ PMAP_SIZE_OVERLAY_ROT \
									+ PMAP_SIZE_VIQE0 \
									+ PMAP_SIZE_VIQE1 \
									+ PMAP_SIZE_OUTPUT_ATTACH \
									+ PMAP_SIZE_V4L2_VOUT0 \
									+ PMAP_SIZE_V4L2_VOUT1 \
									+ PMAP_SIZE_VIDEO_DUAL \
									+ PMAP_SIZE_OSD \
									+ PMAP_SIZE_DUAL_DISPLAY \
									+ PMAP_SIZE_FB_WMIXER \
									)

/*-----------------------------------------------------------
 * Secure Area 3 (CPU X, VPU R/W, GPU X, VIOC R)
 *-----------------------------------------------------------
 */
#ifdef CONFIG_ANDROID
#define SIZE_SECURE_INBUF		0x00C00000
#else
#define SIZE_SECURE_INBUF		0x00000000
#endif
#define SIZE_VIDEO_EXT			(VIDEO_SUB_SIZE)
#define SIZE_VIDEO_EXT2		(VIDEO_SUB2_SIZE)
#define PMAP_SIZE_ENC				(ENC_SIZE) // ahared mem in video pmap.
#define SIZE_VIDEO				(VIDEO_MAIN_SIZE + ENC_SIZE)
#define SIZE_VIDEO_SW_EXTRA	VPU_SW_ACCESS_REGION_SIZE

////////////////////////////////////////////////////////////////////////////////
#ifdef CONFIG_PMAP_TO_CMA
#define CMA_SIZE_SECURE_INBUF		(SIZE_SECURE_INBUF)
#define CMA_SIZE_VIDEO_EXT			(SIZE_VIDEO_EXT)
#define CMA_SIZE_VIDEO_EXT2			(SIZE_VIDEO_EXT2)
#define CMA_SIZE_VIDEO				(SIZE_VIDEO)

#define PMAP_SIZE_SECURE_INBUF		0x00000000//SIZE_SECURE_INBUF
#define PMAP_SIZE_VIDEO_EXT			0x00000000//SIZE_VIDEO_EXT
#define PMAP_SIZE_VIDEO_EXT2		0x00000000//SIZE_VIDEO_EXT2
#define PMAP_SIZE_VIDEO				0x00000000//SIZE_VIDEO
#else
#define CMA_SIZE_SECURE_INBUF		0x00000000
#define CMA_SIZE_VIDEO_EXT			0x00000000
#define CMA_SIZE_VIDEO_EXT2			0x00000000
#define CMA_SIZE_VIDEO				0x00000000

#define PMAP_SIZE_SECURE_INBUF		SIZE_SECURE_INBUF
#define PMAP_SIZE_VIDEO_EXT			SIZE_VIDEO_EXT
#define PMAP_SIZE_VIDEO_EXT2		SIZE_VIDEO_EXT2
#define PMAP_SIZE_VIDEO				SIZE_VIDEO
#endif

#define PMAP_SIZE_SECURE_AREA_3		( 0x1000 \
									+ PMAP_SIZE_SECURE_INBUF \
									+ PMAP_SIZE_VIDEO_EXT \
									+ PMAP_SIZE_VIDEO_EXT2 \
									+ PMAP_SIZE_VIDEO \
									)

/*-----------------------------------------------------------
 * Secure Area 4 (CPU X, VPU X, GPU R/W, VIOC R/W)
 *-----------------------------------------------------------
 */
#ifdef CONFIG_ANDROID
#ifdef CONFIG_TCC_VIDEO_S_FEATURE
#define SIZE_UMP_RESERVED		(ARRAY_MBYTE((ARRAY_256KBYTE((SUPPORT_VIDEO_MAX_WIDTH * SUPPORT_VIDEO_MAX_HEIGHT * 3) / 2)) * 18) + (1*SZ_1MB)) // 1MB for specific streaming case!!
#else
#define SIZE_UMP_RESERVED		(ARRAY_MBYTE((ARRAY_256KBYTE((SUPPORT_VIDEO_MAX_WIDTH * SUPPORT_VIDEO_MAX_HEIGHT * 3) / 2)) * 12) + (1*SZ_1MB)) // 1MB for specific streaming case!!
#endif
#define SIZE_UMP_RESERVED_SW	0x00040000 //256KB = 2KB * 128
#ifdef CONFIG_ION_CARVEOUT_CAM_HEAP
#define SIZE_ION_CARVEOUT_CAM	(12*SZ_1MB)
#else
#define SIZE_ION_CARVEOUT_CAM      0x00000000
#endif
#else
#define SIZE_UMP_RESERVED		0x00000000
#define SIZE_UMP_RESERVED_SW	0x00000000
#define SIZE_ION_CARVEOUT_CAM	(32*SZ_1MB)
#endif

#define CMA_SIZE_UMP_RESERVED			0x00000000
#define CMA_SIZE_ION_CARVEOUT_CAM		0x00000000

///////////////////////////////////////////////////////////////////////////
#ifdef CONFIG_PMAP_TO_CMA
#define CMA_SIZE_UMP_RESERVED			(SIZE_UMP_RESERVED)
#define CMA_SIZE_ION_CARVEOUT_CAM		(SIZE_ION_CARVEOUT_CAM)

#define PMAP_SIZE_UMP_RESERVED			0x00000000//SIZE_UMP_RESERVED
#define PMAP_SIZE_ION_CARVEOUT_CAM		0x00000000//SIZE_ION_CARVEOUT_CAM

#else
#define CMA_SIZE_UMP_RESERVED			0x00000000//(SIZE_UMP_RESERVED)
#define CMA_SIZE_ION_CARVEOUT_CAM		0x00000000//(SIZE_ION_CARVEOUT_CAM)

#define PMAP_SIZE_UMP_RESERVED			SIZE_UMP_RESERVED
#define PMAP_SIZE_ION_CARVEOUT_CAM		SIZE_ION_CARVEOUT_CAM

#endif

#define PMAP_SIZE_SECURE_AREA_4		( 0x1000 \
									+ PMAP_SIZE_UMP_RESERVED \
									+ PMAP_SIZE_ION_CARVEOUT_CAM \
									)

/*-----------------------------------------------------------
 * Default Reserved Memory
 *-----------------------------------------------------------
 */
#define SIZE_SECURE_EXP			0x00000000
#define SIZE_ENCED_TS			0x00000000
#define SIZE_VIDEO_THUMB		0x00000000
#define SIZE_VIDEO_SBACKUP		0x00000000

#ifdef CONFIG_VIOC_DOLBY_VISION_EDR
#define SIZE_DOLBY_REGS		0x01400000
#else
#define SIZE_DOLBY_REGS		0x00000000
#endif

#define SIZE_EXT_CAMERA		0x00000000

#ifdef CONFIG_ANDROID
#define SIZE_V4L2_SUBTITLE		0x00000000
#define SIZE_ITAPI_FIFO		0x00000000
#else
#define SIZE_V4L2_SUBTITLE		0x00000000      //ARRAY_MBYTE(SUPPORT_VIDEO_MAX_WIDTH * SUPPORT_VIDEO_MAX_HEIGHT * 4 * 2)
#define SIZE_ITAPI_FIFO		0x02400000
#endif

#define SIZE_PMEM				0x00000000
#define SIZE_NAND_MEM			0x00000000
#define SIZE_TSIF				0x00400000
#define SIZE_RAMOOPS			0x00100000
#define SIZE_JPG_ENC_DXB		0x00000000	//0x00300000
#define SIZE_JPG_RAW_DXB		0x00000000	//0x00300000

#define SIZE_ENC_EXT			(ENC_EXT_SIZE)
#define SIZE_ENC_EXT2			(ENC_EXT2_SIZE)
#define SIZE_ENC_EXT3			(ENC_EXT3_SIZE)
#define SIZE_ENC_EXT4			(ENC_EXT4_SIZE)
#define SIZE_ENC_EXT5			(ENC_EXT5_SIZE)
#define SIZE_ENC_EXT6			(ENC_EXT6_SIZE)
#define SIZE_ENC_EXT7			(ENC_EXT7_SIZE)

/////////////////////////////////////////////////////////////////////////
#ifdef CONFIG_PMAP_TO_CMA
#define CMA_SIZE_SECURE_EXP				0x00000000//SIZE_SECURE_EXP
#define CMA_SIZE_ENCED_TS				0x00000000//SIZE_ENCED_TS
#define CMA_SIZE_VIDEO_THUMB			0x00000000//SIZE_VIDEO_THUMB
#define CMA_SIZE_DOLBY_REGS			0x00000000//SIZE_DOLBY_REGS
#define CMA_SIZE_VIDEO_SBACKUP			0x00000000//SIZE_VIDEO_SBACKUP
#define CMA_SIZE_EXT_CAMERA			0x00000000//SIZE_EXT_CAMERA
#define CMA_SIZE_V4L2_SUBTITLE			0x00000000//SIZE_V4L2_SUBTITLE
#define CMA_SIZE_PMEM					0x00000000//SIZE_PMEM
#define CMA_SIZE_NAND_MEM				0x00000000//SIZE_NAND_MEM
#define CMA_SIZE_TSIF					0x00000000//SIZE_TSIF
#define CMA_SIZE_ITAPI_FIFO			0x00000000//SIZE_ITAPI_FIFO
#define CMA_SIZE_RAMOOPS				0x00000000//SIZE_RAMOOPS
#define CMA_SIZE_JPG_ENC_DXB			0x00000000//SIZE_JPG_ENC_DXB
#define CMA_SIZE_JPG_RAW_DXB			0x00000000//SIZE_JPG_RAW_DXB
#define CMA_SIZE_ENC_EXT				0x00000000//SIZE_ENC_EXT
#define CMA_SIZE_ENC_EXT2				0x00000000//SIZE_ENC_EXT2
#define CMA_SIZE_ENC_EXT3				0x00000000//SIZE_ENC_EXT3
#define CMA_SIZE_ENC_EXT4				0x00000000//SIZE_ENC_EXT4
#define CMA_SIZE_ENC_EXT5 				0x00000000//SIZE_ENC_EXT5
#define CMA_SIZE_ENC_EXT6 				0x00000000//SIZE_ENC_EXT6
#define CMA_SIZE_ENC_EXT7 				0x00000000//SIZE_ENC_EXT7
#define CMA_SIZE_VIDEO_SW_EXTRA		SIZE_VIDEO_SW_EXTRA
#define CMA_SIZE_UMP_RESERVED_SW		SIZE_UMP_RESERVED_SW


#define PMAP_SIZE_SECURE_EXP			SIZE_SECURE_EXP
#define PMAP_SIZE_ENCED_TS				SIZE_ENCED_TS
#define PMAP_SIZE_VIDEO_THUMB			SIZE_VIDEO_THUMB
#define PMAP_SIZE_DOLBY_REGS			SIZE_DOLBY_REGS
#define PMAP_SIZE_VIDEO_SBACKUP		SIZE_VIDEO_SBACKUP
#define PMAP_SIZE_EXT_CAMERA			SIZE_EXT_CAMERA
#define PMAP_SIZE_V4L2_SUBTITLE		SIZE_V4L2_SUBTITLE
#define PMAP_SIZE_PMEM					SIZE_PMEM
#define PMAP_SIZE_NAND_MEM				SIZE_NAND_MEM
#define PMAP_SIZE_TSIF					SIZE_TSIF
#define PMAP_SIZE_ITAPI_FIFO			SIZE_ITAPI_FIFO
#define PMAP_SIZE_RAMOOPS				SIZE_RAMOOPS
#define PMAP_SIZE_JPG_ENC_DXB			SIZE_JPG_ENC_DXB
#define PMAP_SIZE_JPG_RAW_DXB			SIZE_JPG_RAW_DXB
#define PMAP_SIZE_ENC_EXT				SIZE_ENC_EXT
#define PMAP_SIZE_ENC_EXT2				SIZE_ENC_EXT2
#define PMAP_SIZE_ENC_EXT3				SIZE_ENC_EXT3
#define PMAP_SIZE_ENC_EXT4				SIZE_ENC_EXT4
#define PMAP_SIZE_ENC_EXT5 				SIZE_ENC_EXT5
#define PMAP_SIZE_ENC_EXT6 				SIZE_ENC_EXT6
#define PMAP_SIZE_ENC_EXT7 				SIZE_ENC_EXT7
#define PMAP_SIZE_VIDEO_SW_EXTRA		0x00000000//SIZE_VIDEO_SW_EXTRA
#define PMAP_SIZE_UMP_RESERVED_SW		0x00000000//SIZE_UMP_RESERVED_SW
#else
#define CMA_SIZE_SECURE_EXP				0x00000000
#define CMA_SIZE_ENCED_TS				0x00000000
#define CMA_SIZE_VIDEO_THUMB			0x00000000
#define CMA_SIZE_DOLBY_REGS			0x00000000
#define CMA_SIZE_VIDEO_SBACKUP			0x00000000
#define CMA_SIZE_EXT_CAMERA			0x00000000
#define CMA_SIZE_V4L2_SUBTITLE			0x00000000
#define CMA_SIZE_PMEM					0x00000000
#define CMA_SIZE_NAND_MEM				0x00000000
#define CMA_SIZE_TSIF					0x00000000
#define CMA_SIZE_ITAPI_FIFO			0x00000000
#define CMA_SIZE_RAMOOPS				0x00000000
#define CMA_SIZE_JPG_ENC_DXB			0x00000000
#define CMA_SIZE_JPG_RAW_DXB			0x00000000
#define CMA_SIZE_ENC_EXT				0x00000000
#define CMA_SIZE_ENC_EXT2				0x00000000
#define CMA_SIZE_ENC_EXT3				0x00000000
#define CMA_SIZE_ENC_EXT4				0x00000000
#define CMA_SIZE_ENC_EXT5 				0x00000000
#define CMA_SIZE_ENC_EXT6 				0x00000000
#define CMA_SIZE_ENC_EXT7 				0x00000000
#define CMA_SIZE_VIDEO_SW_EXTRA		0x00000000
#define CMA_SIZE_UMP_RESERVED_SW		0x00000000

#define PMAP_SIZE_SECURE_EXP			SIZE_SECURE_EXP
#define PMAP_SIZE_ENCED_TS				SIZE_ENCED_TS
#define PMAP_SIZE_VIDEO_THUMB			SIZE_VIDEO_THUMB
#define PMAP_SIZE_DOLBY_REGS			SIZE_DOLBY_REGS
#define PMAP_SIZE_VIDEO_SBACKUP		SIZE_VIDEO_SBACKUP
#define PMAP_SIZE_EXT_CAMERA			SIZE_EXT_CAMERA
#define PMAP_SIZE_V4L2_SUBTITLE		SIZE_V4L2_SUBTITLE
#define PMAP_SIZE_PMEM					SIZE_PMEM
#define PMAP_SIZE_NAND_MEM				SIZE_NAND_MEM
#define PMAP_SIZE_TSIF					SIZE_TSIF
#define PMAP_SIZE_ITAPI_FIFO			SIZE_ITAPI_FIFO
#define PMAP_SIZE_RAMOOPS				SIZE_RAMOOPS
#define PMAP_SIZE_JPG_ENC_DXB			SIZE_JPG_ENC_DXB
#define PMAP_SIZE_JPG_RAW_DXB			SIZE_JPG_RAW_DXB
#define PMAP_SIZE_ENC_EXT				SIZE_ENC_EXT
#define PMAP_SIZE_ENC_EXT2				SIZE_ENC_EXT2
#define PMAP_SIZE_ENC_EXT3				SIZE_ENC_EXT3
#define PMAP_SIZE_ENC_EXT4				SIZE_ENC_EXT4
#define PMAP_SIZE_ENC_EXT5 				SIZE_ENC_EXT5
#define PMAP_SIZE_ENC_EXT6 				SIZE_ENC_EXT6
#define PMAP_SIZE_ENC_EXT7 				SIZE_ENC_EXT7
#define PMAP_SIZE_VIDEO_SW_EXTRA		SIZE_VIDEO_SW_EXTRA
#define PMAP_SIZE_UMP_RESERVED_SW		SIZE_UMP_RESERVED_SW

#endif

#define PMAP_SIZE_TOTAL_RESERVED	( 0x0 \
									+ PMAP_SIZE_SECURE_EXP \
									+ PMAP_SIZE_ENCED_TS \
									+ PMAP_SIZE_VIDEO_THUMB \
									+ PMAP_SIZE_DOLBY_REGS \
									+ PMAP_SIZE_CMA \
									+ PMAP_SIZE_VIDEO_SBACKUP \
									+ PMAP_SIZE_EXT_CAMERA \
									+ PMAP_SIZE_V4L2_SUBTITLE \
									+ PMAP_SIZE_PMEM \
									+ PMAP_SIZE_NAND_MEM \
									+ PMAP_SIZE_TSIF \
									+ PMAP_SIZE_ITAPI_FIFO \
									+ PMAP_SIZE_RAMOOPS \
									+ PMAP_SIZE_JPG_ENC_DXB \
									+ PMAP_SIZE_JPG_RAW_DXB \
									+ PMAP_SIZE_ENC_EXT \
									+ PMAP_SIZE_ENC_EXT2 \
									+ PMAP_SIZE_ENC_EXT3 \
									+ PMAP_SIZE_ENC_EXT4 \
									+ PMAP_SIZE_ENC_EXT5 \
									+ PMAP_SIZE_ENC_EXT6 \
									+ PMAP_SIZE_ENC_EXT7 \
									+ PMAP_SIZE_VIDEO_SW_EXTRA \
									+ PMAP_SIZE_UMP_RESERVED_SW \
									)

/*-----------------------------------------------------------
 * Shared Memory with pmap_viqe
 *-----------------------------------------------------------
 */
#define PMAP_SIZE_JPEG_HEADER		0x00100000
#define PMAP_SIZE_JPEG_STREAM		0x00500000
#define PMAP_SIZE_JPEG_RAW			0x00f00000

/*-----------------------------------------------------------
 * compatible = "shared-dma-pool";
 *-----------------------------------------------------------
 */
#define PMAP_SIZE_CMA				0x00000000	//0x04000000	/* 64 MiB */

/*-----------------------------------------------------------
 * compatible = "telechips,pmap";	secure_xxx : 0x2c00_0000~ (12MiB)
 *-----------------------------------------------------------
 */
#define PMAP_BASE_SECURE_TSIF			0x2c000000
#define PMAP_SIZE_SECURE_TSIF			0x00400000
#define PMAP_BASE_SECURE_SAP			0x2c400000
#define PMAP_SIZE_SECURE_SAP			0x00800000

/*-----------------------------------------------------------
 * compatible = "telechips,pmap";	prot_xxx : 0x2cc0_0000~ (20MiB)
 *-----------------------------------------------------------
 */
#define PMAP_BASE_PROT_CA7_FW			0x2cc00000
#define PMAP_SIZE_PROT_CA7_FW			0x00c00000
#define PMAP_BASE_PROT_VPU_FW			0x2d800000
#define PMAP_SIZE_PROT_VPU_FW			0x00700000
#define PMAP_BASE_PROT_ESM_FW			0x2df00000
#define PMAP_SIZE_PROT_ESM_FW			0x00100000

/*-----------------------------------------------------------
 * compatible = "optee.os";			- : 0x2e00_0000~ (32MiB)
 *-----------------------------------------------------------
 */
#define PMAP_BASE_OPTEE_OS			0x2e000000
#define PMAP_SIZE_OPTEE_OS			0x02000000


#if 0
#define SECURED_MEM_BASE	0x30000000
#define SECURED_MEM_SIZE	0x36000000 /* 768 MiB */

#define RESERVED_MEM_BASE	0x30000000
#define RESERVED_MEM_SIZE	0x56000000 /* 1280 MiB */

#else

#ifdef CONFIG_PLATFORM_AVN
#define V4L2_VIDEO0_SIZE		0x01800000
#else
#define V4L2_VIDEO0_SIZE		0x00000000
#endif
#define V4L2_VIDEO1_SIZE		0x00000000
#define V4L2_VIDEO2_SIZE		0x00000000
#define V4L2_VIDEO3_SIZE		0x00000000
#define V4L2_VIDEO4_SIZE		0x00000000

#ifdef CONFIG_PLATFORM_AVN
#define MICOM_IPC_SIZE			0x00200000
#ifdef CONFIG_VIDEO_VIDEOSOURCE_VIDEODECODER_DS90UB964
#define SVM_SIZE			ARRAY_MBYTE(CAMERA_INPUT_WIDTH * CAMERA_INPUT_HEIGHT * 4 * 4 * 4)	// width * heith * color depth * frame * channel
#else
#define SVM_SIZE			0x00000000
#endif
#else
#define MICOM_IPC_SIZE		0x00000000
#define SVM_SIZE			0x00000000
#endif



#define SPACE	0x00100000

#if defined(CONFIG_ARCH_TCC805X) && !defined(CONFIG_TCC805X_CLUSTER)
#define PMAP_BASE	(0x80000000)
#elif defined(CONFIG_TCC805X_CLUSTER)
#define PMAP_BASE	(0x40000000)
#elif defined(CONFIG_ARCH_TCC897X)
#define PMAP_BASE	(0x87800000)
#else
#ifdef CONFIG_ANDROID
#define PMAP_BASE	(0x40000000) // In case of Android, Most significant bit should be zero. otherwise mmap operation is failed because mmap will recognize it into negative value.
#else
#ifdef CONFIG_PLATFORM_AVN
#define PMAP_BASE	(0x40800000)
#else
#define PMAP_BASE	(0x60000000)
#endif
#endif
#endif

#if defined(CONFIG_POWERVR_VZ)
#define PVR_VZ_SIZE		(0x4100000)
#else
#define PVR_VZ_SIZE             (0)
#endif

#define PVR_VZ_BASE             (PMAP_BASE)
#define EARLY_REARCAM_BASE	(PVR_VZ_BASE + PVR_VZ_SIZE)

#ifdef CONFIG_PLATFORM_AVN
#if defined(CONFIG_PMAP_SUBCORE) && defined(CONFIG_ARCH_TCC803X)
#define EARLY_REARCAM_SIZE	(0)
#else
#define EARLY_REARCAM_SIZE	(PMAP_SIZE_EARLY_REARCAM + SPACE)
#endif
#else
#define EARLY_REARCAM_SIZE	(0)
#endif

#define SECURE_AREA_1_BASE  (EARLY_REARCAM_BASE+EARLY_REARCAM_SIZE)
#define SECURE_AREA_1_SIZE	(PMAP_SIZE_SECURE_AREA_1 + SPACE)

#define SECURE_AREA_2_BASE	(SECURE_AREA_1_BASE + SECURE_AREA_1_SIZE)
#define SECURE_AREA_2_SIZE	(PMAP_SIZE_SECURE_AREA_2 + SPACE)

#define SECURE_AREA_3_BASE	(SECURE_AREA_2_BASE + SECURE_AREA_2_SIZE)
#define SECURE_AREA_3_SIZE	(PMAP_SIZE_SECURE_AREA_3 + SPACE)

#define SECURE_AREA_4_BASE	(SECURE_AREA_3_BASE + SECURE_AREA_3_SIZE)
#define SECURE_AREA_4_SIZE	((PMAP_SIZE_SECURE_AREA_4) + SPACE)

#define RESERVED_MEM_BASE	(SECURE_AREA_4_BASE + SECURE_AREA_4_SIZE)

/////////////////////////////////////////////////////////////////////////
#ifdef CONFIG_PMAP_TO_CMA
#define CMA_V4L2_VIDEO0_SIZE			0x00000000//V4L2_VIDEO0_SIZE
#define CMA_V4L2_VIDEO1_SIZE			0x00000000//V4L2_VIDEO1_SIZE
#define CMA_V4L2_VIDEO2_SIZE			0x00000000//V4L2_VIDEO2_SIZE
#define CMA_V4L2_VIDEO3_SIZE			0x00000000//V4L2_VIDEO3_SIZE
#define CMA_V4L2_VIDEO4_SIZE			0x00000000//V4L2_VIDEO4_SIZE
#define CMA_MICOM_IPC_SIZE				0x00000000//MICOM_IPC_SIZE
#define CMA_SVM_SIZE					0x00000000//SVM_SIZE

#define PMAP_V4L2_VIDEO0_SIZE			V4L2_VIDEO0_SIZE
#define PMAP_V4L2_VIDEO1_SIZE			V4L2_VIDEO1_SIZE
#define PMAP_V4L2_VIDEO2_SIZE			V4L2_VIDEO2_SIZE
#define PMAP_V4L2_VIDEO3_SIZE			V4L2_VIDEO3_SIZE
#define PMAP_V4L2_VIDEO4_SIZE			V4L2_VIDEO4_SIZE
#define PMAP_MICOM_IPC_SIZE				MICOM_IPC_SIZE
#define PMAP_SVM_SIZE					SVM_SIZE

#else
#define CMA_V4L2_VIDEO0_SIZE			0x00000000
#define CMA_V4L2_VIDEO1_SIZE			0x00000000
#define CMA_V4L2_VIDEO2_SIZE			0x00000000
#define CMA_V4L2_VIDEO3_SIZE			0x00000000
#define CMA_V4L2_VIDEO4_SIZE			0x00000000
#define CMA_MICOM_IPC_SIZE				0x00000000
#define CMA_SVM_SIZE					0x00000000

#define PMAP_V4L2_VIDEO0_SIZE			V4L2_VIDEO0_SIZE
#define PMAP_V4L2_VIDEO1_SIZE			V4L2_VIDEO1_SIZE
#define PMAP_V4L2_VIDEO2_SIZE			V4L2_VIDEO2_SIZE
#define PMAP_V4L2_VIDEO3_SIZE			V4L2_VIDEO3_SIZE
#define PMAP_V4L2_VIDEO4_SIZE			V4L2_VIDEO4_SIZE
#define PMAP_MICOM_IPC_SIZE				MICOM_IPC_SIZE
#define PMAP_SVM_SIZE					SVM_SIZE

#endif

#define RESERVED_MEM_SIZE	(PMAP_SIZE_TOTAL_RESERVED + (SPACE * 10) \
							+ PMAP_V4L2_VIDEO0_SIZE \
							+ PMAP_V4L2_VIDEO1_SIZE \
							+ PMAP_V4L2_VIDEO2_SIZE \
							+ PMAP_V4L2_VIDEO3_SIZE \
							+ PMAP_V4L2_VIDEO4_SIZE \
							+ PMAP_MICOM_IPC_SIZE \
							+ PMAP_SVM_SIZE \
							)

#endif
