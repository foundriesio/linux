// SPDX-License-Identifier: (GPL-2.0-or-later OR MIT)
/*
 * Copyright (C) Telechips Inc.
 */

/dts-v1/;
/plugin/;

#define DT_OVERLAY

#include <dt-bindings/interrupt-controller/arm-gic.h>
#include <dt-bindings/clock/telechips,tcc901x-clks.h>
#include <dt-bindings/soc/tcc901x-pm.h>
#include <dt-bindings/display/tcc901x-vioc.h>
#include <dt-bindings/power/telechips,boot-mode.h>
#include <dt-bindings/gpio/gpio.h>

#include "tcc-pmap-901x-android-customized.dtsi"

#include <dt-bindings/pmap/tcc901x/pmap-tcc901x-android-ivi.h>
#include "tcc-pmap-common.dtsi"

#include "tcc9010-android-lpd4321-v0.1.dts"

