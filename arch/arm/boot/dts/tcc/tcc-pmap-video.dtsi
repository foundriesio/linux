// SPDX-License-Identifier: (GPL-2.0+ OR MIT)
/*
 * Copyright (C) Telechips Inc.
 */

////////////////////////////////////////////////////////////////////////////////
#ifndef TCC_PMAP_VIDEO_DTSI
#define TCC_PMAP_VIDEO_DTSI
////////////////////////////////////////////////////////////////////////////////

#if defined(CONF_ANDROID) && !defined(CONFIG_ANDROID)
	#define CONFIG_ANDROID
#endif

#if defined(CONF_ARCH_TCC803X) && !defined(CONFIG_ARCH_TCC803X)
	#define CONFIG_ARCH_TCC803X
#endif

#if defined(CONF_SUPPORT_TCC_WAVE410_HEVC) && !defined(CONFIG_SUPPORT_TCC_WAVE410_HEVC)
	#define CONFIG_SUPPORT_TCC_WAVE410_HEVC
#endif

#if defined(CONF_SUPPORT_TCC_JPU) && !defined(CONFIG_SUPPORT_TCC_JPU)
	#define CONFIG_SUPPORT_TCC_JPU
#endif

#if defined(CONF_VDEC_CNT_1) && !defined(CONFIG_VDEC_CNT_1)
	#define CONFIG_VDEC_CNT_1
#elif defined(CONF_VDEC_CNT_2) && !defined(CONFIG_VDEC_CNT_2)
	#define CONFIG_VDEC_CNT_2
#elif defined(CONF_VDEC_CNT_3) && !defined(CONFIG_VDEC_CNT_3)
	#define CONFIG_VDEC_CNT_3
#elif defined(CONF_VDEC_CNT_4) && !defined(CONFIG_VDEC_CNT_4)
	#define CONFIG_VDEC_CNT_4
#elif defined(CONF_VDEC_CNT_5) && !defined(CONFIG_VDEC_CNT_5)
	#define CONFIG_VDEC_CNT_5
#endif

#if defined(CONF_VENC_CNT_1) && !defined(CONFIG_VENC_CNT_1)
	#define CONFIG_VENC_CNT_1
#elif defined(CONF_VENC_CNT_2)  && !defined(CONFIG_VENC_CNT_2)
	#define CONFIG_VENC_CNT_2
#elif defined(CONF_VENC_CNT_3) && !defined(CONFIG_VENC_CNT_3)
	#define CONFIG_VENC_CNT_3
#elif defined(CONF_VENC_CNT_4) && !defined(CONFIG_VENC_CNT_4)
	#define CONFIG_VENC_CNT_4
#elif defined(CONF_VENC_CNT_5) && !defined(CONFIG_VENC_CNT_5)
	#define CONFIG_VENC_CNT_5
#endif

/************************* SYNC WITH tcc_vpu_wbuffer.h ************************/
#ifndef _VPU_WBUFFER_DTSI_
#define _VPU_WBUFFER_DTSI_

#define VPU_INST_MAX 5

#if defined(CONFIG_VENC_CNT_5)
	#define VPU_ENC_MAX_CNT 5
#elif defined(CONFIG_VENC_CNT_4)
	#define VPU_ENC_MAX_CNT 4
#elif defined(CONFIG_VENC_CNT_3)
	#define VPU_ENC_MAX_CNT 3
#elif defined(CONFIG_VENC_CNT_2)
	#define VPU_ENC_MAX_CNT 2
#elif defined(CONFIG_VENC_CNT_1)
	#define VPU_ENC_MAX_CNT 1
#else
	#define VPU_ENC_MAX_CNT 0
#endif

#define _CODEC_HANDLE_T_
#define _CODEC_RESULT_T_
#define _CODEC_ADDR_T_

#define INC_DEVICE_TREE_PMAP

#include "../../../../../drivers/char/vpu/vpu_type.h" // VPU video codec

#if defined(CONFIG_TYPE_C5)
#include "../../../../../include/video/tcc/TCC_VPUs_CODEC.h" // VPU video codec
#else
#include "../../../../../include/video/tcc/TCC_VPU_CODEC.h" // VPU video codec
#endif

#ifdef CONFIG_SUPPORT_TCC_JPU
	#if defined(JPU_C5)
	#include "../../../../../include/video/tcc/TCC_JPU_CODEC.h"
	#else
	#include "../../../../../include/video/tcc/TCC_JPU_C6.h"
	#endif
#endif

#ifdef CONFIG_SUPPORT_TCC_WAVE410_HEVC
#include "../../../../../include/video/tcc/TCC_HEVC_CODEC.h"
#endif

#ifdef CONFIG_SUPPORT_TCC_G2V2_VP9
#include "../../../../../include/video/tcc/TCC_VP9_CODEC.h"
#endif

#ifdef CONFIG_SUPPORT_TCC_WAVE512_4K_D2
#include "../../../../../include/video/tcc/TCC_VPU_4K_D2_CODEC.h"
#endif

#ifdef CONFIG_SUPPORT_TCC_WAVE420L_VPU_HEVC_ENC
#include "../../../../../include/video/tcc/TCC_VPU_HEVC_ENC_CODEC.h"
#endif

#define NUM_OF_MAIN_INSTANCE	(INST_1ST_USE + INST_2ND_USE)
#define NUM_OF_SUB_INSTANCE 	(INST_3RD_USE + INST_4TH_USE)

#define VPU_WORK_BUF_SIZE	(WORK_CODE_PARA_BUF_SIZE)

#ifdef CONFIG_SUPPORT_TCC_WAVE512_4K_D2 // HEVC/VP9
#define WAVExxx_WORK_BUF_SIZE	(WAVE5_WORK_CODE_BUF_SIZE)
#elif defined(CONFIG_SUPPORT_TCC_WAVE410_HEVC) // HEVC
#define WAVExxx_WORK_BUF_SIZE	(WAVE4_WORK_CODE_BUF_SIZE)
#else
#define WAVExxx_WORK_BUF_SIZE	(0)
#endif

#ifdef CONFIG_SUPPORT_TCC_G2V2_VP9 // VP9
#define G2V2_VP9_WORK_BUF_SIZE	(0) //(PAGE_ALIGN(VP9_WORK_CODE_BUF_SIZE))
#else
#define G2V2_VP9_WORK_BUF_SIZE	(0)
#endif

#ifdef CONFIG_SUPPORT_TCC_JPU
#define JPU_WORK_BUF_SIZE	(0) //(PAGE_ALIGN(JPU_WORK_CODE_BUF_SIZE))
#else
#define JPU_WORK_BUF_SIZE	(0)
#endif

#ifdef CONFIG_SUPPORT_TCC_WAVE420L_VPU_HEVC_ENC
#define VPU_HEVC_ENC_WORK_BUF_SIZE	(VPU_HEVC_ENC_WORK_CODE_BUF_SIZE)
#else
#define VPU_HEVC_ENC_WORK_BUF_SIZE	(0)
#endif

#if defined(CONFIG_VENC_CNT_1) || defined(CONFIG_VENC_CNT_2) || \
	defined(CONFIG_VENC_CNT_3) || defined(CONFIG_VENC_CNT_4) || \
	defined(CONFIG_VENC_CNT_5)
#if defined(CONFIG_SUPPORT_TCC_WAVE420L_VPU_HEVC_ENC)
#define ENC_HEADER_BUF_SIZE	(VPU_HEVC_ENC_HEADER_BUF_SIZE)
#else
#define ENC_HEADER_BUF_SIZE	(VPU_ENC_PUT_HEADER_SIZE)
#endif
#else
#define ENC_HEADER_BUF_SIZE	(0)
#endif

#ifdef CONFIG_SUPPORT_TCC_WAVE512_4K_D2 // HEVC/VP9
#define USER_DATA_BUF_SIZE (WAVE5_USERDATA_BUF_SIZE)
#elif defined(CONFIG_SUPPORT_TCC_WAVE410_HEVC)  // HEVC
#define USER_DATA_BUF_SIZE (WAVE4_USERDATA_BUF_SIZE)
#else
#define USER_DATA_BUF_SIZE (50*1024)
#endif

#if defined(CONFIG_TEST_VPU_DRAM_INTLV)
#define VPU_SW_ACCESS_REGION_SIZE (ARRAY_MBYTE(VPU_WORK_BUF_SIZE + WAVExxx_WORK_BUF_SIZE + G2V2_VP9_WORK_BUF_SIZE + JPU_WORK_BUF_SIZE + VPU_HEVC_ENC_WORK_BUF_SIZE + (ENC_HEADER_BUF_SIZE*VPU_ENC_MAX_CNT) + (USER_DATA_BUF_SIZE*VPU_INST_MAX) +(PS_SAVE_SIZE + SLICE_SAVE_SIZE + LARGE_STREAM_BUF_SIZE)))
#else
#define VPU_SW_ACCESS_REGION_SIZE (ARRAY_MBYTE(VPU_WORK_BUF_SIZE + WAVExxx_WORK_BUF_SIZE + G2V2_VP9_WORK_BUF_SIZE + JPU_WORK_BUF_SIZE + VPU_HEVC_ENC_WORK_BUF_SIZE + (ENC_HEADER_BUF_SIZE*VPU_ENC_MAX_CNT) + (USER_DATA_BUF_SIZE*VPU_INST_MAX)))
#endif
#endif //_VPU_WBUFFER_DTSI_
/************************* SYNC WITH tcc_vpu_wbuffer.h ************************/

#if (INST_1ST_IS_HEVC_TYPE > 0)
#define INST_1ST_PROC_SIZE		WAVE_CAL_PROCBUFFER(INST_1ST_USE, INST_1ST_VIDEO_WIDTH, INST_1ST_VIDEO_HEIGHT, INST_1ST_MAX_FRAMEBUFFERS)
#else
#define INST_1ST_PROC_SIZE		VPU_CAL_PROCBUFFER(INST_1ST_USE, INST_1ST_VIDEO_WIDTH, INST_1ST_VIDEO_HEIGHT, INST_1ST_MAX_FRAMEBUFFERS)
#endif

#if (INST_2ND_IS_HEVC_TYPE > 0)
#define INST_2ND_PROC_SIZE		WAVE_CAL_PROCBUFFER(INST_2ND_USE, INST_2ND_VIDEO_WIDTH, INST_2ND_VIDEO_HEIGHT, INST_2ND_MAX_FRAMEBUFFERS)
#else
#define INST_2ND_PROC_SIZE		VPU_CAL_PROCBUFFER(INST_2ND_USE, INST_2ND_VIDEO_WIDTH, INST_2ND_VIDEO_HEIGHT, INST_2ND_MAX_FRAMEBUFFERS)
#endif

#if ((INST_1ST_IS_HEVC_TYPE > 0 && INST_1ST_USE) | (INST_2ND_IS_HEVC_TYPE > 0 && INST_2ND_USE))
#define SUPPORT_HEVC_OF_MAIN_INSTANCE	(1)
#else
#define SUPPORT_HEVC_OF_MAIN_INSTANCE	(0)
#endif

#if ((INST_1ST_IS_HEVC_TYPE == 0 && INST_1ST_USE) | (INST_2ND_IS_HEVC_TYPE == 0 && INST_2ND_USE))
#define SUPPORT_VPU_OF_MAIN_INSTANCE	(1)
#else
#define SUPPORT_VPU_OF_MAIN_INSTANCE	(0)
#endif

// to support 3rd and 4th decoder with 1st and 2nd at the same time.
#if defined(CONFIG_VDEC_CNT_3) || defined(CONFIG_VDEC_CNT_4) || defined(CONFIG_VDEC_CNT_5)
	#if (INST_3RD_IS_HEVC_TYPE > 0)
	#define INST_3RD_PROC_SIZE		WAVE_CAL_PROCBUFFER(INST_3RD_USE, INST_3RD_VIDEO_WIDTH, INST_3RD_VIDEO_HEIGHT, INST_3RD_MAX_FRAMEBUFFERS)
	#else
	#define INST_3RD_PROC_SIZE		VPU_CAL_PROCBUFFER(INST_3RD_USE, INST_3RD_VIDEO_WIDTH, INST_3RD_VIDEO_HEIGHT, INST_3RD_MAX_FRAMEBUFFERS)
	#endif

	#if (INST_4TH_IS_HEVC_TYPE > 0)
	#define INST_4TH_PROC_SIZE		WAVE_CAL_PROCBUFFER(INST_4TH_USE, INST_4TH_VIDEO_WIDTH, INST_4TH_VIDEO_HEIGHT, INST_4TH_MAX_FRAMEBUFFERS)
	#else
	#define INST_4TH_PROC_SIZE		VPU_CAL_PROCBUFFER(INST_4TH_USE, INST_4TH_VIDEO_WIDTH, INST_4TH_VIDEO_HEIGHT, INST_4TH_MAX_FRAMEBUFFERS)
	#endif

	#if ((INST_3RD_IS_HEVC_TYPE > 0 && INST_3RD_USE) | (INST_4TH_IS_HEVC_TYPE > 0 && INST_4TH_USE))
	#define SUPPORT_HEVC_OF_SUB_INSTANCE	(1)
	#else
	#define SUPPORT_HEVC_OF_SUB_INSTANCE	(0)
	#endif

	#if ((INST_3RD_IS_HEVC_TYPE == 0 && INST_3RD_USE) | (INST_4TH_IS_HEVC_TYPE == 0 && INST_4TH_USE))
	#define SUPPORT_VPU_OF_SUB_INSTANCE	(1)
	#else
	#define SUPPORT_VPU_OF_SUB_INSTANCE	(0)
	#endif
#else // defined(CONFIG_VDEC_CNT_3) || defined(CONFIG_VDEC_CNT_4)  || defined(CONFIG_VDEC_CNT_5)
	#define INST_3RD_PROC_SIZE				(0)
	#define INST_4TH_PROC_SIZE				(0)
	#define SUPPORT_HEVC_OF_SUB_INSTANCE	(0)
	#define SUPPORT_VPU_OF_SUB_INSTANCE	(0)
#endif

#if (NUM_OF_MAIN_INSTANCE > 1)
#define VIDEO_MAIN_SIZE		ARRAY_MBYTE(INST_1ST_PROC_SIZE + INST_2ND_PROC_SIZE)
#else
#if (INST_1ST_PROC_SIZE > INST_2ND_PROC_SIZE)
#define VIDEO_MAIN_SIZE		ARRAY_MBYTE(INST_1ST_PROC_SIZE)
#else
#define VIDEO_MAIN_SIZE		ARRAY_MBYTE(INST_2ND_PROC_SIZE)
#endif
#endif

#if defined(CONFIG_VDEC_CNT_3) || defined(CONFIG_VDEC_CNT_4) || defined(CONFIG_VDEC_CNT_5)
#define VIDEO_SUB_SIZE		ARRAY_MBYTE(INST_3RD_PROC_SIZE + INST_4TH_PROC_SIZE)
#else
#define VIDEO_SUB_SIZE		ARRAY_MBYTE(0)
#endif

#if defined(CONFIG_VDEC_CNT_5)
	#if (INST_5TH_IS_HEVC_TYPE > 0)
	#define INST_5TH_PROC_SIZE	WAVE_CAL_PROCBUFFER(INST_5TH_USE, INST_5TH_VIDEO_WIDTH, INST_5TH_VIDEO_HEIGHT, INST_5TH_MAX_FRAMEBUFFERS)
	#else
	#define INST_5TH_PROC_SIZE	VPU_CAL_PROCBUFFER(INST_5TH_USE, INST_5TH_VIDEO_WIDTH, INST_5TH_VIDEO_HEIGHT, INST_5TH_MAX_FRAMEBUFFERS)
	#endif

#define VIDEO_SUB2_SIZE		ARRAY_MBYTE(INST_5TH_PROC_SIZE)
#else
#define VIDEO_SUB2_SIZE		ARRAY_MBYTE(0)
#endif

// Encoder
#if defined(CONFIG_SUPPORT_TCC_WAVE420L_VPU_HEVC_ENC)
#if defined(CONFIG_VENC_CNT_1) || defined(CONFIG_VENC_CNT_2) || defined(CONFIG_VENC_CNT_3) \
	|| defined(CONFIG_VENC_CNT_4) || defined(CONFIG_VENC_CNT_5)
	#if (INST_ENC_1ST_IS_HEVC_TYPE > 0)
	#define INST_1ST_ENC_PROC_SIZE VPU_HEVC_ENC_CAL_PROCBUFFER(INST_ENC_1ST_USE, INST_ENC_1ST_VIDEO_WIDTH, INST_ENC_1ST_VIDEO_HEIGHT, INST_ENC_1ST_MAX_FRAMEBUFFERS)
	#else
	#define INST_1ST_ENC_PROC_SIZE VPU_CAL_ENC_PROCBUFFER(INST_ENC_1ST_USE, INST_ENC_1ST_VIDEO_WIDTH, INST_ENC_1ST_VIDEO_HEIGHT, INST_ENC_1ST_MAX_FRAMEBUFFERS)
	#endif
#define ENC_SIZE ARRAY_MBYTE(INST_1ST_ENC_PROC_SIZE)
#else
#define ENC_SIZE ARRAY_MBYTE(0)
#endif
#if defined(CONFIG_VENC_CNT_2) || defined(CONFIG_VENC_CNT_3) || defined(CONFIG_VENC_CNT_4) \
	|| defined(CONFIG_VENC_CNT_5)
	#if (INST_ENC_2ND_IS_HEVC_TYPE > 0)
	#define INST_2ND_ENC_PROC_SIZE VPU_HEVC_ENC_CAL_PROCBUFFER(INST_ENC_2ND_USE, INST_ENC_2ND_VIDEO_WIDTH, INST_ENC_2ND_VIDEO_HEIGHT, INST_ENC_2ND_MAX_FRAMEBUFFERS)
	#else
	#define INST_2ND_ENC_PROC_SIZE VPU_CAL_ENC_PROCBUFFER(INST_ENC_2ND_USE, INST_ENC_2ND_VIDEO_WIDTH, INST_ENC_2ND_VIDEO_HEIGHT, INST_ENC_2ND_MAX_FRAMEBUFFERS)
	#endif
#define ENC_EXT_SIZE ARRAY_MBYTE(INST_2ND_ENC_PROC_SIZE)
#else
#define ENC_EXT_SIZE ARRAY_MBYTE(0)
#endif
#if defined(CONFIG_VENC_CNT_3) || defined(CONFIG_VENC_CNT_4) || defined(CONFIG_VENC_CNT_5)
	#if (INST_ENC_3RD_IS_HEVC_TYPE > 0)
	#define INST_3RD_ENC_PROC_SIZE VPU_HEVC_ENC_CAL_PROCBUFFER(INST_ENC_3RD_USE, INST_ENC_3RD_VIDEO_WIDTH, INST_ENC_3RD_VIDEO_HEIGHT, INST_ENC_3RD_MAX_FRAMEBUFFERS)
	#else
	#define INST_3RD_ENC_PROC_SIZE VPU_CAL_ENC_PROCBUFFER(INST_ENC_3RD_USE, INST_ENC_3RD_VIDEO_WIDTH, INST_ENC_3RD_VIDEO_HEIGHT, INST_ENC_3RD_MAX_FRAMEBUFFERS)
	#endif
#define ENC_EXT2_SIZE ARRAY_MBYTE(INST_3RD_ENC_PROC_SIZE)
#else
#define ENC_EXT2_SIZE ARRAY_MBYTE(0)
#endif
#if defined(CONFIG_VENC_CNT_4) || defined(CONFIG_VENC_CNT_5)
	#if (INST_ENC_4TH_IS_HEVC_TYPE > 0)
	#define INST_4TH_ENC_PROC_SIZE VPU_HEVC_ENC_CAL_PROCBUFFER(INST_ENC_4TH_USE, INST_ENC_4TH_VIDEO_WIDTH, INST_ENC_4TH_VIDEO_HEIGHT, INST_ENC_4TH_MAX_FRAMEBUFFERS)
	#else
	#define INST_4TH_ENC_PROC_SIZE VPU_CAL_ENC_PROCBUFFER(INST_ENC_4TH_USE, INST_ENC_4TH_VIDEO_WIDTH, INST_ENC_4TH_VIDEO_HEIGHT, INST_ENC_4TH_MAX_FRAMEBUFFERS)
	#endif
#define ENC_EXT3_SIZE ARRAY_MBYTE(INST_4TH_ENC_PROC_SIZE)
#else
#define ENC_EXT3_SIZE ARRAY_MBYTE(0)
#endif
#if defined(CONFIG_VENC_CNT_5)
	#if (INST_ENC_5TH_IS_HEVC_TYPE > 0)
	#define INST_5TH_ENC_PROC_SIZE VPU_HEVC_ENC_CAL_PROCBUFFER(INST_ENC_5TH_USE, INST_ENC_5TH_VIDEO_WIDTH, INST_ENC_5TH_VIDEO_HEIGHT, INST_ENC_5TH_MAX_FRAMEBUFFERS)
	#else
	#define INST_5TH_ENC_PROC_SIZE VPU_CAL_ENC_PROCBUFFER(INST_ENC_5TH_USE, INST_ENC_5TH_VIDEO_WIDTH, INST_ENC_5TH_VIDEO_HEIGHT, INST_ENC_5TH_MAX_FRAMEBUFFERS)
	#endif
#define ENC_EXT4_SIZE ARRAY_MBYTE(INST_5TH_ENC_PROC_SIZE)
#else
#define ENC_EXT4_SIZE ARRAY_MBYTE(0)
#endif
#else
#define ENC_SIZE        VPU_CAL_ENC_PROCBUFFER(INST_ENC_1ST_USE, INST_ENC_1ST_VIDEO_WIDTH, INST_ENC_1ST_VIDEO_HEIGHT, INST_ENC_1ST_MAX_FRAMEBUFFERS)
#define ENC_EXT_SIZE    VPU_CAL_ENC_PROCBUFFER(INST_ENC_2ND_USE, INST_ENC_2ND_VIDEO_WIDTH, INST_ENC_2ND_VIDEO_HEIGHT, INST_ENC_2ND_MAX_FRAMEBUFFERS)
#define ENC_EXT2_SIZE   VPU_CAL_ENC_PROCBUFFER(INST_ENC_3RD_USE, INST_ENC_3RD_VIDEO_WIDTH, INST_ENC_3RD_VIDEO_HEIGHT, INST_ENC_3RD_MAX_FRAMEBUFFERS)
#define ENC_EXT3_SIZE   VPU_CAL_ENC_PROCBUFFER(INST_ENC_4TH_USE, INST_ENC_4TH_VIDEO_WIDTH, INST_ENC_4TH_VIDEO_HEIGHT, INST_ENC_4TH_MAX_FRAMEBUFFERS)
#define ENC_EXT4_SIZE   VPU_CAL_ENC_PROCBUFFER(INST_ENC_5TH_USE, INST_ENC_5TH_VIDEO_WIDTH, INST_ENC_5TH_VIDEO_HEIGHT, INST_ENC_5TH_MAX_FRAMEBUFFERS)
#endif //CONFIG_SUPPORT_TCC_WAVE420L_VPU_HEVC_ENC

////////////////////////////////////////////////////////////////////////////////
#endif // TCC_PMAP_VIDEO_DTSI
////////////////////////////////////////////////////////////////////////////////