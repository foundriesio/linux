// SPDX-License-Identifier: (GPL-2.0-or-later OR MIT)
/*
 * Copyright (C) Telechips Inc.
 */

&firmware_android {
	compatible = "android,firmware";
	fstab {
		compatible = "android,fstab";
		vendor {
			compatible = "android,vendor";
			dev = "/dev/block/platform/16440000.sdhc/by-name/vendor";
			type = "ext4";
			mnt_flags = "ro,barrier=1";
            fsmgr_flags = "wait";
            /*if CONFIG_ANDROID_AB_UPDATE is enabled, the following should be changed
              fsmgr_flags = "wait,slotselect";
              */

		};
	};
};

