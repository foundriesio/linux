// SPDX-License-Identifier: (GPL-2.0-or-later OR MIT)
/*
 * Copyright (C) Telechips Inc.
 * Device tree for Telechips TCC8050 AVN board
 */

/dts-v1/;

#include "tcc805x-subcore-a53q.dtsi"

/ {
	/* Describe here after remove this statement if you have something to be override. */
};

&uart0 {
	pinctrl-names = "default";
	pinctrl-0 = <&uart9_data>;
	status = "okay";
};
