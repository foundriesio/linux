// SPDX-License-Identifier: (GPL-2.0+ OR MIT)
/*
 * Copyright (C) Telechips Inc.
 */

#include "../../../../../include/generated/autoconf.h"

#undef SZ_1MB
#define SZ_1MB 						(1024*1024)
#define ARRAY_16MBYTE(x)          	((((x) + ((16*SZ_1MB)-1))>> 24) << 24)
#define ARRAY_MBYTE(x)            	((((x) + (SZ_1MB-1))>> 20) << 20)
#define ARRAY_256KBYTE(x)         	((((x) + ((SZ_1MB/4)-1))>> 18) << 18)

//for HEVC/VPU framebuffer_size Calculation
#define WAVE_CAL_PROCBUFFER(use,w,h,f) (((0x700000 /*the rest except framebuffer and workbuffer*/) + (ARRAY_MBYTE(((w*h*2014)/1000)*(f+7+3))))*use)
#define VPU_CAL_PROCBUFFER(use,w,h,f)  (((0x400000 /*the rest except framebuffer and workbuffer*/) + ARRAY_MBYTE(((w*h*182)/100)*(f+7)))*use)
#define VPU_CAL_ENC_PROCBUFFER(use,w,h,f) (((0x300000 /*the rest except framebuffer and workbuffer*/) + ARRAY_MBYTE(w*h*3/2) + ARRAY_MBYTE((((w+15)/16*16)*((h+15)/16*16)*3/2)*f))*use)
//##################################################################################################################################################
/********************* Need to be optimized by customer ******************/
//##################################################################################################################################################

// Caution!! Contact engineer who is in charge of scurity in Telechips
// if you modified anything in this file with enabled CONFIG_ARM_TRUSTZONE Feature.

#define SUPPORT_ROTATION  // Enable in case supporting the display-device or video-contents rotation (90/180/270) // have to have rotation h/w block

//***************************** DISPLAY ******************************/
#define PRIMARY_FRAMEBUFFER_WIDTH			1024
#define PRIMARY_FRAMEBUFFER_HEIGHT			600
#define SECONDARY_FRAMEBUFFER_WIDTH			0
#define SECONDARY_FRAMEBUFFER_HEIGHT		0
#define TERTIARY_FRAMEBUFFER_WIDTH			0
#define TERTIARY_FRAMEBUFFER_HEIGHT			0

//Choose more bigger resolution between Primary and Secondary display device.
//and Should sync with hardware/telechips/common/hwcomposer/Hwrenderer.h
#define PRIMARY_TARGET_WIDTH			1024
#define PRIMARY_TARGET_HEIGHT			600
#define SECONDARY_TARGET_WIDTH			0
#define SECONDARY_TARGET_HEIGHT			0
#define TERTIARY_TARGET_WIDTH			0
#define TERTIARY_TARGET_HEIGHT			0

#if ((PRIMARY_TARGET_WIDTH*PRIMARY_TARGET_HEIGHT) > (SECONDARY_TARGET_WIDTH*SECONDARY_TARGET_HEIGHT))
#define SUPPORT_DISPLAY_MAX_WIDTH	PRIMARY_TARGET_WIDTH
#define SUPPORT_DISPLAY_MAX_HEIGHT	PRIMARY_TARGET_HEIGHT
#else
#define SUPPORT_DISPLAY_MAX_WIDTH	SECONDARY_TARGET_WIDTH
#define SUPPORT_DISPLAY_MAX_HEIGHT	SECONDARY_TARGET_HEIGHT
#endif


//***************************** VPU/HEVC ******************************/
//Should sync with hardware/telechips/omx/omx_videodec_interface/include/vdec.h
#define SUPPORT_VIDEO_MAX_WIDTH		1920
#define SUPPORT_VIDEO_MAX_HEIGHT	1088

#define SUPPORT_VIQE_MAX_WIDTH		1920
#define SUPPORT_VIQE_MAX_HEIGHT		1088

// DECODER on VPU
#define INST_1ST_USE				(1)
#define INST_1ST_IS_HEVC_TYPE		(1)		// please check "CONFIG_SUPPORT_TCC_HEVC" Feature in order to enable HEVC
#define INST_1ST_VIDEO_WIDTH		(1920)	// HEVC: 32x alignment, Other: 16x alignment
#define INST_1ST_VIDEO_HEIGHT		(1088)	// HEVC: 32x alignment, Other: 16x alignment
#define INST_1ST_MAX_FRAMEBUFFERS	(17)	// HEVC: 1~21, Others: 1~24

#define INST_2ND_USE				(0)
#define INST_2ND_IS_HEVC_TYPE		(0)		// please check "CONFIG_SUPPORT_TCC_HEVC" Feature in order to enable HEVC
#define INST_2ND_VIDEO_WIDTH		(1920)	// HEVC: 32x alignment, Other: 16x alignment
#define INST_2ND_VIDEO_HEIGHT		(1088)	// HEVC: 32x alignment, Other: 16x alignment
#define INST_2ND_MAX_FRAMEBUFFERS	(24)	// HEVC: 1~21, Others: 1~24

#define INST_3RD_USE				(0)
#define INST_3RD_IS_HEVC_TYPE		(0)		// please check "CONFIG_SUPPORT_TCC_HEVC" Feature in order to enable HEVC
#define INST_3RD_VIDEO_WIDTH		(720)		// HEVC: 32x alignment, Other: 16x alignment
#define INST_3RD_VIDEO_HEIGHT		(576)		// HEVC: 32x alignment, Other: 16x alignment
#define INST_3RD_MAX_FRAMEBUFFERS	(24)	// HEVC: 1~21, Others: 1~24

#define INST_4TH_USE				(0)
#define INST_4TH_IS_HEVC_TYPE		(0)		// please check "CONFIG_SUPPORT_TCC_HEVC" Feature in order to enable HEVC
#define INST_4TH_VIDEO_WIDTH		(720)		// HEVC: 32x alignment, Other: 16x alignment
#define INST_4TH_VIDEO_HEIGHT		(576)		// HEVC: 32x alignment, Other: 16x alignment
#define INST_4TH_MAX_FRAMEBUFFERS	(24)	// HEVC: 1~21, Others: 1~24

#define INST_5TH_USE                (0)
#define INST_5TH_IS_HEVC_TYPE       (0)     // please check "CONFIG_SUPPORT_TCC_HEVC" Feature in order to enable HEVC
#define INST_5TH_VIDEO_WIDTH        (720)     // HEVC: 32x alignment, Other: 16x alignment
#define INST_5TH_VIDEO_HEIGHT       (576)     // HEVC: 32x alignment, Other: 16x alignment
#define INST_5TH_MAX_FRAMEBUFFERS   (24)    // HEVC: 1~21, Others: 1~24


// ENCODER on VPU
#define INST_ENC_1ST_USE                (0)
#define INST_ENC_1ST_IS_HEVC_TYPE       (0)
#define INST_ENC_1ST_VIDEO_WIDTH        (1920)       // 16x alignment
#define INST_ENC_1ST_VIDEO_HEIGHT       (1088)       // 16x alignment
#define INST_ENC_1ST_MAX_FRAMEBUFFERS   (8)          // 8 :: fixed value. ask right engineer if you want to change it.

#define INST_ENC_2ND_USE                (0)
#define INST_ENC_2ND_IS_HEVC_TYPE       (0)
#define INST_ENC_2ND_VIDEO_WIDTH        (1280)       // 16x alignment
#define INST_ENC_2ND_VIDEO_HEIGHT       (720)        // 16x alignment
#define INST_ENC_2ND_MAX_FRAMEBUFFERS   (8)          // 8 :: fixed value. ask right engineer if you want to change it.

#define INST_ENC_3RD_USE                (0)
#define INST_ENC_3RD_IS_HEVC_TYPE       (0)
#define INST_ENC_3RD_VIDEO_WIDTH        (800)        // 16x alignment
#define INST_ENC_3RD_VIDEO_HEIGHT       (480)        // 16x alignment
#define INST_ENC_3RD_MAX_FRAMEBUFFERS   (8)          // 8 :: fixed value. ask right engineer if you want to change it.

#define INST_ENC_4TH_USE                (0)
#define INST_ENC_4TH_IS_HEVC_TYPE       (0)
#define INST_ENC_4TH_VIDEO_WIDTH        (640)        // 16x alignment
#define INST_ENC_4TH_VIDEO_HEIGHT       (480)        // 16x alignment
#define INST_ENC_4TH_MAX_FRAMEBUFFERS   (8)          // 8 :: fixed value. ask right engineer if you want to change it.

#define INST_ENC_5TH_USE                (0)
#define INST_ENC_5TH_IS_HEVC_TYPE       (0)
#define INST_ENC_5TH_VIDEO_WIDTH        (640)        // 16x alignment
#define INST_ENC_5TH_VIDEO_HEIGHT       (480)        // 16x alignment
#define INST_ENC_5TH_MAX_FRAMEBUFFERS   (8)          // 8 :: fixed value. ask right engineer if you want to change it.

#define INST_ENC_6TH_USE                (0)
#define INST_ENC_6TH_IS_HEVC_TYPE       (0)
#define INST_ENC_6TH_VIDEO_WIDTH        (640)       // 16x alignment
#define INST_ENC_6TH_VIDEO_HEIGHT       (480)       // 16x alignment
#define INST_ENC_6TH_MAX_FRAMEBUFFERS   (8)         // 8 :: fixed value. ask right engineer if you want to change it.

#define INST_ENC_7TH_USE                (0)
#define INST_ENC_7TH_IS_HEVC_TYPE       (0)
#define INST_ENC_7TH_VIDEO_WIDTH        (640)       // 16x alignment
#define INST_ENC_7TH_VIDEO_HEIGHT       (480)       // 16x alignment
#define INST_ENC_7TH_MAX_FRAMEBUFFERS   (8)         // 8 :: fixed value. ask right engineer if you want to change it.

#define INST_ENC_8TH_USE                (0)
#define INST_ENC_8TH_IS_HEVC_TYPE       (0)
#define INST_ENC_8TH_VIDEO_WIDTH        (640)       // 16x alignment
#define INST_ENC_8TH_VIDEO_HEIGHT       (480)       // 16x alignment
#define INST_ENC_8TH_MAX_FRAMEBUFFERS   (8)         // 8 :: fixed value. ask right engineer if you want to change it.

//##################################################################################################################################################
//##################################################################################################################################################
