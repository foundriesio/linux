// SPDX-License-Identifier: (GPL-2.0+ OR MIT)
/*
 * Telechips SoC series device tree overlay source
 *
 * Copyright (C) 2018 Telechips Inc.
 */

/dts-v1/;

#include "tcc-pmap-803x-android-customized.dtsi"

#include "tcc8031.dtsi"

/ {
};
