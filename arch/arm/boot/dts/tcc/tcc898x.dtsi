/*
 * Device tree for Telechips TCC898x family SoC
 *
 * Copyright (C) 2016 Telechips Inc. - http://www.telechips.com
 *
 * This file is dual-licensed: you can use it either under the terms
 * of the GPL or the X11 license, at your option. Note that this dual
 * licensing only applies to this file, and not this project as a
 * whole.
 *
 *  a) This file is free software; you can redistribute it and/or
 *     modify it under the terms of the GNU General Public License as
 *     published by the Free Software Foundation; either version 2 of the
 *     License, or (at your option) any later version.
 *
 *     This file is distributed in the hope that it will be useful,
 *     but WITHOUT ANY WARRANTY; without even the implied warranty of
 *     MERCHANTABILITY or FITNESS FOR A PARTICULAR PURPOSE.  See the
 *     GNU General Public License for more details.
 *
 * Or, alternatively,
 *
 *  b) Permission is hereby granted, free of charge, to any person
 *     obtaining a copy of this software and associated documentation
 *     files (the "Software"), to deal in the Software without
 *     restriction, including without limitation the rights to use,
 *     copy, modify, merge, publish, distribute, sublicense, and/or
 *     sell copies of the Software, and to permit persons to whom the
 *     Software is furnished to do so, subject to the following
 *     conditions:
 *
 *     The above copyright notice and this permission notice shall be
 *     included in all copies or substantial portions of the Software.
 *
 *     THE SOFTWARE IS PROVIDED "AS IS", WITHOUT WARRANTY OF ANY KIND,
 *     EXPRESS OR IMPLIED, INCLUDING BUT NOT LIMITED TO THE WARRANTIES
 *     OF MERCHANTABILITY, FITNESS FOR A PARTICULAR PURPOSE AND
 *     NONINFRINGEMENT. IN NO EVENT SHALL THE AUTHORS OR COPYRIGHT
 *     HOLDERS BE LIABLE FOR ANY CLAIM, DAMAGES OR OTHER LIABILITY,
 *     WHETHER IN AN ACTION OF CONTRACT, TORT OR OTHERWISE, ARISING
 *     FROM, OUT OF OR IN CONNECTION WITH THE SOFTWARE OR THE USE OR
 *     OTHER DEALINGS IN THE SOFTWARE.
 */

#include <dt-bindings/interrupt-controller/arm-gic.h>
#include <dt-bindings/clock/tcc898x-clks.h>
#include <dt-bindings/soc/tcc898x-pm.h>
#include <dt-bindings/display/tcc898x-vioc.h>

#define SECURED_MEM_BASE	0x30000000
#define SECURED_MEM_SIZE	0x30000000 /* 768 MiB */

#define RESERVED_MEM_BASE	0x30000000
#define RESERVED_MEM_SIZE	0x50000000 /* 1280 MiB */

/ {
	compatible = "telechips,tcc898x";
	interrupt-parent = <&gic>;
	#address-cells = <1>;
	#size-cells = <1>;

	chosen {
		bootargs = "vmalloc=480M console=ttyAMA0,115200";
	};

	aliases {
		i2c0 = &i2c0;
		i2c1 = &i2c1;
		i2c2 = &i2c2;
		i2c3 = &i2c3;
		i2s0 = &i2s0;
		i2s1 = &i2s1;
		spdif0 = &spdif0;
		spdif1 = &spdif1;
		serial0 = &uart0;
		serial1 = &uart1;
		serial2 = &uart2;
		serial3 = &uart3;
		serial4 = &uart4;
		serial5 = &uart5;
		serial6 = &uart6;
		serial7 = &uart7;
		dma0 = &dma0;
		dma1 = &dma1;
		dma2 = &dma2;
		dma3 = &dma3;
		udma0 = &udma0;
		udma1 = &udma1;
		udma2 = &udma2;
		udma3 = &udma3;
		vioc_rdma0 = &vioc_rdma0;
		vioc_rdma1 = &vioc_rdma1;
		vioc_rdma2 = &vioc_rdma2;
		vioc_rdma3 = &vioc_rdma3;
		vioc_rdma4 = &vioc_rdma4;
		vioc_rdma5 = &vioc_rdma5;
		vioc_rdma6 = &vioc_rdma6;
		vioc_rdma7 = &vioc_rdma7;
		vioc_rdma8 = &vioc_rdma8;
		vioc_rdma9 = &vioc_rdma9;
		vioc_rdma10 = &vioc_rdma10;
		vioc_rdma11 = &vioc_rdma11;
		vioc_rdma12 = &vioc_rdma12;
		vioc_rdma13 = &vioc_rdma13;
		vioc_rdma14 = &vioc_rdma14;
		vioc_rdma15 = &vioc_rdma15;
		vioc_rdma16 = &vioc_rdma16;
		vioc_rdma17 = &vioc_rdma17;
		vioc_wmix0 = &vioc_wmix0;
		vioc_wmix1 = &vioc_wmix1;
		vioc_wmix2 = &vioc_wmix2;
		vioc_wmix3 = &vioc_wmix3;
		vioc_wmix4 = &vioc_wmix4;
		vioc_wmix5 = &vioc_wmix5;
		vioc_wmix6 = &vioc_wmix6;
		vioc_sc0 = &vioc_sc0;
		vioc_sc1 = &vioc_sc1;
		vioc_sc2 = &vioc_sc2;
		vioc_sc3 = &vioc_sc3;
		vioc_sc4 = &vioc_sc4;
		vioc_sc5 = &vioc_sc5;
		vioc_wdma0 = &vioc_wdma0;
		vioc_wdma1 = &vioc_wdma1;
		vioc_wdma2 = &vioc_wdma2;
		vioc_wdma3 = &vioc_wdma3;
		vioc_wdma4 = &vioc_wdma4;
		vioc_wdma5 = &vioc_wdma5;
		vioc_wdma6 = &vioc_wdma6;
		vioc_wdma7 = &vioc_wdma7;
		vioc_wdma8 = &vioc_wdma8;
		wmixer_drv0 = &wmixer_drv0;
		wmixer_drv1 = &wmixer_drv1;
		scaler_drv1 = &scaler_drv1;
		scaler_drv3 = &scaler_drv3;
		vout_drv0 = &vout_drv0;
		vout_drv1 = &vout_drv1;
		wdma_drv0 = &wdma_drv0;
	};

	psci {
		compatible = "arm,psci-0.2";
		method = "smc";
	};

	cpus {
		#address-cells = <1>;
		#size-cells = <0>;

		cpu@0 {
			device_type = "cpu";
			compatible = "arm,cortex-a53";
			reg = <0x0>;
			enable-method = "psci";
			cpu-idle-states = <&CPU_SLEEP_0_0>;
			operating-points = <
				/* kHz    uV */
				/*1302000 1200000*/
				/*1226000 1150000*/
				1150000 1100000
				/*1074000 1050000*/
				998000 1100000
				908000 1100000
			>;

			clocks = <&clk_fbus FBUS_CPU0>;
			clock-names = "cpu0";
			clock-latency = <300000>;
		};
		cpu@1 {
			device_type = "cpu";
			compatible = "arm,cortex-a53";
			reg = <0x1>;
			enable-method = "psci";
		};
		cpu@2 {
			device_type = "cpu";
			compatible = "arm,cortex-a53";
			reg = <0x2>;
			enable-method = "psci";
		};
		cpu@3 {
			device_type = "cpu";
			compatible = "arm,cortex-a53";
			reg = <0x3>;
			enable-method = "psci";
		};

		idle-states {
			entry-method = "arm,psci";

			CPU_SLEEP_0_0: cpu-sleep-0-0 {
				compatible = "arm,idle-state";
				local-timer-stop;
				arm,psci-suspend-param = <0x0010000>;
				entry-latency-us = <250>;
				exit-latency-us = <500>;
				min-residency-us = <950>;
			};
		};
	};

	gic: interrupt-controller@17301000 {
		compatible = "arm,gic-400", "telechips,tcc898x-vpic";
		#interrupt-cells = <3>;
		#address-cells = <0>;
		interrupt-controller;
		reg = <0x17301000 0x1000>,
		      <0x17302000 0x1000>,
		      <0x17304000 0x2000>,
		      <0x17306000 0x2000>,
		      <0x14100000 0x260>;
	};

	timer {
		compatible = "arm,armv8-timer";
		interrupts = <GIC_PPI 13 (GIC_CPU_MASK_SIMPLE(4) | IRQ_TYPE_LEVEL_LOW)>,
			     <GIC_PPI 14 (GIC_CPU_MASK_SIMPLE(4) | IRQ_TYPE_LEVEL_LOW)>,
			     <GIC_PPI 11 (GIC_CPU_MASK_SIMPLE(4) | IRQ_TYPE_LEVEL_LOW)>,
			     <GIC_PPI 10 (GIC_CPU_MASK_SIMPLE(4) | IRQ_TYPE_LEVEL_LOW)>;
	};

	pmu {
		compatible = "arm,cortex-a15-pmu";
		interrupts = <GIC_SPI 114 IRQ_TYPE_LEVEL_HIGH>,
			     <GIC_SPI 115 IRQ_TYPE_LEVEL_HIGH>,
			     <GIC_SPI 116 IRQ_TYPE_LEVEL_HIGH>,
			     <GIC_SPI 117 IRQ_TYPE_LEVEL_HIGH>;
	};

	reserved-memory {
		#address-cells = <1>;
		#size-cells = <1>;
		ranges;

		pmap_secured_inbuff: secured_inbuff {
			compatible = "telechips,pmap";
			telechips,pmap-name = "secured_inbuff";
			alloc-ranges = <SECURED_MEM_BASE SECURED_MEM_SIZE>;
			size = <0x00000000>;  // 0x00800000 for 1080p video, 0x1800000 for 2160p
			telechips,pmap-secured;
			no-map;
		};

		pmap_video_sbackup: video_sbackup {
			compatible = "telechips,pmap";
			telechips,pmap-name = "video_sbackup";
			alloc-ranges = <SECURED_MEM_BASE SECURED_MEM_SIZE>;
			size = <0x00000000>;  // 0x200000 for 1080p, 0x600000 for 2160p
			telechips,pmap-secured;
			no-map;
		};

		pmap_overlay: overlay {
			compatible = "telechips,pmap";
			telechips,pmap-name = "overlay";
			alloc-ranges = <SECURED_MEM_BASE SECURED_MEM_SIZE>;
			size = <0x1800000>; // Max-Displayed-Output(w*h*2) * 3
			telechips,pmap-secured;
			no-map;
		};

		pmap_overlay1: overlay1 {
			compatible = "telechips,pmap";
			telechips,pmap-name = "overlay1";
			alloc-ranges = <SECURED_MEM_BASE SECURED_MEM_SIZE>;
			size = <0x0>; // Max-Displayed-Output(w*h*2) * 3
			telechips,pmap-secured;
			no-map;
		};

		pmap_overlay_rot: overlay_rot {
			compatible = "telechips,pmap";
			telechips,pmap-name = "overlay_rot";
			alloc-ranges = <SECURED_MEM_BASE SECURED_MEM_SIZE>;
			size = <0x0>; // Max-Displayed-Output(w*h*2) for device-rotation.
			telechips,pmap-secured;
			no-map;
		};

		pmap_video_ext: video_ext {
			compatible = "telechips,pmap";
			telechips,pmap-name = "video_ext";
			alloc-ranges = <SECURED_MEM_BASE SECURED_MEM_SIZE>;
			size = <0x0>;
			telechips,pmap-secured;
			no-map;
		};

		pmap_video: video {
			compatible = "telechips,pmap";
			telechips,pmap-name = "video";
			alloc-ranges = <SECURED_MEM_BASE SECURED_MEM_SIZE>;
			size = <0x1dd00000>;
			telechips,pmap-secured;
			no-map;
		};

		pmap_pmem: pmem {
			compatible = "telechips,pmap";
			telechips,pmap-name = "pmem";
			alloc-ranges = <RESERVED_MEM_BASE RESERVED_MEM_SIZE>;
			size = <0x00000000>;
			no-map;
		};

		pmap_fb_video: fb_video {
			compatible = "telechips,pmap";
			telechips,pmap-name = "fb_video";
			alloc-ranges = <RESERVED_MEM_BASE RESERVED_MEM_SIZE>;
			/* Calculate start address based on 0x30000000.
			 * Base address will be (0x30000000 - prot_tztee_size - fb_video_size).
			 */
			size = <0x00000000>;
			no-map;
		};

		pmap_prot_tztee: prot_tztee {
			compatible = "telechips,pmap";
			telechips,pmap-name = "prot_tztee";
			alloc-ranges = <RESERVED_MEM_BASE RESERVED_MEM_SIZE>;
			/* Calculate start address based on 0x30000000.
			 * Base address will be (0x30000000 - prot_tztee_size).
			 */
			size = <0x00000000>;
			no-map;
		};

		pmap_video_thumb: video_thumb {
			compatible = "telechips,pmap";
			telechips,pmap-name = "video_thumb";
			alloc-ranges = <RESERVED_MEM_BASE RESERVED_MEM_SIZE>;
			size = <0x0>; //0x600000 for 1080p video, 0x1A00000 for 2160p
			no-map;
		};

		pmap_ump_reserved: ump_reserved {
			compatible = "telechips,pmap";
			telechips,pmap-name = "ump_reserved";
			alloc-ranges = <RESERVED_MEM_BASE RESERVED_MEM_SIZE>;
			size = <0x0>; // Max-Video-Resolution(Aligned_256KB(w*h*3/2)) * 12 + 1MB
		};

		pmap_fb_wmixer: fb_wmixer {
			compatible = "telechips,pmap";
			telechips,pmap-name = "fb_wmixer";
			alloc-ranges = <RESERVED_MEM_BASE RESERVED_MEM_SIZE>;
			size = <0x0>; // Max-Video-Resolution(w*h*2)
			no-map;
		};

		pmap_viqe: viqe {
			compatible = "telechips,pmap";
			telechips,pmap-name = "viqe";
			alloc-ranges = <RESERVED_MEM_BASE RESERVED_MEM_SIZE>;
			size = <0x0>;
			no-map;
		};

		pmap_ext_camera: ext_camera {
			compatible = "telechips,pmap";
			telechips,pmap-name = "ext_camera";
			alloc-ranges = <RESERVED_MEM_BASE RESERVED_MEM_SIZE>;
			size = <0x0>;
			no-map;
		};

		pmap_fb_scale: fb_scale {
			compatible = "telechips,pmap";
			telechips,pmap-name = "fb_scale";
			alloc-ranges = <RESERVED_MEM_BASE RESERVED_MEM_SIZE>;
			size = <0x0>;
			no-map;
		};

		pmap_fb_scale0: fb_scale0 {
			compatible = "telechips,pmap";
			telechips,pmap-name = "fb_scale0";
			alloc-ranges = <RESERVED_MEM_BASE RESERVED_MEM_SIZE>;
			size = <0x0>;
			no-map;
		};

		pmap_fb_scale1: fb_scale1 {
			compatible = "telechips,pmap";
			telechips,pmap-name = "fb_scale1";
			alloc-ranges = <RESERVED_MEM_BASE RESERVED_MEM_SIZE>;
			size = <0x0>;
			no-map;
		};

		pmap_fb_g2d0: fb_g2d0 {
			compatible = "telechips,pmap";
			telechips,pmap-name = "fb_g2d0";
			alloc-ranges = <RESERVED_MEM_BASE RESERVED_MEM_SIZE>;
			size = <0x0>;
			no-map;
		};

		pmap_fb_g2d1: fb_g2d1 {
			compatible = "telechips,pmap";
			telechips,pmap-name = "fb_g2d1";
			alloc-ranges = <RESERVED_MEM_BASE RESERVED_MEM_SIZE>;
			size = <0x0>;
			no-map;
		};

		pmap_video_dual: video_dual {
			compatible = "telechips,pmap";
			telechips,pmap-name = "video_dual";
			alloc-ranges = <RESERVED_MEM_BASE RESERVED_MEM_SIZE>;
			size = <0x0>;
			no-map;
		};

		pmap_jpeg_header: jpeg_header {
			compatible = "telechips,pmap";
			telechips,pmap-name = "jpeg_header";
			alloc-ranges = <RESERVED_MEM_BASE RESERVED_MEM_SIZE>;
			telechips,pmap-shared = <&pmap_viqe>;
			telechips,pmap-shared-size = <0x100000>;
			telechips,pmap-offset = <0x0>;
			size = <0x0>;
			no-map;
		};

		pmap_jpeg_stream: jpeg_stream {
			compatible = "telechips,pmap";
			telechips,pmap-name = "jpeg_stream";
			alloc-ranges = <RESERVED_MEM_BASE RESERVED_MEM_SIZE>;
			telechips,pmap-shared = <&pmap_jpeg_header>;
			telechips,pmap-shared-size = <0x500000>;
			telechips,pmap-offset = <0x100000>;
			size = <0x0>;
			no-map;
		};

		pmap_jpeg_raw: jpeg_raw {
			compatible = "telechips,pmap";
			telechips,pmap-name = "jpeg_raw";
			alloc-ranges = <RESERVED_MEM_BASE RESERVED_MEM_SIZE>;
			telechips,pmap-shared = <&pmap_jpeg_stream>;
			telechips,pmap-shared-size = <0xf00000>;
			telechips,pmap-offset = <0x500000>;
			size = <0x0>;
			no-map;
		};

		pmap_nand_mem: nand_mem {
			compatible = "telechips,pmap";
			telechips,pmap-name = "nand_mem";
			alloc-ranges = <RESERVED_MEM_BASE RESERVED_MEM_SIZE>;
			size = <0x0>;
			no-map;
		};

		pmap_tsif: tsif {
			compatible = "telechips,pmap";
			telechips,pmap-name = "tsif";
			alloc-ranges = <RESERVED_MEM_BASE RESERVED_MEM_SIZE>;
			size = <0x400000>;
			no-map;
		};

		/*pmap_jpg_enc_dxb: jpg_enc_dxb {
			telechips,pmap-name = "jpg_enc_dxb";
			alloc-ranges = <RESERVED_MEM_BASE RESERVED_MEM_SIZE>;
			size = <0x300000>;
			no-map;
		};

		pmap_jpg_raw_dxb: jpg_raw_dxb {
			telechips,pmap-name = "jpg_raw_dxb";
			alloc-ranges = <RESERVED_MEM_BASE RESERVED_MEM_SIZE>;
			size = <0x300000>;
			no-map;
		};
		*/

		pmap_output_attach: output_attach {
			compatible = "telechips,pmap";
			telechips,pmap-name = "output_attach";
			alloc-ranges = <RESERVED_MEM_BASE RESERVED_MEM_SIZE>;
			size = <0x0>;
			no-map;
		};

		pmap_fb1_video: fb1_video {
			compatible = "telechips,pmap";
			telechips,pmap-name = "fb1_video";
			alloc-ranges = <RESERVED_MEM_BASE RESERVED_MEM_SIZE>;
			size = <0x0>;
			no-map;
		};

		pmap_v4l2_vout: v4l2_vout {
			compatible = "telechips,pmap";
			telechips,pmap-name = "v4l2_vout";
			alloc-ranges = <RESERVED_MEM_BASE RESERVED_MEM_SIZE>;
			size = <0x0>;
			no-map;
		};

		pmap_v4l2_subtitle: v4l2_subtitle {
			compatible = "telechips,pmap";
			telechips,pmap-name = "v4l2_subtitle";
			alloc-ranges = <RESERVED_MEM_BASE RESERVED_MEM_SIZE>;
			size = <0x0>;
			no-map;
		};

		reserved_ramoops: ramoops {
			compatible = "telechips,pmap";
			telechips,pmap-name = "ramoops";
			alloc-ranges = <RESERVED_MEM_BASE RESERVED_MEM_SIZE>;
			size = <0x00100000>;
			no-map;
		};

		reserved_cma: linux,cma {
			compatible = "shared-dma-pool";
			alloc-ranges = <RESERVED_MEM_BASE RESERVED_MEM_SIZE>;
			size = <0x04000000>;	/* 64 MiB */
			alignment = <0x4000000>;
			linux,cma-default;
			reusable;
		};

		pmap_dolby_regs: dolby_regs {
			compatible = "telechips,pmap";
			telechips,pmap-name = "dolby_regs";
			alloc-ranges = <RESERVED_MEM_BASE RESERVED_MEM_SIZE>;
			size = <0x0>;
			no-map;
		};
	};

	ramoops {
		compatible = "ramoops";
		memory-region = <&reserved_ramoops>;
		record-size = <0x00000000 0x00020000>;
		console-size = <0x00000000 0x00020000>;
		ecc-size = <16>;
		unbuffered;
		status = "okay";
	};

	tcc_pm {
		compatible = "telechips,pm";
		reg = < 0x16400000 0x000100  /* nfc*/
			0x16430000 0x000030  /* edi*/
			0x16600000 0x000050  /* uart0*/
			0x16684000 0x000010>;  /* uart config*/
		suspend_mode = <0>;	/* 0:sleep, 1:shutdown, 2:wfi */
	};

	ckc@14000000 {
		compatible = "telechips,ckc";
		reg = <0x14000000 0x0001A8	/* ckc */
		       0x14400000 0x000114	/* pmu */
		       0x13500000 0x000018	/* memory bus configutaion */
		       0x12380000 0x000008	/* display bus configutaion */
		       0x10010000 0x000008	/* graphic bus configutaion */
		       0x16051000 0x000018	/* io bus configutaion 0 */
		       0x16494400 0x000008	/* io bus configutaion 1 */
		       0x15100000 0x000008	/* video bus configutaion */
		       0x111A0000 0x000008	/* hsio bus configutaion */
		       0x17000000 0x300000	/* cpu bus configuration */
		       0x10000000 0x000010	/* graphic 3d clk */
		       0x1A000000 0x000010	/* graphic 2d clk */
		       0x13540000 0x000010>;	/* memory phy clk */
	};

	clk_fbus: clk0 {
		compatible = "telechips,clk-fbus";
		#clock-cells = <1>;
	};

	clk_peri: clk1 {
		compatible = "telechips,clk-peri";
		#clock-cells = <1>;
	};

	clk_isoip_top: clk2 {
		compatible = "telechips,clk-isoip_top";
		#clock-cells = <1>;
	};

	clk_isoip_ddi: clk3 {
		compatible = "telechips,clk-isoip_ddi";
		#clock-cells = <1>;
	};

	clk_ddi: clk4 {
		compatible = "telechips,clk-ddibus";
		#clock-cells = <1>;
	};

	clk_io: clk5 {
		compatible = "telechips,clk-iobus";
		#clock-cells = <1>;
	};

	clk_vpu: clk6 {
		compatible = "telechips,clk-vpubus";
		#clock-cells = <1>;
	};

	clk_hsio: clk7 {
		compatible = "telechips,clk-hsiobus";
		#clock-cells = <1>;
	};

	pinctrl: pinctrl@14200000 {
		compatible = "telechips,tcc898x-pinctrl";
		reg = <0x14200000 0x300>;
		#address-cells = <1>;
		#size-cells = <2>;
		interrupts = <GIC_SPI 0 0>,
				   <GIC_SPI 1 0>,
				   <GIC_SPI 2 0>,
				   <GIC_SPI 3 0>,
				   <GIC_SPI 4 0>,
				   <GIC_SPI 5 0>,
				   <GIC_SPI 6 0>,
				   <GIC_SPI 7 0>,
				   <GIC_SPI 8 0>,
				   <GIC_SPI 9 0>,
				   <GIC_SPI 10 0>,
				   <GIC_SPI 11 0>,
				   <GIC_SPI 12 0>,
				   <GIC_SPI 13 0>,
				   <GIC_SPI 14 0>;
	};

	dma0: dma@16020000 {
		compatible = "telechips,tcc898x-dma";
		reg = <0x16020000 0x94 0x1605101C 0x4>;
		interrupts = <GIC_SPI 41 IRQ_TYPE_LEVEL_HIGH>;
		#dma-cells = <2>;
		dma-channels = <3>;
		dma-requests = <32>;
		channel-priority = <0>;
		clocks = <&clk_io IOBUS_DMA0>;
		clock-names = "dmac0";
	};

	dma1: dma@16020100 {
		compatible = "telechips,tcc898x-dma";
		reg = <0x16020100 0x94 0x16051020 0x4>;
		interrupts = <GIC_SPI 41 IRQ_TYPE_LEVEL_HIGH>;
		#dma-cells = <2>;
		dma-channels = <3>;
		dma-requests = <32>;
		channel-priority = <0>;
		clocks = <&clk_io IOBUS_DMA1>;
		clock-names = "dmac1";
	};

	dma2: dma@16020200 {
		compatible = "telechips,tcc898x-dma";
		reg = <0x16020200 0x94 0x16051024 0x4>;
		interrupts = <GIC_SPI 41 IRQ_TYPE_LEVEL_HIGH>;
		#dma-cells = <2>;
		dma-channels = <3>;
		dma-requests = <32>;
		channel-priority = <0>;
		clocks = <&clk_io IOBUS_DMA2>;
		clock-names = "dmac2";
	};

	dma3: dma@16490000 {
		compatible = "telechips,tcc898x-dma";
		reg = <0x16490000 0x94>;
		interrupts = <GIC_SPI 42 IRQ_TYPE_LEVEL_HIGH>;
		#dma-cells = <2>;
		dma-channels = <3>;
		dma-requests = <32>;
		channel-priority = <0>;
		clocks = <&clk_io IOBUS_DMA>;
		clock-names = "dmac3";
	};

	udma0: udma@16680000 {
		compatible = "arm,pl081", "arm,primecell";
		reg = <0x16680000 0x1000>;
		interrupts = <GIC_SPI 59 IRQ_TYPE_LEVEL_HIGH>;
		//dma-channels = <2>;
		//dma-requests = <32>;
		channel-priority = <0>;
		clocks = <&clk_io IOBUS_UDMA0>;
		clock-names = "apb_pclk";
		lli-bus-interface-ahb1;
		lli-bus-interface-ahb2;
		mem-bus-interface-ahb2;
		memcpy-burst-size = <256>;
		memcpy-bus-width = <32>;
		#dma-cells = <2>;
	};

	udma1: udma@16681000 {
		compatible = "arm,pl081", "arm,primecell";
		reg = <0x16681000 0x1000>;
		interrupts = <GIC_SPI 60 IRQ_TYPE_LEVEL_HIGH>;
		//dma-channels = <2>;
		//dma-requests = <32>;
		channel-priority = <0>;
		clocks = <&clk_io IOBUS_UDMA1>;
		clock-names = "apb_pclk";
		lli-bus-interface-ahb1;
		lli-bus-interface-ahb2;
		mem-bus-interface-ahb2;
		memcpy-burst-size = <256>;
		memcpy-bus-width = <32>;
		#dma-cells = <2>;
	};

	udma2: udma@16682000 {
		compatible = "arm,pl081", "arm,primecell";
		reg = <0x16682000 0x1000>;
		interrupts = <GIC_SPI 61 IRQ_TYPE_LEVEL_HIGH>;
		//dma-channels = <2>;
		//dma-requests = <32>;
		channel-priority = <0>;
		clocks = <&clk_io IOBUS_UDMA2>;
		clock-names = "apb_pclk";
		lli-bus-interface-ahb1;
		lli-bus-interface-ahb2;
		mem-bus-interface-ahb2;
		memcpy-burst-size = <256>;
		memcpy-bus-width = <32>;
		#dma-cells = <2>;
	};

	udma3: udma@16683000 {
		compatible = "arm,pl081", "arm,primecell";
		reg = <0x16683000 0x1000>;
		interrupts = <GIC_SPI 62 IRQ_TYPE_LEVEL_HIGH>;
		//dma-channels = <2>;
		//dma-requests = <32>;
		channel-priority = <0>;
		clocks = <&clk_io IOBUS_UDMA3>;
		clock-names = "apb_pclk";
		lli-bus-interface-ahb1;
		lli-bus-interface-ahb2;
		mem-bus-interface-ahb2;
		memcpy-burst-size = <256>;
		memcpy-bus-width = <32>;
		#dma-cells = <2>;
	};

	timer@14300080 {
		compatible = "telechips,timer32";
		reg = <0x14300080 0x1c>;
		interrupts = <GIC_SPI 32 IRQ_TYPE_NONE>;
		clocks = <&clk_peri PERI_TCZ>;
	};

	timer@14300000 { /* tc0~tc5 */
		compatible = "telechips,timer";
		reg = <0x14300000 0xa0>;
		interrupts = <GIC_SPI 33 0>;
		clocks = <&clk_peri PERI_TCT>;
		clock-frequency = <12000000>;
	};

	watchdog@144000D0 {
		compatible = "telechips,wdt";
		reg = <0x144000D0 0x4 0x144000D4 0x4 0x144000DC 0x4 0x14300070 0xc 0x14300060 0x4>;   /* wdt_ctrl, wdt_cnt, wdt_clear, wdt_timer, wdt_int_sts */
		clocks = <&clk_peri PERI_TCX &clk_peri PERI_TCT>;
		clock-frequency = <24000000>;
		interrupts = <GIC_SPI 33 0>;
		int-offset = <6>;
		clear-bit = <0>;
		/* status = "disabled"; */
	};

	ictc:ictc@0x16055000 {
		compatible = "telechips,ictc";
		reg = <0x16055000 0x4 0x16055004 0x4 0x16055008 0x4>;
		interrupt = <GIC_SPI 75 0>;
		f_in_sel = <15>;
		status = "disabled";
	};

	i2c0: i2c@16300000 {
		compatible = "telechips,i2c";
		reg = <0x16300000 0x1c 0x163C0000 0x10>;
		interrupts = <GIC_SPI 46 IRQ_TYPE_LEVEL_HIGH>;
		#address-cells = <1>;
		#size-cells = <0>;
		clocks = <&clk_peri PERI_I2C0 &clk_io IOBUS_I2C_M0>;
		clock-frequency = <4000000>;
		scl-clock-frequency = <400000>;
		port-mux = <0xFF>;	/* default value */
		status = "disabled";
		interrupt_mode = <0>;
	};

	i2c1: i2c@16310000 {
		compatible = "telechips,i2c";
		reg = <0x16310000 0x1c 0x163C0000 0x10>;
		interrupts = <GIC_SPI 46 IRQ_TYPE_LEVEL_HIGH>;
		#address-cells = <1>;
		#size-cells = <0>;
		clocks = <&clk_peri PERI_I2C1 &clk_io IOBUS_I2C_M1>;
		clock-frequency = <4000000>;
		scl-clock-frequency = <400000>;
		port-mux = <0xFF>;	/* default value */
		status = "disabled";
		interrupt_mode = <0>;
	};

	i2c2: i2c@16320000 {
		compatible = "telechips,i2c";
		reg = <0x16320000 0x1c 0x163C0000 0x10>;
		interrupts = <GIC_SPI 46 IRQ_TYPE_LEVEL_HIGH>;
		#address-cells = <1>;
		#size-cells = <0>;
		clocks = <&clk_peri PERI_I2C2 &clk_io IOBUS_I2C_M2>;
		clock-frequency = <4000000>;
		scl-clock-frequency = <400000>;
		port-mux = <0xFF>;	/* default value */
		status = "disabled";
		interrupt_mode = <0>;
	};

	i2c3: i2c@16330000 {
		compatible = "telechips,i2c";
		reg = <0x16330000 0x1c 0x163C0000 0x10>;
		interrupts = <GIC_SPI 46 IRQ_TYPE_LEVEL_HIGH>;
		#address-cells = <1>;
		#size-cells = <0>;
		clocks = <&clk_peri PERI_I2C3 &clk_io IOBUS_I2C_M3>;
		clock-frequency = <4000000>;
		/*Set HDMI I2C frequency to 80Khz*/
		scl-clock-frequency = <80000>;
		port-mux = <0xFF>;	/* default value */
		status = "disabled";
		interrupt_mode = <0>;
	};

	gpsb0: gpsb0@16900000 {
	    compatible = "telechips,tcc-spi";
	    reg = <0x16900000 0x38 0x16960000 0x10 0x16970000 0x84>;
	    interrupts = <GIC_SPI 44 IRQ_TYPE_LEVEL_HIGH>;
	    clocks = <&clk_peri PERI_GPSB0 &clk_io IOBUS_GPSB0>;
	    gpsb-id = <0>;
	    status = "disabled";
	};

	gpsb1: gpsb1@16910000 {
	    compatible = "telechips,tcc89xx-tsif";
	    reg = <0x16910000 0x38 0x16960000 0x10 0x16970000 0x84>;
	    interrupts = <GIC_SPI 44 IRQ_TYPE_LEVEL_HIGH>;
	    clocks = <&clk_peri PERI_GPSB1 &clk_io IOBUS_GPSB1>;
	    gpsb-id = <0>;
	    status = "disabled";
	};

	gpsb2: gpsb2@16920000 {
	    compatible = "telechips,tcc89xx-tsif";
	    reg = <0x16920000 0x38 0x16960000 0x10 0x16970000 0x84>;
	    interrupts = <GIC_SPI 44 IRQ_TYPE_LEVEL_HIGH>;
	    clocks = <&clk_peri PERI_GPSB2 &clk_io IOBUS_GPSB2>;
	    gpsb-id = <1>;
	    status = "disabled";
	};

	gpsb3: gpsb3@16930000 {
	    compatible = "telechips,tcc-spi";
	    reg = <0x16930000 0x38 0x16960000 0x10 0x16970000 0x84>;
	    interrupts = <GIC_SPI 44 IRQ_TYPE_LEVEL_HIGH>;
	    clocks = <&clk_peri PERI_GPSBMS0 &clk_io IOBUS_GPSB3>;
	    gpsb-id = <1>;
	    status = "disabled";

		// With DMA-engine
		dmas = <&dma0 0 3 &dma0 1 9>;
		dma-names = "tx", "rx";
	};
/*
	gpsb4: gpsb4@16940000 {
	    compatible = "telechips,tcc89xx-tsif";
	    reg = <0x16940000 0x38 0x16960000 0x10 0x16970000 0x84>;
	    interrupts = <GIC_SPI 44 IRQ_TYPE_LEVEL_HIGH>;
	    clocks = <&clk_peri PERI_GPSBMS1 &clk_io IOBUS_GPSB4>;
	    gpsb-id = <3>;
	    status = "disabled";

		// With DMA-engine
		dmas = <&dma? ? 4 &dma? ? 10>;
		dma-names = "tx", "rx";
	};

	gpsb5: gpsb5@16950000 {
	    compatible = "telechips,tcc89xx-tsif";
	    reg = <0x16950000 0x38 0x16960000 0x10 0x16970000 0x84>;
	    interrupts = <GIC_SPI 44 IRQ_TYPE_LEVEL_HIGH>;
	    clocks = <&clk_peri PERI_GPSBMS2 &clk_io IOBUS_GPSB5>;
	    gpsb-id = <4>;
	    status = "disabled";

		// With DMA-engine
		dmas = <&dma? ? 5 &dma? ? 11>;
		dma-names = "tx", "rx";
	};
*/
	adma0: adma@16100000 {
		compatible = "telechips,adma";
		reg = <0x16100000 0x200>;
		clocks = <&clk_io IOBUS_ADMA0>;
		interrupts = <GIC_SPI 54 IRQ_TYPE_LEVEL_HIGH>;
		have-hopcnt-clear = <1>;
		adrcnt-mode = <0>;
	};

	adma1: adma@16200000 {
		compatible = "telechips,adma";
		reg = <0x16200000 0x200>;
		clocks = <&clk_io IOBUS_ADMA1>;
		interrupts = <GIC_SPI 56 IRQ_TYPE_LEVEL_HIGH>;
		have-hopcnt-clear = <1>;
		adrcnt-mode = <0>;
	};

	i2s0: i2s@16101000 {
		compatible = "telechips,i2s";
		reg = <0x16101000 0x50>;
		clocks = <&clk_peri PERI_MDAI0 &clk_io IOBUS_DAI0 &clk_peri PERI_MFLT0_DAI>;
		clock-frequency = <11289600>;   // 44100*256
		have-fifo-clear=<1>;
		block-type = <1>;
		adma = <&adma0>;
		status = "disabled";
	};

	i2s1: i2s@16201000 {
		compatible = "telechips,i2s";
		reg = <0x16201000 0x50>;
		clocks = <&clk_peri PERI_MDAI1 &clk_io IOBUS_DAI1 &clk_peri PERI_MFLT1_DAI>;
		clock-frequency = <11289600>;   // 44100*256
		block-type = <2>;
		adma = <&adma1>;
		have-fifo-clear=<1>;
		status = "disabled";
	};

	spdif0: spdif@16102000 {
		compatible = "telechips,spdif";
		reg = <0x16102000 0x1000>;
		clocks = <&clk_peri PERI_MSPDIF0 &clk_io IOBUS_SPDIF0>;
		clock-frequency = <44100>;
		adma = <&adma0>;
		status = "disabled";
	};

	spdif1: spdif@16202000 {
		compatible = "telechips,spdif";
		reg = <0x16202000 0x1000>;
		clocks = <&clk_peri PERI_MSPDIF1 &clk_io IOBUS_SPDIF1>;
		clock-frequency = <44100>;
		adma = <&adma1>;
		status = "disabled";
	};

	audio_chmux: audio_chmux@16051000{
		compatible = "telechips,audio-chmux-898x";
		reg = <0x16051000 0x78>;
		dai = <0 0>; // i2s0(x) i2s1(x)
		cdif = <0 0>; // cdif0(x) cdif1(x)
		spdif = <0 0>; // spdif0(x) spdif1(x)
		status = "disabled";
	};

	uart0: serial@16600000 {
		compatible = "arm,pl011", "arm,primecell";
		reg = <0x16600000 0x1000>;
		arm,primecell-periphid = <0x001feff7>;
	    interrupts = <GIC_SPI 63 IRQ_TYPE_LEVEL_HIGH>;
		clocks = <&clk_peri PERI_UART0>, <&clk_io IOBUS_UART0>;
		clock-names = "uartclk", "apb_pclk";
		status = "disabled";
	};

	uart1: serial@16610000 {
		compatible = "arm,pl011", "arm,primecell";
		reg = <0x16610000 0x1000>;
		arm,primecell-periphid = <0x001feff7>;
	    interrupts = <GIC_SPI 64 IRQ_TYPE_LEVEL_HIGH>;
		clocks = <&clk_peri PERI_UART1>, <&clk_io IOBUS_UART1>;
		clock-names = "uartclk", "apb_pclk";
		status = "disabled";
	};

	uart2: serial@16620000 {
		compatible = "arm,pl011", "arm,primecell";
		reg = <0x16620000 0x1000>;
		arm,primecell-periphid = <0x001feff7>;
	    interrupts = <GIC_SPI 65 IRQ_TYPE_LEVEL_HIGH>;
		clocks = <&clk_peri PERI_UART2>, <&clk_io IOBUS_UART2>;
		clock-names = "uartclk", "apb_pclk";
		status = "disabled";
	};

	uart3: serial@16630000 {
		compatible = "arm,pl011", "arm,primecell";
		reg = <0x16630000 0x1000>;
		arm,primecell-periphid = <0x001feff7>;
	    interrupts = <GIC_SPI 66 IRQ_TYPE_LEVEL_HIGH>;
		clocks = <&clk_peri PERI_UART3>, <&clk_io IOBUS_UART3>;
		clock-names = "uartclk", "apb_pclk";
		status = "disabled";
	};

	uart4: serial@16640000 {
		compatible = "arm,pl011", "arm,primecell";
		reg = <0x16640000 0x1000>;
		arm,primecell-periphid = <0x001feff7>;
	    interrupts = <GIC_SPI 67 IRQ_TYPE_LEVEL_HIGH>;
		clocks = <&clk_peri PERI_UART4>, <&clk_io IOBUS_UART4>;
		clock-names = "uartclk", "apb_pclk";
		status = "disabled";
	};

	uart5: serial@16650000 {
		compatible = "arm,pl011", "arm,primecell";
		reg = <0x16650000 0x1000>;
		arm,primecell-periphid = <0x001feff7>;
	    interrupts = <GIC_SPI 68 IRQ_TYPE_LEVEL_HIGH>;
		clocks = <&clk_peri PERI_UART5>, <&clk_io IOBUS_UART5>;
		clock-names = "uartclk", "apb_pclk";
		status = "disabled";
	};

	uart6: serial@16660000 {
		compatible = "arm,pl011", "arm,primecell";
		reg = <0x16660000 0x1000>;
		arm,primecell-periphid = <0x001feff7>;
	    interrupts = <GIC_SPI 69 IRQ_TYPE_LEVEL_HIGH>;
		clocks = <&clk_peri PERI_UART6>, <&clk_io IOBUS_UART6>;
		clock-names = "uartclk", "apb_pclk";
		status = "disabled";
	};

	uart7: serial@16670000 {
		compatible = "arm,pl011", "arm,primecell";
		reg = <0x16670000 0x1000>;
		arm,primecell-periphid = <0x001feff7>;
	    interrupts = <GIC_SPI 70 IRQ_TYPE_LEVEL_HIGH>;
		clocks = <&clk_peri PERI_UART7>, <&clk_io IOBUS_UART7>;
		clock-names = "uartclk", "apb_pclk";
		status = "disabled";
	};

	/*
	 * HSIO Bus Block
	 */
	dwc3@11900000 {
		compatible = "telechips,tcc-dwc3";
		reg = <0x11900000 0xCFFF 0x11190000 0x48>;
		/* clock-frequency = <48000000>; */
		interrupts = <GIC_SPI 110 IRQ_TYPE_LEVEL_HIGH>;
		clocks = <&clk_fbus FBUS_HSIO &clk_isoip_top ISOIP_TOP_U30>;
		status = "disabled";
	    tpl-support;   // Support TPL
	};

	trng@111B0100 {
		compatible = "telechips,tcc-rng";
		status = "okay";
	};

	ehci_phy:ehci_phy@111A0010 {
		 compatible = "telechips,tcc_ehci_phy";
		 reg = <0x111A0010 0x30>;
		 /* otg_hclk=0xe0+0, otg_phy=0x10+9*/
		 clocks = <&clk_hsio HSIOBUS_USB20H &clk_isoip_top ISOIP_TOP_U20H>;
		 status = "disabled";
	 };

	ehci@11200000 {
		compatible = "telechips,tcc-ehci";
		reg = <0x11200000 0x108 0x111A0010 0x54>;
		interrupts = <GIC_SPI 102 IRQ_TYPE_LEVEL_HIGH>;
		clocks = <&clk_hsio HSIOBUS_USB20H &clk_isoip_top ISOIP_TOP_U20H>;
		telechips,ehci_phy = <&ehci_phy>;
		status = "disabled";
		tpl-support;   // Support TPL
	};

	ohci@11300000 {
		compatible = "telechips,tcc-ohci";
		reg = <0x11300000 0x60 0x111A0010 0x54>;
		interrupts = <GIC_SPI 102 IRQ_TYPE_LEVEL_HIGH>;
		clocks = <&clk_hsio HSIOBUS_USB20H &clk_isoip_top ISOIP_TOP_U20H>;
		status = "disabled";
	    tpl-support;   // Support TPL
	};

	dwc_otg_phy:dwc_otg_phy@111A0100 {
		 compatible = "telechips,tcc_dwc_otg_phy";
		 reg = <0x111A0100 0x30>;
		 /* otg_hclk=0xe0+0, otg_phy=0x10+9*/
		 clocks = <&clk_hsio HSIOBUS_DWC_OTG &clk_isoip_top ISOIP_TOP_OTG>;
		 status = "disabled";
	};

	mhst_phy:mux_host_phy@111A00DC {
		 compatible = "telechips,tcc_ehci_phy";
		 reg = <0x111A00DC 0x20>;
		 /* otg_hclk=0xe0+0, otg_phy=0x10+9*/
		 clocks = <&clk_hsio HSIOBUS_DWC_OTG &clk_isoip_top ISOIP_TOP_OTG>;
		 mux_port;
		 status = "disabled";
	};

	dwc_otg@11080000 {
		compatible = "telechips,dwc_otg";
		/*     otg base   |size  |otg phy   |size|ehci base |size |ehci phy  |size|ohci base |size */
		reg = <0x11080000 0xcfff 0x111a0100 0x30 0x11000000 0x108 0x111A00DC 0x20 0x11040000 0x60>;
		clock-frequency = <48000000>;
		interrupts = <GIC_SPI 103 IRQ_TYPE_LEVEL_HIGH>;
		/* otg_pclk=0x120+9, otg_hclk=0xe0+0, otg_phy=0x10+9*/
		clocks = <&clk_peri PERI_USB_OTG &clk_hsio HSIOBUS_DWC_OTG &clk_isoip_top ISOIP_TOP_OTG>;
		telechips,mhst_phy = <&mhst_phy>;
		telechips,dwc_otg_phy = <&dwc_otg_phy>;
		status = "disabled";
	};

	tcc_cipher@111C0000 {
		compatible = "telechips,tcc-cipher";
		reg = <0x111C0000 0x1E0 0x14100000 0x10C>;      //HSIO_Cipher , VPIC(VECTORED PRIORITY INTERRUPT CONTROLLER)
		interrupts = <GIC_SPI 45 IRQ_TYPE_LEVEL_HIGH>;
		clocks = <&clk_hsio HSIOBUS_CIPHER>;    //HSIOBUS_CIPHER
		status = "disabled";
	};

	/* for EVT0/EVT1 */
	pcie@11500000 {
		compatible = "telechips,pcie", "snps,dw-pcie";
		reg = <0x11500000 0x1000
		       0x11600000 0x1000
		       0x11610000 0x1000
		       0x114e0000 0x20000>;
		reg-names = "dbi", "phy", "cfg", "config";
		interrupts = <GIC_SPI 100 IRQ_TYPE_LEVEL_HIGH>;
		clocks = <&clk_peri PERI_PCIE_AUX>, <&clk_peri PERI_PCIE_APB>, <&clk_peri PERI_PCIE_REF_EXT>,
			 <&clk_fbus FBUS_HSIO>, <&clk_isoip_top ISOIP_TOP_PCIE>;
		clock-names = "pcie_aux", "pcie_apb", "pcie_ref_ext", "fbus_hsio", "pcie_phy";
		#address-cells = <3>;
		#size-cells = <2>;
		device_type = "pci";
		ranges = <0x81000000 0 0          0x114d0000 0 0x00010000   /* downstream I/O */
			  0x82000000 0 0x11400000 0x11400000 0 0x000d0000>; /* non-prefetchable memory */
		#interrupt-cells = <1>;
		interrupt-map-mask = <0 0 0 0>;
		interrupt-map = <0 0 0 0 &gic GIC_SPI 100 IRQ_TYPE_LEVEL_HIGH>;
		num-lanes = <1>;

		/* PHY setting */
		dcc_feedback = <0>;
		tx_impedance = <0x5>;
		rx_impedance = <0xd>;
		tx_amplitude = <0x35>;
		tx_deemphasis = <0x14>;
		pll_bias = <0x7>;
		rx_cdr_bw = <0x82>;

		status = "disabled";
	};

	/* for EVT2 */
	pcie@11680000 {
		compatible = "telechips,pcie", "snps,dw-pcie";
		reg = <0x11680000 0x1000
		       0x11600000 0x1000
		       0x11610000 0x1000
		       0x115e0000 0x20000>;
		reg-names = "dbi", "phy", "cfg", "config";
		interrupts = <GIC_SPI 100 IRQ_TYPE_LEVEL_HIGH>;
		clocks = <&clk_peri PERI_PCIE_AUX>, <&clk_peri PERI_PCIE_APB>, <&clk_peri PERI_PCIE_REF_EXT>,
			 <&clk_fbus FBUS_HSIO>, <&clk_isoip_top ISOIP_TOP_PCIE>;
		clock-names = "pcie_aux", "pcie_apb", "pcie_ref_ext", "fbus_hsio", "pcie_phy";
		#address-cells = <3>;
		#size-cells = <2>;
		device_type = "pci";
		ranges = <0x81000000 0 0          0x115d0000 0 0x00010000   /* downstream I/O */
			  0x82000000 0 0x11400000 0x11400000 0 0x001d0000>; /* non-prefetchable memory */
		#interrupt-cells = <1>;
		interrupt-map-mask = <0 0 0 0>;
		interrupt-map = <0 0 0 0 &gic GIC_SPI 100 IRQ_TYPE_LEVEL_HIGH>;
		num-lanes = <1>;

		/* PHY setting */
		dcc_feedback = <0>;
		tx_impedance = <0x5>;
		rx_impedance = <0xd>;
		tx_amplitude = <0x35>;
		tx_deemphasis = <0x14>;
		pll_bias = <0x7>;
		rx_cdr_bw = <0x82>;

		status = "disabled";
	};


	/*
	 * Graphic Bus Block
	 */

	gpu@10020000 {
		compatible = "arm,mali-400", "arm,mali-utgard";
//		status = "disabled";
		reg = <0x10020000 0x10000>;
		interrupts = <GIC_SPI 90 IRQ_TYPE_LEVEL_HIGH>,
			     <GIC_SPI 91 IRQ_TYPE_LEVEL_HIGH>,
			     <GIC_SPI 88 IRQ_TYPE_LEVEL_HIGH>,
			     <GIC_SPI 89 IRQ_TYPE_LEVEL_HIGH>,
			     <GIC_SPI 93 IRQ_TYPE_LEVEL_HIGH>,
			     <GIC_SPI 94 IRQ_TYPE_LEVEL_HIGH>,
			     <GIC_SPI 92 IRQ_TYPE_LEVEL_HIGH>;
		interrupt-names = "IRQGP", "IRQGPMMU", "IRQPP0", "IRQPPMMU0",
				  "IRQPP1", "IRQPPMMU1", "IRQPMU";
		shared_mem_size = <512>;
		clocks = <&clk_fbus FBUS_GPU>;
		clock-names = "mali_clk";
	};

	telechips,ion {
		compatible = "telechips,tcc-ion";
//		status = "disabled";
		#address-cells = <1>;
		#size-cells = <0>;

		ion-heap@0 {
			reg = <0>;
			telechips,ion-heap-name = "ion_noncontig_heap";
		};

		ion-heap@1 {
			reg = <1>;
			telechips,ion-heap-name = "ion_contig_heap";
		};

		ion-heap@2 {
			reg = <2>;
			telechips,ion-heap-name = "ion_carveout_heap";
		};
	};

	overlaymixer:overlaymixer@1A100000 {
		compatible = "vivante.gc";
		reg = <0x1A100000 0x1000>;
		interrupts = <GIC_SPI 95 IRQ_TYPE_LEVEL_HIGH>;
		clocks =<&clk_fbus FBUS_G2D>;
		status ="disabled";
	};

	/*
	 * Display Bus Block
	 */
	vioc_rdma0: vioc_rdma_@12000400 {
		reg = <0x12000400 0x100 0x1200A0D8 0x4>;
		interrupts = <GIC_SPI 84 IRQ_TYPE_LEVEL_HIGH>;
		#vioc_rdma-cells = <0>;
	};

	vioc_rdma1: vioc_rdma_@12000500 {
		reg = <0x12000500 0x100 0x1200A0D8 0x4>;
		interrupts = <GIC_SPI 84 IRQ_TYPE_LEVEL_HIGH>;
		#vioc_rdma-cells = <0>;
	};

	vioc_rdma2: vioc_rdma_@12000600 {
		reg = <0x12000600 0x100 0x1200A0D8 0x4>;
		interrupts = <GIC_SPI 84 IRQ_TYPE_LEVEL_HIGH>;
		#vioc_rdma-cells = <0>;
	};

	vioc_rdma3: vioc_rdma_@12000700 {
		reg = <0x12000700 0x100 0x1200A0D8 0x4>;
		interrupts = <GIC_SPI 84 IRQ_TYPE_LEVEL_HIGH>;
		#vioc_rdma-cells = <0>;
	};

	vioc_rdma4: vioc_rdma_@12000800 {
		reg = <0x12000800 0x100 0x1200A0D8 0x4>;
		interrupts = <GIC_SPI 84 IRQ_TYPE_LEVEL_HIGH>;
		#vioc_rdma-cells = <0>;
	};

	vioc_rdma5: vioc_rdma_@12000900 {
		reg = <0x12000900 0x100 0x1200A0D8 0x4>;
		interrupts = <GIC_SPI 84 IRQ_TYPE_LEVEL_HIGH>;
		#vioc_rdma-cells = <0>;
	};

	vioc_rdma6: vioc_rdma_@12000A00 {
		reg = <0x12000A00 0x100 0x1200A0D8 0x4>;
		interrupts = <GIC_SPI 84 IRQ_TYPE_LEVEL_HIGH>;
		#vioc_rdma-cells = <0>;
	};

	vioc_rdma7: vioc_rdma_@12000B00 {
		reg = <0x12000B00 0x100 0x1200A0D8 0x4>;
		interrupts = <GIC_SPI 84 IRQ_TYPE_LEVEL_HIGH>;
		#vioc_rdma-cells = <0>;
	};

	vioc_rdma8: vioc_rdma_@12000C00 {
		reg = <0x12000C00 0x100 0x1200A0D8 0x4>;
		interrupts = <GIC_SPI 84 IRQ_TYPE_LEVEL_HIGH>;
		#vioc_rdma-cells = <0>;
	};

	vioc_rdma9: vioc_rdma_@12000D00 {
		reg = <0x12000D00 0x100 0x1200A0D8 0x4>;
		interrupts = <GIC_SPI 84 IRQ_TYPE_LEVEL_HIGH>;
		#vioc_rdma-cells = <0>;
	};

	vioc_rdma10: vioc_rdma_@12000E00 {
		reg = <0x12000E00 0x100 0x1200A0D8 0x4>;
		interrupts = <GIC_SPI 84 IRQ_TYPE_LEVEL_HIGH>;
		#vioc_rdma-cells = <0>;
	};

	vioc_rdma11: vioc_rdma_@12000F00 {
		reg = <0x12000F00 0x100 0x1200A0D8 0x4>;
		interrupts = <GIC_SPI 84 IRQ_TYPE_LEVEL_HIGH>;
		#vioc_rdma-cells = <0>;
	};

	vioc_rdma12: vioc_rdma_@12001000 {
		reg = <0x12001000 0x100 0x1200A0D8 0x4>;
		interrupts = <GIC_SPI 84 IRQ_TYPE_LEVEL_HIGH>;
		#vioc_rdma-cells = <0>;
	};

	vioc_rdma13: vioc_rdma_@12001100 {
		reg = <0x12001100 0x100 0x1200A0D8 0x4>;
		interrupts = <GIC_SPI 84 IRQ_TYPE_LEVEL_HIGH>;
		#vioc_rdma-cells = <0>;
	};

	vioc_rdma14: vioc_rdma_@12001200 {
		reg = <0x12001200 0x100 0x1200A0D8 0x4>;
		interrupts = <GIC_SPI 84 IRQ_TYPE_LEVEL_HIGH>;
		#vioc_rdma-cells = <0>;
	};

	vioc_rdma15: vioc_rdma_@12001300 {
		reg = <0x12001300 0x100 0x1200A0D8 0x4>;
		interrupts = <GIC_SPI 84 IRQ_TYPE_LEVEL_HIGH>;
		#vioc_rdma-cells = <0>;
	};

	vioc_rdma16: vioc_rdma_@12001400 {
		reg = <0x12001400 0x100 0x1200A0D8 0x4>;
		interrupts = <GIC_SPI 84 IRQ_TYPE_LEVEL_HIGH>;
		#vioc_rdma-cells = <0>;
	};

	vioc_rdma17: vioc_rdma_@12001500 {
		reg = <0x12001500 0x100 0x1200A0D8 0x4>;
		interrupts = <GIC_SPI 84 IRQ_TYPE_LEVEL_HIGH>;
		#vioc_rdma-cells = <0>;
	};

	vioc_wmix0: vioc_wmix@12001800 {
		reg = <0x12001800 0x100 0x1200A0DC 0x4>;
		interrupts = <GIC_SPI 84 IRQ_TYPE_LEVEL_HIGH>;
		#vioc_wmix-cells = <1>;
	};

	vioc_wmix1: vioc_wmix@12001900 {
		reg = <0x12001900 0x100 0x1200A0DC 0x4>;
		interrupts = <GIC_SPI 84 IRQ_TYPE_LEVEL_HIGH>;
		#vioc_wmix-cells = <1>;
	};

	vioc_wmix2: vioc_wmix@12001A00 {
		reg = <0x12001A00 0x100 0x1200A0DC 0x4>;
		interrupts = <GIC_SPI 84 IRQ_TYPE_LEVEL_HIGH>;
		#vioc_wmix-cells = <1>;
	};

	vioc_wmix3: vioc_wmix@12001B00 {
		reg = <0x12001B00 0x100 0x1200A0DC 0x4>;
		interrupts = <GIC_SPI 84 IRQ_TYPE_LEVEL_HIGH>;
		#vioc_wmix-cells = <1>;
	};

	vioc_wmix4: vioc_wmix@12001C00 {
		reg = <0x12001C00 0x100 0x1200A0DC 0x4>;
		interrupts = <GIC_SPI 84 IRQ_TYPE_LEVEL_HIGH>;
		#vioc_wmix-cells = <1>;
	};

	vioc_wmix5: vioc_wmix@12001D00 {
		reg = <0x12001D00 0x100 0x1200A0DC 0x4>;
		interrupts = <GIC_SPI 84 IRQ_TYPE_LEVEL_HIGH>;
		#vioc_wmix-cells = <1>;
	};

	vioc_wmix6: vioc_wmix@12001E00 {
		reg = <0x12001E00 0x100 0x1200A0DC 0x4>;
		interrupts = <GIC_SPI 84 IRQ_TYPE_LEVEL_HIGH>;
		#vioc_wmix-cells = <1>;
	};

	vioc_sc0: vioc_sc@12002000 {
		reg = <0x12002000 0x100 0x1200A12C 0x4>;
		interrupts = <GIC_SPI 84 IRQ_TYPE_LEVEL_HIGH>;
		#vioc_sc-cells = <1>;
	};

	vioc_sc1: vioc_sc@12002100 {
		reg = <0x12002100 0x100 0x1200A12C 0x4>;
		interrupts = <GIC_SPI 84 IRQ_TYPE_LEVEL_HIGH>;
		#vioc_sc-cells = <1>;
	};

	vioc_sc2: vioc_sc@12002200 {
		reg = <0x12002200 0x100 0x1200A12C 0x4>;
		interrupts = <GIC_SPI 84 IRQ_TYPE_LEVEL_HIGH>;
		#vioc_sc-cells = <1>;
	};

	vioc_sc3: vioc_sc@12002300 {
		reg = <0x12002300 0x100 0x1200A12C 0x4>;
		interrupts = <GIC_SPI 84 IRQ_TYPE_LEVEL_HIGH>;
		#vioc_sc-cells = <1>;
	};

	vioc_sc4: vioc_sc@12002400 {
		reg = <0x12002400 0x100 0x1200A12C 0x4>;
		interrupts = <GIC_SPI 84 IRQ_TYPE_LEVEL_HIGH>;
		#vioc_sc-cells = <1>;
	};

	vioc_sc5: vioc_sc@12002500 {
		reg = <0x12002500 0x100 0x1200A12C 0x4>;
		interrupts = <GIC_SPI 84 IRQ_TYPE_LEVEL_HIGH>;
		#vioc_sc-cells = <1>;
	};

	vioc_wdma0: vioc_wdma_@12002800 {
		reg = <0x12002800 0x100 0x1200A0DC 0x4>;
		interrupts = <GIC_SPI 84 IRQ_TYPE_LEVEL_HIGH>;
		#vioc_wdma-cells = <0>;
	};

	vioc_wdma1: vioc_wdma_@12002900 {
		reg = <0x12002900 0x100 0x1200A0DC 0x4>;
		interrupts = <GIC_SPI 84 IRQ_TYPE_LEVEL_HIGH>;
		#vioc_wdma-cells = <0>;
	};

	vioc_wdma2: vioc_wdma_@12002A00 {
		reg = <0x12002A00 0x100 0x1200A0DC 0x4>;
		interrupts = <GIC_SPI 84 IRQ_TYPE_LEVEL_HIGH>;
		#vioc_wdma-cells = <0>;
	};

	vioc_wdma3: vioc_wdma_@12002B00 {
		reg = <0x12002B00 0x100 0x1200A0DC 0x4>;
		interrupts = <GIC_SPI 84 IRQ_TYPE_LEVEL_HIGH>;
		#vioc_wdma-cells = <0>;
	};

	vioc_wdma4: vioc_wdma_@12002C00 {
		reg = <0x12002C00 0x100 0x1200A0DC 0x4>;
		interrupts = <GIC_SPI 84 IRQ_TYPE_LEVEL_HIGH>;
		#vioc_wdma-cells = <0>;
	};

	vioc_wdma5: vioc_wdma_@12002D00 {
		reg = <0x12002D00 0x100 0x1200A0DC 0x4>;
		interrupts = <GIC_SPI 84 IRQ_TYPE_LEVEL_HIGH>;
		#vioc_wdma-cells = <0>;
	};

	vioc_wdma6: vioc_wdma_@12002E00 {
		reg = <0x12002E00 0x100 0x1200A0DC 0x4>;
		interrupts = <GIC_SPI 84 IRQ_TYPE_LEVEL_HIGH>;
		#vioc_wdma-cells = <0>;
	};

	vioc_wdma7: vioc_wdma_@12002F00 {
		reg = <0x12002F00 0x100 0x1200A0DC 0x4>;
		interrupts = <GIC_SPI 84 IRQ_TYPE_LEVEL_HIGH>;
		#vioc_wdma-cells = <0>;
	};

	vioc_wdma8: vioc_wdma_@12003000 {
		reg = <0x12003000 0x100 0x1200A0DC 0x4>;
		interrupts = <GIC_SPI 84 IRQ_TYPE_LEVEL_HIGH>;
		#vioc_wdma-cells = <0>;
	};

	cifport: cifport@1238000c {
		compatible = "telechips,cif-port";
		reg = <0x1238000c 0x4>;
		status = "disabled";
	};

	lvds@12380040 {
		compatible = "telechips,tcc-lvds";
		reg = <0x12380040 0x64>;
		clocks = <&clk_isoip_ddi ISOIP_DDB_LVDS>;
		statue = "disable";
	};

	vioc_config:vioc_config@1200a000{
		compatible = "telechips,vioc_config";
		reg = <0x1200a000 0x1000>;
		status = "disabled";
	};

	vioc_intr:vioc_intr@1200a400{
		compatible = "telechips,vioc_intr";
		interrupts = <GIC_SPI 84 IRQ_TYPE_LEVEL_HIGH>;
		status = "disabled";
	};

	vioc_vin_demux:vioc_vin_demux@1200a800{
		compatible = "telechips,vioc_vin_demux";
		reg = <0x1200a800 0x1000>;
		status = "disabled";
	};

	ddi_config:ddi_config@12380000 {
		compatible = "telechips,ddi_config";
		reg = <0x12380000 0x70>;
		status = "disabled";
	};

	ddi_nexguard:ddi_nexguard@124C0000 {
		compatible = "telechips,ddi_nexguard";
		reg = <0x124C0000 0x40>;
		status = "disabled";
	};

	output_config: output_config@12100200 {
		compatible = "telechips,output_config";
		reg = <0x12100200 0x10>;
		status = "disabled";
	};

	vioc_disp:vioc_disp@12000000{
		compatible = "telechips,vioc_disp";
		reg = <0x12000000 0x100 0x12000100 0x100>;
		interrupts = <GIC_SPI 84 IRQ_TYPE_LEVEL_HIGH>, <GIC_SPI 84 IRQ_TYPE_LEVEL_HIGH>;
		clocks = <&clk_ddi DDIBUS_VIOC>, <&clk_peri PERI_LCD0>, <&clk_peri PERI_LCD1>;
		clock-names = "ddi-clk", "disp0-clk", "disp1-clk";
		status = "disabled";
	};

	vioc_wmix:vioc_wmix@12000000{
	        compatible = "telechips,vioc_wmix";
	        reg = <0x12001800 0x100 0x12001900 0x100 0x12001A00 0x100 0x12001B00 0x100 0x12001C00 0x100 0x12001D00 0x100 0x12001E00 0x100>;
	        status = "disabled";
	};

	vioc_wwdma:vioc_swdma@12000000{
	        compatible = "telechips,vioc_wdma";
	        reg = <0x12002800 0x100 0x12002900 0x100 0x12002A00 0x100 0x12002B00 0x100 0x12002C00 0x100 0x12002D00 0x100 0x12002E00 0x100 0x12002F00 0x100 0x12003000 0x100>;
	        status = "disabled";
	};

	vioc_display0:vioc_display0@12000000{
		compatible = "telechips,vioc_display0";
		reg = <0x12000000 0x100>;
		interrupts = <GIC_SPI 84 IRQ_TYPE_LEVEL_HIGH>;
		clocks = <&clk_ddi DDIBUS_VIOC &clk_peri PERI_LCD0>;
		disp_number = <0>;
	};

	vioc_display1:vioc_display1@12000000{
		compatible = "telechips,vioc_display1";
		reg = <0x12000100 0x100>;
		interrupts = <GIC_SPI 84 IRQ_TYPE_LEVEL_HIGH>;
		clocks = <&clk_ddi DDIBUS_VIOC &clk_peri PERI_LCD1>;
		disp_number = <1>;
	};

	vioc_rdma:vioc_rdma@12000400{
		compatible = "telechips,vioc_rdma";
		status = "disabled";
		reg = <0x12000400 0x100 0x12000500 0x100 0x12000600 0x100 0x12000700 0x100
				0x12000800 0x100 0x12000900 0x100 0x12000a00 0x100  0x12000b00 0x100
				0x12000c00 0x100 0x12000d00 0x100 0x12000e00 0x100  0x12000f00 0x100
				0x12001000 0x100 0x12001100 0x100 0x12001200 0x100  0x12001300 0x100
				0x12001400 0x100  0x12001500 0x100>;
		interrupts = <GIC_SPI 84 IRQ_TYPE_LEVEL_HIGH>,
			     <GIC_SPI 84 IRQ_TYPE_LEVEL_HIGH>,
			     <GIC_SPI 84 IRQ_TYPE_LEVEL_HIGH>,
			     <GIC_SPI 84 IRQ_TYPE_LEVEL_HIGH>,
			     <GIC_SPI 84 IRQ_TYPE_LEVEL_HIGH>,
			     <GIC_SPI 84 IRQ_TYPE_LEVEL_HIGH>,
			     <GIC_SPI 84 IRQ_TYPE_LEVEL_HIGH>,
			     <GIC_SPI 84 IRQ_TYPE_LEVEL_HIGH>,
			     <GIC_SPI 84 IRQ_TYPE_LEVEL_HIGH>,
			     <GIC_SPI 84 IRQ_TYPE_LEVEL_HIGH>,
			     <GIC_SPI 84 IRQ_TYPE_LEVEL_HIGH>,
			     <GIC_SPI 84 IRQ_TYPE_LEVEL_HIGH>,
			     <GIC_SPI 84 IRQ_TYPE_LEVEL_HIGH>,
			     <GIC_SPI 84 IRQ_TYPE_LEVEL_HIGH>,
			     <GIC_SPI 84 IRQ_TYPE_LEVEL_HIGH>,
			     <GIC_SPI 84 IRQ_TYPE_LEVEL_HIGH>,
			     <GIC_SPI 84 IRQ_TYPE_LEVEL_HIGH>,
			     <GIC_SPI 84 IRQ_TYPE_LEVEL_HIGH>;
	};

	vioc_wmixer:vioc_wmixer@12001800{
		reg = <0x12001800 0x100 0x12001900 0x100 0x12001a00 0x100 0x12001b00 0x100
				0x12001c00 0x100 0x12001d00 0x100 0x12001e00 0x100>;
		interrupts = <GIC_SPI 84 IRQ_TYPE_LEVEL_HIGH>,
			     <GIC_SPI 84 IRQ_TYPE_LEVEL_HIGH>,
			     <GIC_SPI 84 IRQ_TYPE_LEVEL_HIGH>,
			     <GIC_SPI 84 IRQ_TYPE_LEVEL_HIGH>,
			     <GIC_SPI 84 IRQ_TYPE_LEVEL_HIGH>,
			     <GIC_SPI 84 IRQ_TYPE_LEVEL_HIGH>,
			     <GIC_SPI 84 IRQ_TYPE_LEVEL_HIGH>;
	};

	vioc_scaler:vioc_scaler@12002000{
		compatible = "telechips,scaler";
		reg = <0x12002000 0x100 0x12002100 0x100 0x12002200 0x100 0x12002300 0x100 0x12002400 0x100>;
		status = "disabled";
	};

	vioc_wdma:vioc_wdma@12002800{
		reg = <0x12002800 0x700 0x12002900 0x100 0x12002a00 0x100 0x12002b00 0x100
				0x12002c00 0x100 0x12002d00 0x100 0x12002e00 0x100  0x12002f00 0x100
				0x12003000 0x100 >;
		interrupts = <GIC_SPI 84 IRQ_TYPE_LEVEL_HIGH>,
			     <GIC_SPI 84 IRQ_TYPE_LEVEL_HIGH>,
			     <GIC_SPI 84 IRQ_TYPE_LEVEL_HIGH>,
			     <GIC_SPI 84 IRQ_TYPE_LEVEL_HIGH>,
			     <GIC_SPI 84 IRQ_TYPE_LEVEL_HIGH>,
			     <GIC_SPI 84 IRQ_TYPE_LEVEL_HIGH>,
			     <GIC_SPI 84 IRQ_TYPE_LEVEL_HIGH>,
			     <GIC_SPI 84 IRQ_TYPE_LEVEL_HIGH>,
			     <GIC_SPI 84 IRQ_TYPE_LEVEL_HIGH>;
	};

	vioc_vin:vioc_vin@12004000{
		compatible = "telechips,vioc_vin";
		reg = <0x12004000 0x400 0x12005000 0x400 0x12006000 0x400 0x12007000 0x400
				0x12004400 0x600 0x12005400 0x600 0x12006400 0x600 0x12007400 0x600>;
		interrupts = <GIC_SPI 84 IRQ_TYPE_LEVEL_HIGH>,
			     <GIC_SPI 84 IRQ_TYPE_LEVEL_HIGH>,
			     <GIC_SPI 84 IRQ_TYPE_LEVEL_HIGH>,
			     <GIC_SPI 84 IRQ_TYPE_LEVEL_HIGH>,
			     <GIC_SPI 84 IRQ_TYPE_LEVEL_HIGH>,
			     <GIC_SPI 84 IRQ_TYPE_LEVEL_HIGH>,
			     <GIC_SPI 84 IRQ_TYPE_LEVEL_HIGH>,
			     <GIC_SPI 84 IRQ_TYPE_LEVEL_HIGH>,
			     <GIC_SPI 84 IRQ_TYPE_LEVEL_HIGH>;

	};

	vioc_viqe:vioc_viqe@1200d000{
		compatible = "telechips,vioc_viqe";
		status = "disabled";
		reg = <0x1200d000 0x1000 0x12010000 0x1000>;
	};

	vioc_lut:vioc_lut@12009000{
		compatible = "telechips,vioc_lut";
		reg = <0x12009000 0x800>;
		status = "okay";
	};

	vioc_deintls:vioc_deintls@12003800{
		compatible = "telechips,vioc_deintls";
		reg = <0x12003800 0x100>;
		status = "disabled";
	};

	vioc_rdma_arbitor:vioc_rdma_arbitor@12003f00{
		reg = <0x12003f00 0x20 0x12003f20 0x20 0x12003f40 0x20 0x12003f60 0x20>;
		arbitor_num = <4>;
	};

	vioc_mc@12009000{
		compatible = "telechips,vioc_mc";
		reg = <0x12001600 0x100 0x12001700 0x100>;
		status = "disabled";
	};

	vioc_dtrc@12002600{
	    compatible = "telechips,vioc_dtrc";
	    reg = <0x12002600 0x100 0x12002700 0x100>;
	    status = "disabled";
	};

	vioc_disp_dv@12001F00{
		compatible = "telechips,vioc_disp_dv";
		reg = <0x12001F00 0x40000 0x12003100 0x40000 0x12003D00 0x40000 0x12003E00 0x40000>;
		status = "disabled";
	};

	vioc_vedr@12001F00{
		compatible = "telechips,vioc_vedr";
		reg = <0x12500000 0x40000 0x12540000 0x40000 0x12580000 0x40000 0x125C0000 0x40000>;
		status = "disabled";
	};

	fbdisplay: fbdisplay@12000000 {
		compatible = "telechips,vioc-fb";
		status = "disabled";
		reg = <0x12000000 0x10000>;
		telechips,fbdisplay_num = <1>;
		telechips,rdma_arbitor=<&vioc_rdma_arbitor>;
		memory-region = <&pmap_fb_video &pmap_fb1_video>;

		fbdisplay0:fbdisplay0@12000000{
			telechips,disp = <&vioc_disp VIOC_DISP0>;
			telechips,wmixer = <&vioc_wmixer VIOC_WMIX0>;
			telechips,rdma = <&vioc_rdma VIOC_RDMA00 VIOC_RDMA01 VIOC_RDMA02 VIOC_RDMA03>;
			telechips,rdma,path = <VIOC_SC_RDMA_00 VIOC_SC_RDMA_01 VIOC_SC_RDMA_02 VIOC_SC_RDMA_03>;
			telechips,wdma = <&vioc_wdma VIOC_WDMA00>;
		};


		fbdisplay1:fbdisplay1@12000100{
			telechips,disp = <&vioc_disp VIOC_DISP1>;
			telechips,wmixer = <&vioc_wmixer VIOC_WMIX1>;
			telechips,rdma = <&vioc_rdma VIOC_RDMA04 VIOC_RDMA05 VIOC_RDMA07>;
			telechips,rdma,path = <VIOC_SC_RDMA_04 VIOC_SC_RDMA_05 VIOC_SC_RDMA_07>;
			telechips,wdma = <&vioc_wdma VIOC_WDMA01>;
		};
	};


	tcc_overlay_drv {
		compatible = "telechips,tcc_overlay";
		fbdisplay-overlay = <&fbdisplay>;
		rdmas = <&vioc_rdma VIOC_RDMA00 VIOC_RDMA01 VIOC_RDMA02 VIOC_RDMA03 VIOC_RDMA04 VIOC_RDMA05 VIOC_RDMA07>;
		wmixs = <&vioc_wmix VIOC_WMIX0 VIOC_WMIX1>;
		status = "okay";
	};

	tcc_video_viqe {
		compatible = "telechips,tcc_viqe";
		status = "disabled";

		tcc_viqe_viqe_common {
			telechips,viqe,0 = <&vioc_viqe VIOC_VIQE0>;
			telechips,viqe,1 = <&vioc_viqe VIOC_VIQE1>;
			vioc_deintls = <VIOC_DEINTLS0>;
			board_num=<0>;
		};

		tcc_video_viqe_lcd {
			telechips,wmixer = <&vioc_wmixer VIOC_WMIX1>;
			telechips,rdma,60 = <&vioc_rdma VIOC_RDMA07>;
			telechips,disp = <&vioc_disp VIOC_DISP1>;
			telechips,sc = <&vioc_scaler VIOC_SCALER1>;
		};

		tcc_video_viqe_external {
			telechips,wmixer = <&vioc_wmixer VIOC_WMIX0>;
			telechips,rdma,60 = <&vioc_rdma VIOC_RDMA03>;
			telechips,disp = <&vioc_disp VIOC_DISP0>;
			telechips,sc = <&vioc_scaler VIOC_SCALER1>;
		};

		tcc_video_viqe_external_sub {
			telechips,wmixer = <&vioc_wmixer VIOC_WMIX0>;
			telechips,rdma,60 = <&vioc_rdma VIOC_RDMA02>;
			telechips,disp = <&vioc_disp VIOC_DISP0>;
			telechips,sc = <&vioc_scaler VIOC_SCALER3>;
		};

		tcc_video_main_m2m{
			main_rdma_num_m2m = <VIOC_VIQE_RDMA_16>;
			telechips,main_rdma,m2m = <&vioc_rdma VIOC_RDMA16>;
		};

		tcc_video_sub_m2m {
			sub_rdma_num_m2m = <VIOC_VIQE_RDMA_07>;
			telechips,sub_rdma,m2m = <&vioc_rdma VIOC_RDMA07>;
		};

		tcc_video_scaler_main_m2m {
			clocks = <&clk_ddi DDIBUS_VIOC>;
			m2m_sc_rdma = <&vioc_rdma VIOC_RDMA16>;
			m2m_sc_scaler = <&vioc_scaler VIOC_SCALER1>;	/* id:1, path:17 */
			m2m_sc_wmix = <&vioc_wmixer VIOC_WMIX5>;	/* id:5, path:6 */
			m2m_sc_wdma = <&vioc_wdma VIOC_WDMA06>;
			m2m_sc_settop_support = <1>;
		};

		tcc_video_scaler_sub_m2m {
			clocks = <&clk_ddi DDIBUS_VIOC>;
			m2m_sc_rdma = <&vioc_rdma VIOC_RDMA07>;
			m2m_sc_scaler = <&vioc_scaler VIOC_SCALER3>;	/* id:3, path:7 */
			m2m_sc_wmix = <&vioc_wmixer VIOC_WMIX1>;	/* id:1, path:3 */
			m2m_sc_wdma = <&vioc_wdma VIOC_WDMA01>;
			m2m_sc_settop_support = <1>;
		};
	};

	vout_drv0: vout_drv@0 {
	    compatible = "telechips,v4l2_vout";
	    reg = <0x0 0x0>;						/* Dummy regs. */
	    clocks = <&clk_ddi DDIBUS_VIOC>;

	    rdma = <&vioc_rdma VIOC_RDMA03>;
	    wmix = <&vioc_wmixer VIOC_WMIX0>;
	    disp = <&vioc_disp VIOC_DISP0>;

	    subplane_rdma = <&vioc_rdma VIOC_RDMA02>;
	    m2m_subplane_rdma = <&vioc_rdma VIOC_RDMA10>;
	    m2m_rdma = <&vioc_rdma VIOC_RDMA11>;
	    m2m_wmix	= <&vioc_wmixer VIOC_WMIX2>;
	    m2m_wdma = <&vioc_wdma VIOC_WMIX2>;

	    deintl_block = <&vioc_viqe VIOC_VIQE0>;
	    scaler = <&vioc_scaler VIOC_SCALER1>;

	    status = "disabled";
	};

	vout_drv1: vout_drv@1 {
	    compatible = "telechips,v4l2_vout";
	    reg = <0x1 0x0>;						/* Dummy regs. */
	    clocks = <&clk_ddi DDIBUS_VIOC>;

	    rdma = <&vioc_rdma VIOC_RDMA07>;
	    wmix = <&vioc_wmixer VIOC_WMIX1>;
	    disp = <&vioc_disp VIOC_DISP1>;

	    subplane_rdma = <&vioc_rdma VIOC_RDMA05>;
	    m2m_subplane_rdma = <&vioc_rdma VIOC_RDMA13>;
	    m2m_rdma = <&vioc_rdma VIOC_RDMA12>;
	    m2m_wmix	= <&vioc_wmixer VIOC_WMIX3>;
	    m2m_wdma = <&vioc_wdma VIOC_WDMA03>;

	    deintl_block = <&vioc_deintls VIOC_DEINTLS0>;
	    deintl_plugin = <VIOC_DEINTLS_RDMA_12 VIOC_DEINTLS_RDMA_07>;					/* 8: rdma12(m2m) 7: rdma7(otf) */

	    scaler = <&vioc_scaler VIOC_SCALER3>;
	    scaler_plugin = <VIOC_SC_WDMA_03 VIOC_SC_RDMA_07>;					/* 23: wdma3(m2m) 7: rdma7(otf) */

	    status = "disabled";
	};

	tcc_tve: tve@12200000 {
		status = "disabled";
		compatible = "telechips,tcc-tve";
		reg = <0x12200000 0x100 0x12200800 0x10>;
		clocks = <&clk_ddi DDIBUS_NTSCPAL &clk_isoip_ddi ISOIP_DDB_VDAC>;
	};

	composite {
		status = "disabled";
		compatible = "telechips,tcc-composite";
		clocks = <&clk_peri PERI_LCD0 &clk_peri PERI_LCD1>;
		vioc-frequency = <27000000>;
		scaler = <&vioc_scaler VIOC_SCALER3>;
		config = <&vioc_config>;
		ddicfg = <&ddi_config>;
	};

	component {
		status = "disabled";
		compatible = "telechips,tcc-component";
		clocks = <&clk_peri PERI_LCD0 &clk_peri PERI_LCD1>;
		vioc-frequency = <74250000>;
		scaler = <&vioc_scaler VIOC_SCALER3>;
		config = <&vioc_config>;
		ddicfg = <&ddi_config>;
		pinctrl-names = "default", "idle";
		pinctrl-0 = <&lcd_lpxclk &lcd_lhsync &lcd_lvsync &lcd_lacbias &lcd_lpd>;
		pinctrl-1 = <&lcd_lpxclk_idle &lcd_lhsync_idle &lcd_lvsync_idle &lcd_lacbias_idle &lcd_lpd_idle>;
	};

	output_starter {
		status = "disabled";
		compatible = "telechips,tcc-output-starter";
		scaler = <&vioc_scaler VIOC_SCALER2>;
		ddicfg = <&ddi_config>;
		tve = <&tcc_tve>;

		composite_starter {
			label = "composite output starter";
			clocks = <&clk_peri PERI_LCD0>, <&clk_peri PERI_LCD1>;
			clock-names = "lcdc0-clk", "lcdc1-clk";
			lcdc-clock-frequency = <27000000>;
		};

		component_starter {
			label = "component output starter";
			clocks = <&clk_peri PERI_LCD0>, <&clk_peri PERI_LCD1>;
			clock-names = "lcdc0-clk", "lcdc1-clk";
			lcdc-clock-frequency = <74250000>;
		};
	};

	jpeg_enc {
		compatible = "telechips-jpegenc";
		status = "disabled";
		clocks = <&clk_fbus FBUS_VBUS &clk_vpu VIDEOBUS_JENC>;
		jpu_base_addr = <0x75300000>;
	};

	/*
	 * Video Bus Block
	 */

	vpu_dev_mgr {
		compatible = "telechips,vpu_dev_mgr";
		reg = <0x15000000 0x4000>;
		interrupts = <GIC_SPI 96 IRQ_TYPE_LEVEL_HIGH>;
		clocks = <&clk_fbus FBUS_VBUS &clk_fbus FBUS_CODA &clk_vpu VIDEOBUS_CODA_BUS &clk_vpu VIDEOBUS_CODA_CORE>;
	};

	hevc_dev_mgr {
		compatible = "telechips,hevc_dev_mgr";
		reg = <0x15200000 0xA000>;
		interrupts = <GIC_SPI 98 IRQ_TYPE_LEVEL_HIGH>;
		clocks = <&clk_fbus FBUS_VBUS &clk_fbus FBUS_CHEVC &clk_fbus FBUS_VHEVC &clk_fbus FBUS_BHEVC &clk_vpu VIDEOBUS_HEVC_BUS &clk_vpu VIDEOBUS_HEVC_CORE>;
	};

	jpu_dev_mgr {
	    compatible = "telechips,jpu_dev_mgr";
	    reg = <0x15180000 0x1000>;
	    interrupts = <GIC_SPI 97 IRQ_TYPE_LEVEL_HIGH>;
	    clocks = <&clk_fbus FBUS_VBUS &clk_vpu VIDEOBUS_JENC>;
	};

	vp9_dev_mgr {
	    compatible = "telechips,vp9_dev_mgr";
	    reg = <0x15280000 0x1000>;
	    interrupts = <GIC_SPI 99 IRQ_TYPE_LEVEL_HIGH>;
	    clocks = <&clk_fbus FBUS_VBUS &clk_vpu VIDEOBUS_VP9>;
	};

	vpu_4k_d2_dev_mgr {
		compatible = "telechips,vpu_4k_d2_dev_mgr";
		reg = <0x15200000 0xA000>;
		interrupts = <GIC_SPI 98 IRQ_TYPE_LEVEL_HIGH>;
		clocks = <&clk_fbus FBUS_VBUS &clk_fbus FBUS_CHEVC &clk_fbus FBUS_VHEVC &clk_fbus FBUS_BHEVC &clk_vpu VIDEOBUS_HEVC_BUS &clk_vpu VIDEOBUS_HEVC_CORE>;
	};

	/*
	 * Misc. Devices
	 */
	scaler_drv_common: scaler_drv_common@1 {
		compatible = "telechips,scaler_drv_common";
		reg = <0x1 0x0>;
		interrupts = <GIC_SPI 84 IRQ_TYPE_LEVEL_HIGH>;
		clocks = <&clk_ddi DDIBUS_VIOC>;
		status = "disabled";
	};


	scaler_drv1: scaler_drv@1 {
		compatible = "telechips,scaler_drv";
		reg = <0x1 0x0>;
		clocks = <&clk_ddi DDIBUS_VIOC>;
		status = "disabled";
	};

	scaler_drv3: scaler_drv@3 {
		compatible = "telechips,scaler_drv";
		reg = <0x3 0x0>;
		clocks = <&clk_ddi DDIBUS_VIOC>;
		status = "disabled";
	};

	wmixer_drv0: wmixer_drv@0 {
		compatible = "telechips,wmixer_drv";
		reg = <0x0 0x0>;	/* Dummy regs. */
		clocks = <&clk_ddi DDIBUS_VIOC>;
		rdmas = <&vioc_rdma VIOC_RDMA17>;
		scalers = <&vioc_scaler VIOC_SCALER3>;	/* id:0, path:19 */
		wmixs = <&vioc_wmix VIOC_WMIX6>;	/* id:5, path:- TODO: WMIX_MAX occurs error*/
		wdmas = <&vioc_wdma VIOC_WDMA08>;
		status = "disabled";
	};

	wmixer_drv1: wmixer_drv@1 {
		compatible = "telechips,wmixer_drv";
		reg = <0x1 0x0>;	/* Dummy regs. */
		clocks = <&clk_ddi DDIBUS_VIOC>;
		rdmas = <&vioc_rdma VIOC_RDMA13>;
		wmixs = <&vioc_wmix VIOC_WMIX3>;	/* id:3, path:- TODO: WMIX_MAX occurs error*/
		wdmas = <&vioc_wdma VIOC_WDMA03>;
		status = "disabled";
	};

	wdma_drv0: wdma_drv@0 {
		compatible = "telechips,tcc_wdma";
		clocks = <&clk_ddi DDIBUS_VIOC>;
		wdma-fbdisplay = <&fbdisplay>;
		scalers = <&vioc_scaler VIOC_SCALER0>, <&vioc_scaler VIOC_SCALER0>;       /* id:1, path:20 (wdma 0 path), 21(wdma 1 path) */
		wdmas = <&vioc_wdma VIOC_WDMA00>, <&vioc_wdma VIOC_WDMA01>;   /* id:1, path: wmix output mixed pah */
		wmixs = <&vioc_wmix VIOC_WMIX0>, <&vioc_wmix VIOC_WMIX1>;      /* id:1, path: input rdma mixed path */
		status = "okay";
	};

	hdmi_tx_20: hdmi_tx_20@12400000 {
		compatible = "telechips,dw-hdmi-tx";
		/* Register */
		reg = <0x12400000 0x20000 0x12440000 0x1000 0x12480000 0x1000 0x163C0000 0x10 0x16051000 0x000018>;
		reg-names = "hdmi_link", "hdcp_2.2", "hdmi_phy", "i2c_port_cfg";
		/* Interrupt */

		interrupts = <GIC_SPI 85 IRQ_TYPE_LEVEL_HIGH>,
				<GIC_SPI 86 IRQ_TYPE_LEVEL_HIGH>, 
				<GIC_SPI 87 IRQ_TYPE_LEVEL_HIGH>;
		interrupt-names = "hdmi_link", "hdcp_2.2", "hdmi_cec";
		/* Clocks */
		clocks = <&clk_peri PERI_HDMI_PHY27M>, 
				<&clk_peri PERI_HDMI_SPDIFCLK>, 
				<&clk_peri PERI_HDMI_PCLK>, 
				<&clk_peri PERI_HDMI_CEC>, 
				<&clk_peri PERI_HDMI_HDCP14>, 
				<&clk_peri PERI_HDMI_HDCP22>, 
				<&clk_ddi DDIBUS_HDMI>, 
				<&clk_isoip_ddi ISOIP_DDB_HDMI>;
		clock-names = "hdmi_ref_clk", 
				"hdmi_spdif_clk", 
				"hdmi_apb_clk", 
				"hdmi_cec", 
				"hdmi_hdcp14", 
				"hdmi_hdcp22", 
				"hdmi_ddibus", 
				"hdmi_isoip_ddibus";
		clock-frequency = <50000000>;
		/* Pinctrl and gpio */
		pinctrl-names = "default";
		pinctrl-0 = <&hdmi_hpd &hdmi_i2c>;
		gpios = <&gphdmi 1 0>;
		/* DDC */
		hdmi_i2c_port_mapping = <0xc 0xf 0xe>; /* offset mask value */
		audio_if_selection_ofst = <0x58>;
		verbose = <0>; // 0 disable, 1 basic, 2 io
		status = "disabled";
	};

	hdmi_cec_20: hdmi_cec_20@16053000 {
		compatible = "telechips,dw-hdmi-cec";
		reg = <0x16053000 0x1000>;
		interrupts = <GIC_SPI 47 IRQ_TYPE_LEVEL_HIGH>,		/* CEC1 Interrupt */
				<GIC_SPI 52 IRQ_TYPE_LEVEL_HIGH>;	/* CEC1 WAKEUP Interrupt */
		clocks = <&clk_peri PERI_CEC1_CORE>, <&clk_peri PERI_CEC1_SFR>,<&clk_io IOBUS_CEC1>;
		pinctrl-names = "default";
		pinctrl-0 = <&hdmi_cec>;
		status = "disabled";
	};

	/* eMMC Boot */
	sdhc1: sdhc@16450000 {
		compatible = "telechips,tcc-sdhc";
		reg = <0x16450000 0x100>, <0x16470050 0x50>, <0x16494414 0x4>;
		interrupts = <GIC_SPI 51 IRQ_TYPE_LEVEL_HIGH>;
		clocks = <&clk_peri PERI_SDMMC1 &clk_io IOBUS_SDMMC1>;
		clock-names = "mmc_fclk", "mmc_hclk";
		max-frequency = <50000000>;
		bus-width = <4>;
		status = "disabled";
	};

	sdhc0: sdhc@16440000 {
		compatible = "telechips,tcc-sdhc";
		reg = <0x16440000 0x100>, <0x16470000 0x50>, <0x16494410 0x4>;
		interrupts = <GIC_SPI 50 IRQ_TYPE_LEVEL_HIGH>;
		clocks = <&clk_peri PERI_SDMMC0 &clk_io IOBUS_SDMMC0>;
		clock-names = "mmc_fclk", "mmc_hclk";
		max-frequency = <50000000>;
		bus-width = <4>;
		status = "disabled";
	};

	sdhc2: sdhc@16460000 {
		compatible = "telechips,tcc-sdhc";
		reg = <0x16460000 0x100>, <0x164700A0 0x50>;
		interrupts = <GIC_SPI 43 IRQ_TYPE_LEVEL_HIGH>;
		clocks = <&clk_peri PERI_SDMMC2 &clk_io IOBUS_SDMMC2>;
		clock-names = "mmc_fclk", "mmc_hclk";
		max-frequency = <50000000>;
		bus-width = <4>;
		status = "disabled";
	};

	nand: nand@16400000 {
		compatible = "telechips,nand-v8";
		reg = <0x16400000 0x13ff>;
		interrupts = <GIC_SPI 48 IRQ_TYPE_LEVEL_HIGH>;
		status = "disabled";
	};

	remote@16040000 {
		compatible = "telechips,tccxxxx-remote";
		reg = <0x16040000 0x100>, <0x14400128 0x4>;
		interrupts = <GIC_SPI 35 IRQ_TYPE_LEVEL_HIGH>;
		clocks = <&clk_peri PERI_RMT &clk_io IOBUS_REMOCON>;
		clock-frequency = <24000000>;
		status = "disabled";
	};

	adc@16050000 {
		compatible = "telechips,adc";
		reg = <0x16050000 0x24 0x1440000C 0x4>;
		clocks = <&clk_peri PERI_ADC &clk_io IOBUS_TSADC &clk_isoip_top ISOIP_TOP_TSADC>;
		clock-frequency = <12000000>;
		ckin-frequency  = <1000000>;
		adc-12bit-resolution;
		adc-delay = <150>;
		adc-board-ver = <8>;
		status = "disabled";
	};

	tsadc@16050000 {	/* ADC Touch Screen */
		compatible = "telechips,tsadc";
		reg = <0x16050000 0x24>;
		int-gpios = <&gpadc 6 0>;	/* for using TSADC_UPDOWN extint soruce */
		status = "disabled";
	};

	/*
	 * HSIO Bus Block
	 */

	gmac@11700000{
		compatible = "telechips,gmac";
	reg = <0x11700000 0x3000 0x111A0000 0x0008>;
		interrupts = <GIC_SPI 101 IRQ_TYPE_LEVEL_HIGH>;
		status = "disabled";
		index = <1>;
		clocks = <&clk_peri PERI_GMAC &clk_fbus FBUS_HSIO &clk_peri PERI_GMAC_PTP &clk_hsio HSIOBUS_GMAC>; //PERI_GMAC0, HSIOBUS, PERI_PTP0, HCLK_GMAC
		clock-names = "gmac-pclk", "hsio-clk", "ptp-pclk", "gmac-hclk";
	};

	rtc {
		compatible = "telechips,rtc";
		reg = <0x16480000 0x50>;
		clocks = <&clk_io IOBUS_RTC &clk_isoip_top ISOIP_TOP_RTC>;
		interrupts = <GIC_SPI 49 0>;
	};

	/*
	 * CM Bus Block
	 */
	cmbus@19000000 {
		reg =   <0x19080000 0x10000>,
			<0x190A0000 0x80>,
			<0x190B0000 0x80>,
			<0x190F0000 0x50>;
		interrupts = <GIC_SPI 37 IRQ_TYPE_LEVEL_LOW>;
		clocks = <&clk_fbus FBUS_CMBUS>,
			<&clk_peri PERI_TSRX0>,
			<&clk_peri PERI_TSRX1>,
			<&clk_peri PERI_TSRX2>,
			<&clk_peri PERI_TSRX3>;
		clock-frequency = <200000000>;
		status = "disabled";
	};

	tcc_nsk_sc: tcc_nsk_sc@16671000 {
		compatible = "telechips,tcc-nsk-sc";
		reg = <0x16671000 0xFF>,
			<0x16684000 0x1F>,
			<0x16051000 0x70>,
			<0x16020200 0x2F>;
		interrupts = <GIC_SPI 70 IRQ_TYPE_LEVEL_HIGH>;
		clocks = <&clk_peri PERI_UART7>, <&clk_io IOBUS_UART7>;
		clock-names = "uartclk", "apb_pclk";
		clock-frequency = <54857142>;

		iobus_dmareqsel_offset = <0x24>;
		iobus_dmareqsel_value = <0x40000000>;
		iobus_hrsten_offset = <0xc>;
		iobus_hrsten_value = <0x200>;

		dma_extreq_value = <0x40000000>;

		uart_chnum = <7>;
		uart_port = <0>;
		uart_datmux_use = <1>;
	};
	pwm:pwm@16050000 { /* pwm */
		compatible = "telechips,pwm";
		reg = <0x16030000 0x70 0x1605104C 0x4>;
		tcc,pwm-number = <4>;
		#pwm-cells = <2>;
		clocks = <&clk_peri PERI_PDM &clk_io IOBUS_PWM >;
		clock-frequency = <10000000>; /* Hz */
		status = "okay";
	};


	pwm_led_a {
		compatible = "pwm-leds";
		led_a {
			pwms = <&pwm 0 1000000000>;
			max-brightness = <255>;
			linux,default-trigger = "default-on";
		};
	};

	pwm_led_b {
		compatible = "pwm-leds";
		led_b {
			pwms = <&pwm 1 500000000>;
			max-brightness = <255>;
			linux,default-trigger = "default-on";
		};
	};

	tcc-restart {
		compatible = "telechips,restart";
		reg = <0x14400000 0x1A0 0xF0009FFC 0x4>;
		status = "okay";
	};



};
