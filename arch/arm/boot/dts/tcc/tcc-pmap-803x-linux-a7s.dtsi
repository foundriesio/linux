/*
 * Device tree for Telechips TCC899x family SoC
 *
 * Copyright (C) 2018 Telechips Inc. - http://www.telechips.com
 *
 * This file is dual-licensed: you can use it either under the terms
 * of the GPL or the X11 license, at your option. Note that this dual
 * licensing only applies to this file, and not this project as a
 * whole.
 *
 *  a) This file is free software; you can redistribute it and/or
 *     modify it under the terms of the GNU General Public License as
 *     published by the Free Software Foundation; either version 2 of the
 *     License, or (at your option) any later version.
 *
 *     This file is distributed in the hope that it will be useful,
 *     but WITHOUT ANY WARRANTY; without even the implied warranty of
 *     MERCHANTABILITY or FITNESS FOR A PARTICULAR PURPOSE.  See the
 *     GNU General Public License for more details.
 *
 * Or, alternatively,
 *
 *  b) Permission is hereby granted, free of charge, to any person
 *     obtaining a copy of this software and associated documentation
 *     files (the "Software"), to deal in the Software without
 *     restriction, including without limitation the rights to use,
 *     copy, modify, merge, publish, distribute, sublicense, and/or
 *     sell copies of the Software, and to permit persons to whom the
 *     Software is furnished to do so, subject to the following
 *     conditions:
 *
 *     The above copyright notice and this permission notice shall be
 *     included in all copies or substantial portions of the Software.
 *
 *     THE SOFTWARE IS PROVIDED "AS IS", WITHOUT WARRANTY OF ANY KIND,
 *     EXPRESS OR IMPLIED, INCLUDING BUT NOT LIMITED TO THE WARRANTIES
 *     OF MERCHANTABILITY, FITNESS FOR A PARTICULAR PURPOSE AND
 *     NONINFRINGEMENT. IN NO EVENT SHALL THE AUTHORS OR COPYRIGHT
 *     HOLDERS BE LIABLE FOR ANY CLAIM, DAMAGES OR OTHER LIABILITY,
 *     WHETHER IN AN ACTION OF CONTRACT, TORT OR OTHERWISE, ARISING
 *     FROM, OUT OF OR IN CONNECTION WITH THE SOFTWARE OR THE USE OR
 *     OTHER DEALINGS IN THE SOFTWARE.
 */

#include "../../../../../include/generated/autoconf.h"

#undef SZ_1MB
#define SZ_1MB 				(1024*1024)
#define ARRAY_16MBYTE(x)          	((((x) + ((16*SZ_1MB)-1))>> 24) << 24)
#define ARRAY_MBYTE(x)            	((((x) + (SZ_1MB-1))>> 20) << 20)
#define ARRAY_256KBYTE(x)         	((((x) + ((SZ_1MB/4)-1))>> 18) << 18)

//***************************** DISPLAY ******************************/
#define PRIMARY_FRAMEBUFFER_WIDTH	1920
#define PRIMARY_FRAMEBUFFER_HEIGHT	720
#if defined(CONFIG_OVERLAY_DPGL)
#define SECONDARY_FRAMEBUFFER_WIDTH 	1920
#define SECONDARY_FRAMEBUFFER_HEIGHT 	720
#else
#define SECONDARY_FRAMEBUFFER_WIDTH	0
#define SECONDARY_FRAMEBUFFER_HEIGHT	0
#endif
//****************************** Camera ******************************/
#define CAMERA_INPUT_WIDTH		720
#define CAMERA_INPUT_HEIGHT		480
#define CAMERA_OUTPUT_WIDTH		1920
#define CAMERA_OUTPUT_HEIGHT		720

#if defined(CONFIG_VIDEO_TCCVIN)
#define FRAMES_CAMERA_VIQE		4	// 4: 3D Mode
#define FRAMES_CAMERA_PREVIEW		4
#define FRAMES_CAMERA_CAPTURE		0
#else
#define FRAMES_CAMERA_VIQE		0
#define FRAMES_CAMERA_PREVIEW		0
#define FRAMES_CAMERA_CAPTURE		0
#endif//defined(CONFIG_VIDEO_TCCVIN)
#if defined(CONFIG_OVERLAY_PGL)
#if defined(CONFIG_VIDEO_TCCVIN_SAFE_ASSURE)
#define FRAMES_CAMERA_PGL		2
#else
#define FRAMES_CAMERA_PGL		1
#endif//defined(CONFIG_VIDEO_TCCVIN_SAFE_ASSURE)
#else
#define FRAMES_CAMERA_PGL		0
#endif//defined(CONFIG_OVERLAY_PGL)
#if defined(CONFIG_VIDEO_TCCVIN_SAFE_ASSURE)
#define FRAMES_CAMERA_SAFE_ASSURE	5
#else
#define FRAMES_CAMERA_SAFE_ASSURE	0
#endif//defined(CONFIG_VIDEO_TCCVIN_SAFE_ASSURE)

#define FRAMES_REARCAMERA_VIQE		(FRAMES_CAMERA_VIQE)
#define FRAMES_REARCAMERA		(FRAMES_CAMERA_PREVIEW + FRAMES_CAMERA_CAPTURE)
#define FRAMES_PARKING_GUI		(FRAMES_CAMERA_PGL)
#define FRAMES_OVERLAY_ROT		(FRAMES_CAMERA_SAFE_ASSURE)

#define PMAP_SIZE_FB_VIDEO		ARRAY_MBYTE(PRIMARY_FRAMEBUFFER_WIDTH * PRIMARY_FRAMEBUFFER_HEIGHT * 4 * 3)
#define PMAP_SIZE_FB1_VIDEO		ARRAY_MBYTE(SECONDARY_FRAMEBUFFER_WIDTH * SECONDARY_FRAMEBUFFER_HEIGHT * 4 * 3)
#define PMAP_SIZE_OVERLAY_ROT		ARRAY_MBYTE(PRIMARY_FRAMEBUFFER_WIDTH * PRIMARY_FRAMEBUFFER_HEIGHT * 4 * FRAMES_OVERLAY_ROT)
#define PMAP_SIZE_UMP_RESERVED		ARRAY_MBYTE((PRIMARY_FRAMEBUFFER_WIDTH * 4) * PRIMARY_FRAMEBUFFER_HEIGHT * 4 * 4)
#define PMAP_SIZE_REARCAMERA_VIQE	ARRAY_MBYTE((CAMERA_INPUT_WIDTH * (CAMERA_INPUT_HEIGHT / 2 ) * 4 * FRAMES_REARCAMERA_VIQE) * 3 / 2)
#define PMAP_SIZE_REARCAMERA		ARRAY_MBYTE(CAMERA_OUTPUT_WIDTH * CAMERA_OUTPUT_HEIGHT * 4 * FRAMES_REARCAMERA)
#define PMAP_SIZE_PARKING_GUI		ARRAY_MBYTE(CAMERA_OUTPUT_WIDTH * CAMERA_OUTPUT_HEIGHT * 4 * FRAMES_PARKING_GUI)

#define PMAP_SIZE_REARCAMERAS		ARRAY_MBYTE(PMAP_SIZE_REARCAMERA_VIQE + PMAP_SIZE_REARCAMERA + PMAP_SIZE_PARKING_GUI + 0x10000)	// 0x10000: padding

#define RESERVED_MEM_BASE		( 0x90000000 )
#define RESERVED_MEM_SIZE		( 0x10000000 - PMAP_SIZE_REARCAMERAS ) /* 256 MiB */

#define REARCAMERA_MEM_BASE		( RESERVED_MEM_BASE + RESERVED_MEM_SIZE )
#define REARCAMERA_MEM_SIZE		( PMAP_SIZE_REARCAMERAS )

