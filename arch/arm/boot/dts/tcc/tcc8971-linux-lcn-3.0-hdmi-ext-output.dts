// SPDX-License-Identifier: (GPL-2.0-or-later OR MIT)
/*
 * Copyright (C) Telechips Inc.
 */

/dts-v1/;

#include "tcc8971-linux-lcn-3.0.dts"

/ {
	model = "Telechips TCC8971 LCN Board SV3.0";
	compatible = "telechips,tcc8971", "telechips,tcc897x";

	vout_drv@0 {
		m2m_rdma = <&vioc_rdma VIOC_RDMA16>;
		m2m_wmix = <&vioc_wmix VIOC_WMIX5>;
		m2m_wdma = <&vioc_wdma VIOC_WDMA06>;
		status = "okay";
	};

	vout_drv@1 {
		status = "okay";
	};
};
