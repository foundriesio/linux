/*
 * Copyright 2014-2016 Toradex AG
 * Copyright 2012 Freescale Semiconductor, Inc.
 * Copyright 2011 Linaro Ltd.
 *
 * The code contained herein is licensed under the GNU General Public
 * License. You may obtain a copy of the GNU General Public License
 * Version 2 or later at the following locations:
 *
 * http://www.opensource.org/licenses/gpl-license.html
 * http://www.gnu.org/copyleft/gpl.html
 */

/dts-v1/;

#include <dt-bindings/input/input.h>
#include <dt-bindings/interrupt-controller/irq.h>
#include "imx6q.dtsi"
/* on HW V1.0 all RxD/TxD lines are routed in a DCE way, all control lines (RTS/...)
   are then not routed as given in the module specification and thus unusable.
   The following define configures the UARTs to RxD/TxD correctly */
#define USE_UART_IN_DCE_MODE
#include "imx6qdl-apalis.dtsi"
#include "imx6qdl-apalis-ixora.dtsi"

/ {
	model = "Toradex Apalis iMX6Q/D V1.0 Module on Ixora Carrier Board";
	compatible = "toradex,apalis_imx6q_v1_0-ixora",
		     "toradex,apalis_imx6q_v1_0", "fsl,imx6q";
};
