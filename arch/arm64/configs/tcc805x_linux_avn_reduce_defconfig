## drivers/char/vpu/Kconfig
```kconfig
#
# VPU device configuration
#

menuconfig TCC_VPU_DRV
	tristate "VPU-Video Process Unit"

if TCC_VPU_DRV

# For test of WAVE420L in TCC805x
config SUPPORT_TCC_WAVE420L_VPU_HEVC_ENC
	bool "support HEVC encoder using WAVE420L"
	depends on (ARCH_TCC805X)
	default y
	help
		Enable HEVC codec using WAVE420L.
		This adds support
		the VPU drivers
		on TCCxxxx Soc devices.

config SUPPORT_TCC_WAVE512_4K_D2
	bool "support HEVC/VP9 Decoder using WAVE512"
	depends on (ARCH_TCC899X || ARCH_TCC901X || ARCH_TCC805X)
	default y
	help
		Enable HEVC/VP9 codec using WAVE512.
		This adds support
		the VPU drivers
		on TCCxxxx Soc devices.

if SUPPORT_TCC_WAVE512_4K_D2
config SUPPORT_TCC_HEVC_4K
	default y
	bool "support 4K resolution for HEVC"
	help
		4K Resolution for HEVC/VP9
		This adds support
		the VPU drivers
		on TCCxxxx Soc devices.

config SUPPORT_TCC_VP9_4K
	default y
	bool "support 4K resolution for VP9"
	help
		4K Resolution for VP9
		This adds support
		the VPU drivers
		on TCCxxxx Soc devices.
endif

config SUPPORT_TCC_WAVE410_HEVC
	bool "support HEVC Decoder using WAVE410"
	depends on (ARCH_TCC803X || ARCH_TCC896X || ARCH_TCC897X || ARCH_TCC898X || ARCH_TCC570X)
	default y
	help
		Enable HEVC codec using WAVE410.
		This adds support
		the VPU drivers
		on TCCxxxx Soc devices.

if SUPPORT_TCC_WAVE410_HEVC
config SUPPORT_TCC_HEVC_4K
	default y
	depends on (ARCH_TCC803X || ARCH_TCC896X || ARCH_TCC898X)
	bool "support 4K resolution for HEVC"
	help
		4K Resolution for HEVC
		This adds support
		the VPU drivers
		on TCCxxxx Soc devices.
endif

config SUPPORT_TCC_G2V2_VP9
	bool "support VP9 Codec using G2V2"
	default y
	depends on (ARCH_TCC898X)
	help
		Enable VP9 codec.
		This adds support
		the VPU drivers
		on TCCxxxx Soc devices.

if SUPPORT_TCC_G2V2_VP9
config SUPPORT_TCC_VP9_4K
	default y
	depends on (ARCH_TCC898X)
	bool "support 4K resolution for VP9"
	help
		4K Resolution for VP9
		This adds support
		the VPU drivers
		on TCCxxxx Soc devices.
endif

config SUPPORT_TCC_JPU
	bool "support JPU Codec"
	default y
	help
		Enable JPU codec.
		This adds support
		the VPU drivers
		on TCCxxxx Soc devices.

choice
	prompt "Max Frame Size (W x H)"
	default DEC_MAX_FRAME_SIZE_1
	depends on (ARCH_TCC899X || ARCH_TCC901X ||ARCH_TCC805X)
	help
		max frame size(width/height) for decoder.
		This adds support
		the VPU drivers
		on TCCxxxx Soc devices.

config VDEC_MAX_FRAME_SIZE_1
	bool "4096x2160"
	select DEC_MAX_FRAME_SIZE_1
	help
		DEC_MAX_FRAME_SIZE_1
		This adds support
		the VPU drivers.
		on TCCxxxx Soc devices.

config VDEC_MAX_FRAME_SIZE_2
	bool "3840x2160"
	select DEC_MAX_FRAME_SIZE_2
	help
		DEC_MAX_FRAME_SIZE_2
		This adds support
		the VPU drivers
		on TCCxxxx Soc devices.
endchoice

choice
	prompt "Instance count of Decoder"
	default VDEC_MAX_CNT_5
	help
		max instance count
		for decoder.
		This adds support
		the VPU drivers
		on TCCxxxx Soc devices.

config VDEC_CNT_1
	bool "max 1"
	select VDEC_MAX_CNT_1
	help
		VDEC_MAX_CNT_1
		This adds support
		the VPU drivers.
		on TCCxxxx Soc devices.

config VDEC_CNT_2
	bool "max 2"
	select VDEC_MAX_CNT_2
	help
		VDEC_MAX_CNT_2
		This adds support
		the VPU drivers.
		on TCCxxxx Soc devices.

config VDEC_CNT_3
	bool "max 3"
	select VDEC_MAX_CNT_3
	help
		VDEC_MAX_CNT_3
		This adds support
		the VPU drivers.
		on TCCxxxx Soc devices.

config VDEC_CNT_4
	bool "max 4"
	select VDEC_MAX_CNT_4
	help
		VDEC_MAX_CNT_4
		This adds support
		the VPU drivers.
		on TCCxxxx Soc devices.

config VDEC_CNT_5
	bool "max 5"
	select VDEC_MAX_CNT_5
	help
		VDEC_MAX_CNT_5
		This adds support
		the VPU drivers.
		on TCCxxxx Soc devices.

endchoice

choice
	prompt "Instance count of Encoder"
	depends on (SUPPORT_TCC_JPU || ARCH_TCC893X || ARCH_TCC896X || ARCH_TCC898X || ARCH_TCC803X || ARCH_TCC805X)
	default VENC_MAX_CNT_8
	help
		max instance count for encoder.
		This adds support
		the VPU drivers
		on TCCxxxx Soc devices.

config VENC_CNT_1
	bool "max 1"
	select VENC_MAX_CNT_1
	help
		VENC_MAX_CNT_1
		This adds support
		the VPU drivers.
		on TCCxxxx Soc devices.

config VENC_CNT_2
	bool "max 2"
	select VENC_MAX_CNT_2
	help
		VENC_MAX_CNT_2
		This adds support
		the VPU drivers.
		on TCCxxxx Soc devices.

config VENC_CNT_3
	bool "max 3"
	select VENC_MAX_CNT_3
	help
		VENC_MAX_CNT_3
		This adds support
		the VPU drivers.
		on TCCxxxx Soc devices.

config VENC_CNT_4
	bool "max 4"
	select VENC_MAX_CNT_4
	help
		VENC_MAX_CNT_4
		This adds support
		the VPU drivers.
		on TCCxxxx Soc devices.

config VENC_CNT_5
	bool "max 5"
	select VENC_MAX_CNT_5
	help
		VENC_MAX_CNT_5
		This adds support
		the VPU drivers.
		on TCCxxxx Soc devices.

config VENC_CNT_6
	bool "max 6"
	select VENC_MAX_CNT_6
	help
		VENC_MAX_CNT_6
		This adds support
		the VPU drivers.
		on TCCxxxx Soc devices.

config VENC_CNT_7
	bool "max 7"
	select VENC_MAX_CNT_7
	help
		VENC_MAX_CNT_7
		This adds support
		the VPU drivers.
		on TCCxxxx Soc devices.

config VENC_CNT_8
	bool "max 8"
	select VENC_MAX_CNT_8
	help
		VENC_MAX_CNT_8
		This adds support
		the VPU drivers.
		on TCCxxxx Soc devices.

config ENC_NO_SUPPORT
	bool "not support"
	select ENC_NOT_SUPPORT
	help
		ENC_NOT_SUPPORT
		This adds support
		the VPU drivers.
		on TCCxxxx Soc devices.
endchoice

config VENC_BUFFER_SIZE
	int "Encoder's buffer size (1 => 1MB, ex> 15MB(720p)/30MB(1080p))"
	depends on (SUPPORT_TCC_JPU || ARCH_TCC893X || ARCH_TCC896X || ARCH_TCC898X || ARCH_TCC803X || ARCH_TCC805X)
	default 30
	help
		Select buffer size of Encoder.
		This adds support
		the VPU drivers
		on TCCxxxx Soc devices.

config VPU_ALLOC_MEM_IN_SPECIFIC_SEQUENCE
	bool "alloc memory in specific sequence"
	help
		To alloc memory in regular sequence only
		specific case like black-box in linux platform.
		This adds support
		the VPU drivers
		on TCCxxxx Soc devices.

config VPU_TIME_MEASUREMENT
	bool "processing time masurement"
	help
		Enable to measure the time of decoding/encoding.
		This adds support
		the VPU drivers
		on TCCxxxx Soc devices.

config TEST_VPU_DRAM_INTLV
	bool "dram interleaving test"
	depends on ARCH_TCC896X
	help
		Enable to test DRAM Interleaving
		This adds support
		the VPU drivers
		on TCCxxxx Soc devices.

endif # TCC_VPU_DRV
```

## drivers/gpu/arm/utgard/mali/Kconfig
```kconfig
config MALI_UTGARD
	tristate "Mali-300/400/450 support"
	default n	
	depends on FB && (ARM || ARM64)
	select DMA_SHARED_BUFFER
	---help---
	  This enables support for the ARM Mali-300, Mali-400, and Mali-450
	  GPUs.

	  To compile this driver as a module, choose M here: the module will be
	  called mali.

config MALI450
	bool "Enable Mali-450 support"
	depends on MALI_UTGARD
	default n
	---help---
	  This enables support for Mali-450 specific features.

config MALI470
	bool "Enable Mali-470 support"
	depends on MALI_UTGARD
	---help---
	  This enables support for Mali-470 specific features.

config MALI400_DEBUG
	bool "Enable debug in Mali driver"
	depends on MALI_UTGARD
	default n
	---help---
	  This enabled extra debug checks and messages in the Mali driver.

config MALI400_PROFILING
	bool "Enable Mali profiling"
	depends on MALI_UTGARD
	select TRACEPOINTS
	default n
	---help---
	  This enables gator profiling of Mali GPU events.

config MALI400_INTERNAL_PROFILING
	bool "Enable internal Mali profiling API"
	depends on MALI400_PROFILING
	default n
	---help---
	  This enables the internal legacy Mali profiling API.

config GPU_BUS_SCALING
	bool "Use GPU bus scaling"
	default n
	depends on MALI_UTGARD
	---help---
	   Use GPU bus scaling for Mali GPU

config MALI_DVFS
	bool "Enable Mali dynamically frequency change"
	depends on MALI_UTGARD && !GPU_BUS_SCALING
	default n
	---help---
	  This enables support for dynamic change frequency of Mali with the goal of lowering power consumption.

config MALI_DMA_BUF_FENCE
	bool "Enable dma_buf_fence"
	depends on MALI_UTGARD && DRM
	default y
	---help---
	  A dma buffer fence can be attached to a shared dma buffer that is
	  being filled or consumed by a different hardware component.
	  Alternatively, the dma buffer can be passed to the GPU without
  	  waiting for the display device, the GPU is only required to attach a
	  callback to wait for the notification.
	  
config MALI_DMA_BUF_MAP_ON_ATTACH
	bool "Map dma-buf attachments on attach"
	depends on MALI_UTGARD && DMA_SHARED_BUFFER
	default y
	---help---
	  This makes the Mali driver map dma-buf attachments after doing
	  attach. If this is not set the dma-buf attachments will be mapped for
	  every time the GPU need to access the buffer.

	  Mapping for each access can cause lower performance.

config MALI_SHARED_INTERRUPTS
	bool "Support for shared interrupts"
	depends on MALI_UTGARD
	default n
	---help---
	  Adds functionality required to properly support shared interrupts.  Without this support,
	  the device driver will fail during insmod if it detects shared interrupts.  This also
	  works when the GPU is not using shared interrupts, but might have a slight performance
	  impact.

config MALI_PMU_PARALLEL_POWER_UP
	bool "Power up Mali PMU domains in parallel"
	depends on MALI_UTGARD
	default n
	---help---
	  This makes the Mali driver power up all PMU power domains in parallel, instead of
	  powering up domains one by one, with a slight delay in between. Powering on all power
	  domains at the same time may cause peak currents higher than what some systems can handle.
	  These systems must not enable this option.

config MALI_DT
	bool "Using device tree to initialize module"
	depends on MALI_UTGARD && OF
	default y
	---help---
	  This enable the Mali driver to choose the device tree path to get platform resoures
	  and disable the old config method. Mali driver could run on the platform which the
	  device tree is enabled in kernel and corresponding hardware description is implemented
	  properly in device DTS file.

config MALI_DEVFREQ
	bool "Using devfreq to tuning frequency"
	depends on MALI_UTGARD && PM_DEVFREQ
	default n
	---help---
	Support devfreq for Mali.

	Using the devfreq framework and, by default, the simpleondemand
	governor, the frequency of Mali will be dynamically selected from the
	available OPPs.

config MALI_QUIET
	bool "Make Mali driver very quiet"
	depends on MALI_UTGARD && !MALI400_DEBUG
	default n
	---help---
	  This forces the Mali driver to never print any messages.

	  If unsure, say N.

config MALI_OS_MEMORY
	bool "Use OS memory"
	default y
	depends on MALI_UTGARD
	---help---
	   Use OS memory for Mali GPU

config MALI_MEMORY_SIZE
	int "Mali memory size"
	default 512 if TCC_MEM_1024MB
	default 300 if TCC_MEM_512MB
	depends on MALI_OS_MEMORY && !OF
	---help---
	    Memory size for Mali GPU
```

## drivers/gpu/arm/utgard/ump/Kconfig
```kconfig
config MALI400_UMP
	tristate "MALI400 UMP support"
	depends on ARM
	default n	
	---help---
	  This enables support for the UMP memory allocation and sharing API.

	  To compile this driver as a module, choose M here: the module will be
	  called ump.

config UMP_DEBUG
	bool "Enable extra debug in UMP"
	depends on MALI400_UMP
	default n
	---help---
	  This enabled extra debug checks and messages in UMP.

config UMP_OS_MEMORY
	bool "Use OS memory"
	default y
	depends on MALI400_UMP
	---help---
	   Use OS memory for UMP

config UMP_MEMORY_ADDRESS
	int "UMP memory address"
	default 0
	depends on MALI400_UMP
	---help---
	   Memory address for UMP

config UMP_MEMORY_SIZE
	int "UMP memory size"
	default 82 if (MACH_TCC8930ST)
	default 72
	depends on MALI400_UMP
	---help---
	   Memory size for UMP in MB	  
```
