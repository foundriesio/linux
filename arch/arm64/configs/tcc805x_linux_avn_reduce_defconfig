## arch/arm64/configs/tcc901x_linux_stb_defconfig
```kconfig
#CONFIG_CROSS_COMPILE="aarch64-linux-gnu-"
CONFIG_CROSS_COMPILE="aarch64-telechips-linux-"
CONFIG_LOCALVERSION="-tcc"
# CONFIG_LOCALVERSION_AUTO is not set
CONFIG_SYSVIPC=y
CONFIG_POSIX_MQUEUE=y
CONFIG_FHANDLE=y
CONFIG_AUDIT=y
CONFIG_NO_HZ_IDLE=y
CONFIG_HIGH_RES_TIMERS=y
CONFIG_BSD_PROCESS_ACCT=y
CONFIG_BSD_PROCESS_ACCT_V3=y
CONFIG_TASKSTATS=y
CONFIG_TASK_DELAY_ACCT=y
CONFIG_TASK_XACCT=y
CONFIG_TASK_IO_ACCOUNTING=y
CONFIG_IKCONFIG=y
CONFIG_IKCONFIG_PROC=y
CONFIG_LOG_BUF_SHIFT=14
CONFIG_MEMCG=y
CONFIG_MEMCG_SWAP=y
CONFIG_CGROUP_HUGETLB=y
CONFIG_SCHED_AUTOGROUP=y
CONFIG_BLK_DEV_INITRD=y
CONFIG_INITRAMFS_SOURCE="../ramdisk/initramfs.cpio.lzo"
CONFIG_RD_LZO=y
CONFIG_KALLSYMS_ALL=y
CONFIG_EMBEDDED=y
# CONFIG_PERF_EVENTS is not set
# CONFIG_COMPAT_BRK is not set
CONFIG_PROFILING=y
CONFIG_JUMP_LABEL=y
CONFIG_MODULES=y
CONFIG_MODULE_UNLOAD=y
CONFIG_MODULE_FORCE_UNLOAD=y
# CONFIG_MODVERSIONS is not set
# CONFIG_BLK_DEV_BSG is not set
# CONFIG_IOSCHED_DEADLINE is not set
CONFIG_ARM64_TCC_BUILD=y
CONFIG_ARCH_TCC=y
CONFIG_ARCH_TCC901X=y
CONFIG_TCC_ECID=y
CONFIG_PCI=y
CONFIG_PCIE_DW_HOST=y
CONFIG_PCIE_DW_PLAT=y
CONFIG_PCI_HOST_GENERIC=y
CONFIG_PCI_TCC=y
CONFIG_SMP=y
CONFIG_PREEMPT=y
CONFIG_KSM=y
CONFIG_TRANSPARENT_HUGEPAGE=y
CONFIG_CMA=y
CONFIG_CMDLINE="console=ttyAMA0"
# CONFIG_CORE_DUMP_DEFAULT_ELF_HEADERS is not set
CONFIG_COMPAT=y
CONFIG_PM_AUTOSLEEP=y
CONFIG_PM_WAKELOCKS=y
CONFIG_CPU_IDLE=y
# CONFIG_CPU_IDLE_GOV_LADDER is not set
CONFIG_CPU_FREQ=y
CONFIG_CPU_FREQ_DEFAULT_GOV_INTERACTIVE=y
CONFIG_CPU_FREQ_GOV_PERFORMANCE=y
CONFIG_CPU_FREQ_GOV_ONDEMAND=y
CONFIG_NET=y
CONFIG_PACKET=y
CONFIG_UNIX=y
CONFIG_INET=y
CONFIG_IP_PNP=y
CONFIG_IP_PNP_DHCP=y
CONFIG_IP_PNP_BOOTP=y
# CONFIG_IPV6 is not set
CONFIG_BPF_JIT=y
CONFIG_BT=y
CONFIG_RFKILL=y
CONFIG_WIRELESS=y
CONFIG_CFG80211=y
CONFIG_NET_9P=y
CONFIG_NET_9P_VIRTIO=y
CONFIG_UEVENT_HELPER_PATH="/sbin/hotplug"
CONFIG_DEVTMPFS=y
CONFIG_DEVTMPFS_MOUNT=y
CONFIG_DMADEVICES=y
CONFIG_TCC_DMA=y
CONFIG_DMA_ENGINE=y
CONFIG_DMA_OF=y
CONFIG_DMA_CMA=y
CONFIG_BLK_DEV_LOOP=y
CONFIG_VIRTIO_BLK=y
# CONFIG_SCSI_PROC_FS is not set
CONFIG_BLK_DEV_SD=y
# CONFIG_SCSI_LOWLEVEL is not set
CONFIG_ATA=y
CONFIG_SATA_AHCI=y
CONFIG_SATA_AHCI_PLATFORM=y
CONFIG_AHCI_XGENE=y
CONFIG_PATA_PLATFORM=y
CONFIG_PATA_OF_PLATFORM=y
CONFIG_NETDEVICES=y
CONFIG_TUN=y
CONFIG_ETHERNET=y
CONFIG_TCC_GMAC=y
CONFIG_TCC_GMAC_DA=y
CONFIG_PHYLIB=y
CONFIG_TCC_REALTEK_PHY=y
CONFIG_VIRTIO_NET=y
CONFIG_NET_XGENE=y
CONFIG_SMC91X=y
CONFIG_SMSC911X=y
CONFIG_WLAN=y
CONFIG_INPUT_EVDEV=y
CONFIG_GPIOLIB=y
CONFIG_KEYBOARD_GPIO_POLLED=y
# CONFIG_SERIO_SERPORT is not set
CONFIG_INPUT_MISC=y
CONFIG_INPUT_TCC_REMOTE=y
CONFIG_LINUX_KEY_TABLE=y
CONFIG_INPUT_KEYCHORD=y
CONFIG_CS_2000_IR_X_CANVAS=y
CONFIG_PBUS_DIVIDE_CLOCK_WITH_XTIN=y
CONFIG_INPUT_UINPUT=y
CONFIG_INPUT_GPIO=y
CONFIG_SERIO_AMBAKMI=y
CONFIG_LEGACY_PTY_COUNT=16
CONFIG_SERIAL_8250=y
CONFIG_SERIAL_8250_CONSOLE=y
CONFIG_SERIAL_AMBA_PL011=y
CONFIG_SERIAL_AMBA_PL011_CONSOLE=y
CONFIG_SERIAL_OF_PLATFORM=y
CONFIG_VIRTIO_CONSOLE=y
# CONFIG_HW_RANDOM is not set
CONFIG_TCC_VPU_DRV=m
CONFIG_TCC_DISPMG=y
CONFIG_VDEC_CNT_2=y
CONFIG_I2C=y
CONFIG_I2C_CHARDEV=y
CONFIG_SPI=y
CONFIG_SPI_SPIDEV=y
CONFIG_SPI_TCC=y
CONFIG_SPI_TCCXXXX_TSIF_SLAVE=y
#CONFIG_SPI_PL022=y
CONFIG_REBOOT_MODE_TCC=y
# CONFIG_HWMON is not set
CONFIG_THERMAL=y
CONFIG_WATCHDOG=y
CONFIG_TCC_WATCHDOG=y
CONFIG_REGULATOR=y
CONFIG_REGULATOR_FIXED_VOLTAGE=y
CONFIG_REGULATOR_GPIO=y
# CONFIG_GC_GPU is not set
CONFIG_MALI_MIDGARD=y
CONFIG_FB=y
CONFIG_FB_ARMCLCD=y
CONFIG_FB_TCC_USE_VSYNC_INTERRUPT=y
CONFIG_TCC_VIDEO_DISPLAY_BY_VSYNC_INT=y
CONFIG_LCD_HDMI1280X720=y
CONFIG_LCD_HDMI1920X1080=y
CONFIG_LCD_HDMI1920X720=y
CONFIG_LCD_HDMI4K=y
CONFIG_TCC_HDMI_DRIVER_V2_0=y
# CONFIG_FB_TCC_COMPOSITE is not set
# CONFIG_FB_TCC_COMPONENT is not set
CONFIG_TCC_OUTPUT_STARTER=y
CONFIG_TCC_DISPLAY_MODE_USE=y
CONFIG_TCC_DISPLAY_MODE_DUAL_AUTO=y
CONFIG_LOGO=y
# CONFIG_LOGO_LINUX_MONO is not set
# CONFIG_LOGO_LINUX_VGA16 is not set
CONFIG_SOUND=y
CONFIG_SND=y
# CONFIG_SND_SUPPORT_OLD_API is not set
CONFIG_SND_SOC=y
CONFIG_SND_SOC_WM8524=y
CONFIG_USB=y
CONFIG_USB_XHCI_HCD=y
CONFIG_USB_EHCI_HCD=y
CONFIG_USB_EHCI_TCC=y
CONFIG_USB_OHCI_HCD=y
CONFIG_USB_OHCI_TCC=y
CONFIG_TCC_DWC_OTG=y
CONFIG_TCC_DWC_OTG_DUAL_FIRST_HOST=y
CONFIG_USB_STORAGE=y
CONFIG_USB_DWC3=y
CONFIG_USB_DWC3_HOST=y
CONFIG_VBUS_CTRL_DEF_ENABLE=y
CONFIG_MMC=y
CONFIG_MMC_EMBEDDED_SDIO=y
CONFIG_MMC_PARANOID_SD_INIT=y
CONFIG_MMC_BLOCK_MINORS=16
CONFIG_MMC_SDHCI=y
CONFIG_MMC_SDHCI_PLTFM=y
CONFIG_MMC_SDHCI_TCC=y
CONFIG_MMC_TCC_SDHC=y
CONFIG_NEW_LEDS=y
CONFIG_LEDS_CLASS=y
CONFIG_LEDS_GPIO=y
CONFIG_LEDS_TRIGGERS=y
CONFIG_LEDS_TRIGGER_TIMER=y
CONFIG_LEDS_TRIGGER_HEARTBEAT=y
CONFIG_RTC_CLASS=y
CONFIG_RTC_DRV_EFI=y
CONFIG_RTC_DRV_TCC=y
CONFIG_ARCH_XGENE=y
CONFIG_RTC_DRV_XGENE=y
CONFIG_VIRTIO_BALLOON=y
CONFIG_VIRTIO_MMIO=y
CONFIG_MAILBOX=y
CONFIG_TCC_MAILBOX=y
# CONFIG_IOMMU_SUPPORT is not set
CONFIG_PLATFORM_STB=y
CONFIG_PHY_XGENE=y
CONFIG_TEE=y
CONFIG_OPTEE=y
CONFIG_EXT4_FS=y
CONFIG_FANOTIFY=y
CONFIG_FANOTIFY_ACCESS_PERMISSIONS=y
CONFIG_FUSE_FS=y
CONFIG_CUSE=y
CONFIG_VFAT_FS=y
CONFIG_TMPFS=y
CONFIG_HUGETLBFS=y
# CONFIG_MISC_FILESYSTEMS is not set
CONFIG_NFS_FS=y
CONFIG_ROOT_NFS=y
CONFIG_9P_FS=y
CONFIG_NLS_CODEPAGE_437=y
CONFIG_NLS_ISO8859_1=y
CONFIG_NLS_UTF8=y
CONFIG_PRINTK_TIME=y
CONFIG_DEBUG_INFO=y
CONFIG_DEBUG_FS=y
CONFIG_MAGIC_SYSRQ=y
CONFIG_LOCKUP_DETECTOR=y
# CONFIG_SCHED_DEBUG is not set
# CONFIG_FTRACE is not set
CONFIG_EARLY_PRINTK=y
CONFIG_SECURITY=y
CONFIG_CRYPTO_ANSI_CPRNG=y
CONFIG_ARM64_CRYPTO=y
CONFIG_CRYPTO_SHA1_ARM64_CE=y
CONFIG_CRYPTO_SHA2_ARM64_CE=y
CONFIG_CRYPTO_GHASH_ARM64_CE=y
CONFIG_CRYPTO_AES_ARM64_CE=y
CONFIG_CRYPTO_AES_ARM64_CE_CCM=y
CONFIG_CRYPTO_AES_ARM64_CE_BLK=y
CONFIG_CRYPTO_AES_ARM64_NEON_BLK=y
CONFIG_HIDRAW=y
CONFIG_USB_HIDDEV=y
CONFIG_UHID=y
CONFIG_MEDIA_SUPPORT=y
CONFIG_MEDIA_DIGITAL_TV_SUPPORT=y
CONFIG_DVB_CORE=y
CONFIG_DVB_NET=y
CONFIG_DVB_MAX_ADAPTERS=8
CONFIG_DVB_PLATFORM_DRIVERS=y
CONFIG_PLATFORM_HWDEMUX=y
CONFIG_HZ_1000=y
CONFIG_HZ=1000
```

## arch/csky/Kconfig.debug
```kconfig
menu "C-SKY Debug Options"
config CSKY_BUILTIN_DTB
	bool "Use kernel builtin dtb"
	help
	  User could define the dtb instead of the one which is passed from
	  bootloader.
	  Sometimes for debug, we want to use a built-in dtb and then we needn't
	  modify bootloader at all.

config CSKY_BUILTIN_DTB_NAME
	string "kernel builtin dtb name"
	depends on CSKY_BUILTIN_DTB
endmenu
```

## arch/riscv/Kconfig.platforms
```kconfig
menu "Platform selection"

config ARCH_SIFIVE
        bool "SiFive platforms"
        help
          This enables direct support for SiFive SoC platform hardware.

endmenu
```

## drivers/char/ctc/Kconfig
```kconfig
#
# Core2Core
#

menu "RZ/N CTC"

config RZNCTC
	bool "RZ/N Core2Core device support"
	default n
	help
	  Say Y here if you want to support the RZ/N Core2Core.
	  When in doubt, say "Y".

endmenu
```

## drivers/char/displayport_v1_4/Kconfig
```kconfig
#
# Displayport Configuration
#

config TCC_DP_DRIVER_V1_4
	bool "Support DisplayPort V1.4 drivers"
	depends on ARCH_TCC805X
	default y
	help
		It supports DisplayPort Tx V1.4.
		It will make kernel compile DisplayPort V1.4 drivers.
		It's for DP Tx functionalities.
		It's based on Vesa V1.4.
```

## drivers/char/hdcp2_core/Kconfig
```kconfig
#
# HDMI Configuration
#

config TCC_HDCP2_CORE_DRIVER
	bool "TCC HDCP 2.2 Feature Enable"
	depends on TCC_HDMI_DRIVER_V2_0
	default y
	help
	  Say Y here if you want to support the /dev/esm device.
	  The /dev/esm device is used to control Synopsys HDCP IP.
	  It supports HDCP1.4 and HDCP2.2.
	  When in doubt, say "Y".
```

## drivers/char/hdmi_v1_4/Kconfig
```kconfig
#
# HDMI Configuration
#

config TCC_HDMI_DRIVER_V1_4
	bool "Use TCC HDMI V1.4 drivers"
	depends on ARCH_TCC897X
	default n

config TCC_HDCP1_CORE_DRIVER
	bool "TCC HDCP 1.4 Feature Enable"
	depends on TCC_HDMI_DRIVER_V1_4
	default y
```

## drivers/char/hdmi_v2_0/Kconfig
```kconfig
#
# HDMI Configuration
#

config TCC_HDMI_DRIVER_V2_0
	bool "Use TCC HDMI V2.0 drivers"
	depends on (ARCH_TCC898X || ARCH_TCC899X || ARCH_TCC803X || ARCH_TCC901X)
	default n

config TCC_HDMI_TIME_PROFILE
	bool "Support HDMI Time Profile"
	depends on TCC_HDMI_DRIVER_V2_0
	default n

config TCC_RUNTIME_TUNE_HDMI_PHY
	bool "Tune up the hdmi phy using procfs"
	depends on TCC_HDMI_DRIVER_V2_0
	default n
```

## drivers/char/switch/Kconfig
```kconfig
# drivers/char/switch/Kconfig
#
# Copyright (c) 2010 Telechips Co., Ltd.
#	http://www.telechips.com/
# Jay <B150095@telechips.com>
#
# Licensed under GPL

config SWITCH_REVERSE
	tristate "Reverse Switch Driver"
	default n
	help
		Choose this option if you want to use reverse switch driver
```

## drivers/char/tcc_aux_detect/Kconfig
```kconfig
# drivers/char/switch/Kconfig
#
# Copyright (c) 2010 Telechips Co., Ltd.
#	http://www.telechips.com/
#  <B100306@telechips.com>
#
# Licensed under GPL

config TCC_AUX_DETECT
	tristate "TCC Aux detect Driver"
	default n
	help
		This driver detects the aux jack.
		This driver creates sysfs to inform you of the aux status.
		Choose this option if you want to use aux detect driver.
		This driver only supports Telechips EVM Board.
```

## drivers/char/tcc_cipher/Kconfig
```kconfig
config TCC_HSIO_CIPHER
	tristate "TCC HSIO Cipher"
	default n
	depends on PLATFORM_AVN
	help
        This adds support for HSIO Cipher.
        The CIPHER encrypts data or decrypts the encrypted data for the security of user data.
        AES, DES, MULTI2, Hash, CSA2, and CSA3 are algorithms built in the CIPHER.
        Specifically, AES supports 128/192/256 key mode and ECB (Electronic Codebook),
		CBC (Cipher Block Chaining), CFB (Cipher Feedback), OFB (Output Feedback),
		CTR (Counter) mode in AES, DES, and MULTI2.
```

## drivers/char/tcc_early_view_control/Kconfig
```kconfig
config TCC_EARLY_VIEW_CM_CONTROL
	tristate "TCC Early-View CM Control"
	default n
	depends on PLATFORM_AVN
	help
		Support to Cortex-M4 EarlyCamera Solution.
```

## drivers/char/tcc_hsm/Kconfig
```kconfig
config TCC_HSM
	tristate "TCC HSM"
	default n
	depends on PLATFORM_AVN
	help
		Support to HSM based on Cortex-M4(TCC803x) or HSM Core(TCC805x)
```

## drivers/char/tcc_ipc/Kconfig
```kconfig
config TCC_IPC
	tristate "TCC IPC Driver for TCC803x/TCC805X"
	default n
	depends on TCC_MULTI_MAILBOX
	help
		TCC IPC only supports TCC803x/TCC805X.
		TCC IPC is a driver that communicates between cores.
		Supprot Core :
		Main core <-> Subcore, Main Core <-> MICOM, Sub Core <-> MICOM
```

## drivers/char/tcc_sdr_ipc/Kconfig
```kconfig
config TCC_SDR_IPC
	tristate "Telechips IPC Driver for SDR Applications"
	default n
	depends on TCC_MULTI_MAILBOX && ARCH_TCC805X
	help
		TCC SDR IPC only supports TCC805X.
		This driver is for SDR Applications.
		This driver supports communication between main_core(A72) and sub_core(A53).
```

## drivers/char/tcc_snor_updater/Kconfig
```kconfig
config TCC_SNOR_UPDATER
	bool "TCC SNOR Update Driver for TCC803x/TCC805x"
	default n
	depends on TCC_MULTI_MAILBOX
	help
		This driver only supports TCC803x/TCC805x.
		This driver is snor updater driver.
		You need to use this drvier for snor image update.
		Snor is used by R5 core.
```

## drivers/char/tcc_thsm/Kconfig
```kconfig
config TCC_THSM
	tristate "TCC THSM"
	default n
	depends on PLATFORM_AVN
	help
		Support to THSM based on CA7,R5, <-> CA53 communication
```

## drivers/char/viocmg/Kconfig
```kconfig
config TCC_VIOCMG

   bool "TCC VIOC Manager for Automotive Linux Platform "
   default y
   depends on PLATFORM_AVN && (ARCH_TCC897X || ARCH_TCC896X || ARCH_TCC570X || ARCH_TCC802X)
   help
     TCC VIOC Manager for Automotive Linux Platform.
```
