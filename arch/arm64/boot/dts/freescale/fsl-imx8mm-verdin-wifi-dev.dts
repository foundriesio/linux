// SPDX-License-Identifier: GPL-2.0+ OR MIT
/*
 * Copyright 2019 Toradex
 */

/dts-v1/;

#include "fsl-imx8mm-verdin-wifi.dtsi"
#include "fsl-imx8mm-verdin-dev.dtsi"

/ {
	model = "Toradex Verdin iMX8M Mini WB on Verdin Development Board";
	compatible = "toradex,verdin-imx8mm-wifi-dev",
		     "toradex,verdin-imx8mm-wifi", "fsl,imx8mm";
};
