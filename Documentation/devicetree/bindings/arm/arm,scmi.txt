## Documentation/devicetree/bindings/arm/arm,scmi.txt
```
System Control and Management Interface (SCMI) Message Protocol
----------------------------------------------------------

The SCMI is intended to allow agents such as OSPM to manage various functions
that are provided by the hardware platform it is running on, including power
and performance functions.

This binding is intended to define the interface the firmware implementing
the SCMI as described in ARM document number ARM DUI 0922B ("ARM System Control
and Management Interface Platform Design Document")[0] provide for OSPM in
the device tree.

Required properties:

- compatible : shall be "arm,scmi"
- method : The method of calling the SCMI firmware. Only permitted value
	   currently is:
	   "mailbox-doorbell" : When mailbox doorbell is used as a mechanism
				to alert the presence of a messages and/or
				notification
- mboxes: List of phandle and mailbox channel specifiers. It should contain
	  exactly one or two mailboxes, one for transmitting messages("tx")
	  and another optional for receiving the notifications("rx") if
	  supported.
- mbox-names: shall be "tx" or "rx"
- shmem : List of phandle pointing to the shared memory(SHM) area as per
	  generic mailbox client binding.

See Documentation/devicetree/bindings/mailbox/mailbox.txt for more details
about the generic mailbox controller and client driver bindings.

Each protocol supported shall have a sub-node with corresponding compatible
as described in the following sections. If the platform supports dedicated
communication channel for a particular protocol, the 3 properties namely:
mboxes, mbox-names and shmem shall be present in the sub-node corresponding
to that protocol.

Clock/Performance bindings for the clocks/OPPs based on SCMI Message Protocol
------------------------------------------------------------

This binding uses the common clock binding[1].

Required properties:
- #clock-cells : Should be 1. Contains the Clock ID value used by SCMI commands.

Power domain bindings for the power domains based on SCMI Message Protocol
------------------------------------------------------------

This binding uses the generic power domain binding[4].

PM domain providers
===================

Required properties:
 - #power-domain-cells : Should be 1. Contains the device or the power
			 domain ID value used by SCMI commands.

PM domain consumers
===================

Required properties:
 - power-domains : A phandle and PM domain specifier as defined by bindings of
                   the power controller specified by phandle.

Sensor bindings for the sensors based on SCMI Message Protocol
--------------------------------------------------------------
SCMI provides an API to access the various sensors on the SoC.

Required properties:
- #thermal-sensor-cells: should be set to 1. This property follows the
			 thermal device tree bindings[2].

			 Valid cell values are raw identifiers (Sensor ID)
			 as used by the firmware. Refer to  platform details
			 for your implementation for the IDs to use.

SRAM and Shared Memory for SCMI
-------------------------------

A small area of SRAM is reserved for SCMI communication between application
processors and SCP.

The properties should follow the generic mmio-sram description found in [3]

Each sub-node represents the reserved area for SCMI.

Required sub-node properties:
- reg : The base offset and size of the reserved area with the SRAM
- compatible : should be "arm,scmi-shmem" for Non-secure SRAM based
	       shared memory

[0] http://infocenter.arm.com/help/topic/com.arm.doc.den0056a/index.html
[1] Documentation/devicetree/bindings/clock/clock-bindings.txt
[2] Documentation/devicetree/bindings/thermal/thermal.txt
[3] Documentation/devicetree/bindings/sram/sram.txt
[4] Documentation/devicetree/bindings/power/power_domain.txt

Example:

sram: sram@50000000 {
	compatible = "mmio-sram";
	reg = <0x0 0x50000000 0x0 0x10000>;

	#address-cells = <1>;
	#size-cells = <1>;
	ranges = <0 0x0 0x50000000 0x10000>;

	cpu_scp_lpri: scp-shmem@0 {
		compatible = "arm,scmi-shmem";
		reg = <0x0 0x200>;
	};

	cpu_scp_hpri: scp-shmem@200 {
		compatible = "arm,scmi-shmem";
		reg = <0x200 0x200>;
	};
};

mailbox: mailbox0@40000000 {
	....
	#mbox-cells = <1>;
};

scmi_protocol: scmi@2e000000 {
	compatible = "arm,scmi";
	method = "mailbox-doorbell";
	mboxes = <&mailbox 0 &mailbox 1>;
	shmem = <&cpu_scp_lpri &cpu_scp_hpri>;
	#address-cells = <1>;
	#size-cells = <0>;

	scmi_devpd: protocol@11 {
		reg = <0x11>;
		#power-domain-cells = <1>;
	};

	scmi_dvfs: protocol@13 {
		reg = <0x13>;
		#clock-cells = <1>;
	};

	scmi_clk: protocol@14 {
		reg = <0x14>;
		#clock-cells = <1>;
	};

	scmi_sensors0: protocol@15 {
		reg = <0x15>;
		#thermal-sensor-cells = <1>;
	};
};

cpu@0 {
	...
	reg = <0 0>;
	clocks = <&scmi_dvfs 0>;
};

hdlcd@7ff60000 {
	...
	reg = <0 0x7ff60000 0 0x1000>;
	clocks = <&scmi_clk 4>;
	power-domains = <&scmi_devpd 1>;
};

thermal-zones {
	soc_thermal {
		polling-delay-passive = <100>;
		polling-delay = <1000>;

				/* sensor         ID */
		thermal-sensors = <&scmi_sensors0 3>;
		...
	};
};
```

## Documentation/devicetree/bindings/arm/freescale/fsl,vf610-ddrmc.txt
```
Freescale Vybrid LPDDR2/DDR3 SDRAM Memory Controller

The memory controller supports high performance applications for 16-bit or
8-bit DDR2, or LPDDR SDRAM memories.

Required properties:
- compatible:	"fsl,vf610-ddrmc"
- reg:		the register range of the DDRMC registers
- clocks:	DDRMC main clock to clock memory and access registers.
- clock-names:	Must contain "ddrc", matching entry in the clocks property.
- fsl,has-cke-reset-pulls:
		States whether pull-down/up are populated on DDR CKE/RESET
		signals to allow using DDR self-refresh modes (see Vybrid
		Hardware Development Guide for details).

Example:
	ddrmc: ddrmc@400ae000 {
		compatible = "fsl,vf610-ddrmc";
		reg = <0x400ae000 0x1000>;
		clocks = <&clks VF610_CLK_DDRMC>;
		clock-names = "ddrc";
		fsl,has-cke-reset-pulls;
	}
```

## Documentation/devicetree/bindings/block/ram.txt
```
Telechips RAM block driver

A block driver uses RAM as a storage.

Required properties:
- compatible: should be "telechips,ramblk".
- memory-region: specifies the region of the reserved memory.

Example:
	reserved_ramblk: reserved_ramblk {
		compatible = "telechips,pmap";
		telechips,pmap-name = "ramblk";
		no-map;
		size = <0x8000000>;
	};

	ramblk {
		compatible = "telechips,ramblk";
		memory-region = <&reserved_ramblk>;
	};
```

## Documentation/devicetree/bindings/char/cam_ipc_mgr.txt
```
* Device Tree Bindings for Camera IPC Manager

  Camera IPC Manager (a.k.a. cam_ipc) is a device driver to communicate between
  mcu and sub-core, which is needed for trust RVC since TCC805X.

  Trust RVC checks the state of sub-core by transferring a request message to
  sub-core via mailbox. Then, sub-core sends back an ACK to MCU. If the message
  cannot receive by MCU, Trust RVC will recognize the state of subcore as safety
  state, it will control the video mux and change the display bus from DDIBUS to
  Trust RVC.

Required properties:

- status     : disable or enable the device node
- compatible : property name that conveys the platform architecture identifiers,
               as 'telechips,cam_ipc_mgr'
- mbox-names : the name of mailbox
- mboxes     : specifies the channel for the mailbox (IPC)
- mbox-id    : specifies the mailbox id for camera ipc manager
- device-name: the name of the device

Example
-------
	cam_ipc_mgr0: cam_ipc_mgr@0 {
		compatible = "telechips,cam_ipc_mgr";
		device-name ="cam_ipc_mgr_sub";
		mbox-names ="sub-cam-ipc";
		mboxes = <&micom_mbox TCC_MICOM_MBOX1_CAMIPC>;
		mbox-id = TCC_MBOX_CAMIPC_ID;
		status = "okay";
	};
```

## Documentation/devicetree/bindings/char/dw-hdcp.txt
```
Synopsys HDCP on HDMI Controller
-----------------------------------------------------
This binding defines the HDCP controller that are using synopsys IP.

Required properties:
- compatible : "telechips,dw-hdcp"
- reg : address and length of the register for the device.
        Should be contained the link and hpi(hdcp2.2) registers.
- interrupts : Should be contained the hdcp and hdcp2 interrupts.

Optional properties:
- memory-region : fixed memory region that are defined 'reserved-memroy'.
                  this option is only used the settop box platform.

Example:
	hdmi_hdcp: hdmi_hdcp@12440000 {
		compatible = "telechips,dw-hdcp";
		reg = <0x12400000 0x20000 0x12440000 0x1000 0x163C0000 0x10>;
		reg-names = "hdmi_link", "hdcp_2.2", "i2c_port_cfg";
		interrupts = <GIC_SPI 123 IRQ_TYPE_LEVEL_HIGH>,
			     <GIC_SPI 126 IRQ_TYPE_LEVEL_HIGH>;
		interrupt-names = "hdmi_link", "hdcp_2.2";
		memory-region = <&reserved_dw_esm>;
	};
```

## Documentation/devicetree/bindings/char/switch.txt
```
* Device Tree Bindings for Telechips Reverse Switch Driver

Required properties:

- compatible : property name that conveys the platform architecture identifiers,
               as 'telechips,switch'

Example
-------
	switch0:switch0 {
		compatible = "telechips,switch";
		status = "okay";

		pinctrl-names = "default";
		pinctrl-0 = <&switch_mb23>;

		switch-gpios = <&gpmb 23 1>;
		switch-active = <0>;
	};
```

## Documentation/devicetree/bindings/char/tcc_aux_detect/aux_detect.txt
```
Telechips aux_detect device

Required property:
- compatible:
	telechips,aux_detect

- pintctrl-0:
	<&aux_detect_pin>

- aux-gpios:
	aux detect gpio

Example:
	aux_detect {
		compatible = "telechips,aux_detect";
		status = "okay";

		pinctrl-names = "default";
		pinctrl-0 = <&aux_detect_pin>;

		aux-gpios = <&gpmb 11 1>;
		aux-active = <1>;
	};
```

## Documentation/devicetree/bindings/char/tcc_ecid.txt
```
* Read EFUSE Data on Telechips SoCs

- compatible : "telechips,tcc-cpu-id";
- reg : physical base address of the controller and length of memory mapped
region.
	<ECID_Control register>,
	<ECID Parrelel output data0 Register>,
	<ECID Parrelel output data1 Register>,
	<PMU Configuration Register>;

Example:

cpu_id: cpu-id@14200290{
		compatible = "telechips,tcc-cpu-id";
		reg = <0x0 0x14200290 0x0 0x4>,
		    <0x0 0x14200298 0x0 0x4>,
		    <0x0 0x1420029C 0x0 0x4>,
		    <0x0 0x14400014 0x0 0x4>;
		status = "okay";
	};
```

## Documentation/devicetree/bindings/char/tcc_hsm/tcc803x/tcc_hsm.txt
```
This is for "Telechips tcc_hsm device for tcc803x"

Required properties:
	- compatible:
		- telechips,tcc-hsm
	-reg:
		Specifies base physical address and size of the registers map.

Optional properties:
	-tcc multi mbox:
		Telechips Mailbox device Telechips Mailbox device
		This device file must be enable to use sec_ipc.
		For more information for , see
		“Documentation/devicetree/bindings/mailbox/tcc803x_multi_mailbox/tcc_multi_mbox.txt”
		in kernel directory.

Example:

	tcc_hsm@0 {
		compatible = "telechips,tcc-hsm";
		status = "okay";
	};
```

## Documentation/devicetree/bindings/char/tcc_ipc/tcc_ipc.txt
```
Telechips TCC IPC device

Required properties:
- compatible:
    telechips,tcc_ipc

- mbox-names: List of identifier strings for each mailbox channel.

- mboxes: List of phandle and mailbox channel specifiers.

- mbox-id:
	TCC_MBOX_IPC_ID


Example:
	ipc0: tcc_ipc0 {
		 compatible = "telechips,tcc_ipc";
		 device-name = "tcc_ipc_micom";
		 mbox-names ="micom-ipc";
		 mboxes = <&micom_mbox TCC_MICOM_MBOX0_IPC>;
		 mbox-id = TCC_MBOX_IPC_ID;
	 };
```

## Documentation/devicetree/bindings/char/tcc_screen_share.txt
```
This is for Telechips Screen Share Driver

Required properties for display:
	-compatible:
		"telechips,tcc_scrshare"

-------------------------------------------------------------------------------

Example:

	tcc_scrshare0: tcc_scrshare@0 {
		compatible = "telechips,tcc_scrshare";
		device-name ="tcc_scrshare_main";
		mbox-names ="main-scrshare";
		mboxes = <&cb_mbox TCC_CB_MBOX_SCRSHARE>;
		mbox-id = TCC_MBOX_SCRSHARE_ID;
		overlay_driver_names = "/dev/overlay";
		status = "disabled";
	};
```

## Documentation/devicetree/bindings/char/tcc_sdr_ipc/tcc_sdr_ipc.txt
```
Telechips IPC Driver for SDR Applications

Required properties:
	-compatible:
    	telechips,sdr_ipc

	-device-name:
		device driver name

	-mbox-names:
		List of identifier strings for each mailbox channel.

	-mboxes:
		List of phandle and mailbox channel specifiers.

	-mbox-id:
		TCC_MBOX_SDR_ID

Example:
	sdr_ipc {
		compatible = "telechips,sdr_ipc";
		device-name = "tcc_sdr_ipc";
		mbox-names ="sdr-ipc-a72";
		mboxes = <&cb_mbox TCC_CB_MBOX_SDR>;
		mbox-id = TCC_MBOX_SDR_ID;
	};
```

## Documentation/devicetree/bindings/char/tcc_snor_update/tcc_snor_updater_dev.txt
```
Telechips snor update device

Required properties:
- compatible:
    telechips,snor_updater

- mbox-names: List of identifier strings for each mailbox channel.

- mboxes: List of phandle and mailbox channel specifiers.

- mbox-id:
	TCC_MBOX_FWUG_ID

Example:
	snor_updater: snor_updater {
		 compatible = "telechips,snor_updater";
		 mbox-names ="snor-update-mbox";
		 mboxes = <&micom_mbox TCC_MICOM_MBOX0_FWUG>;
		 mbox-id = TCC_MBOX_FWUG_ID;
	};
```

## Documentation/devicetree/bindings/char/tcc_tcm_lpo.txt
```
This is for 'telechips,tcm_lpo'.

Required properties for telechips tcm38xx modules:

	-compatible:
		"telechips,tcm_lpo"

        -clocks: clock peri to use
        -clock-names: the name of the clocks referenced by the code.
        -ext_clock_speed: clock speed
        -pinctrl-names: Contains only one value - "default".
        -pinctrl-0: Phandle to pinctrl group for tcc_tcm_lpo.

-------------------------------------------------------------------------------

Example:

        /* for BT/WIFI LPO (32.768KHz) */
        tcm_lpo: tcm_lpo {
                compatible = "telechips,tcm-lpo";
                clocks = <&clk_peri PERI_OUT0>;
                clock-names = "ext_clock";
                ext_clock_speed = <32768>;
                pinctrl-names = "default";
                pinctrl-0 = <&out0_clk>;
        };
```

## Documentation/devicetree/bindings/char/tcc_thsm/tcc_thsm.txt
```
This is for "Telechips tcc_thsm device"

Required properties:
	- compatible:
		- telechips,tcc-thsm
	-reg:
		Specifies base physical address and size of the registers map.

Optional properties:
	-tcc multi mbox:
		Telechips Mailbox device Telechips Mailbox device
		This device file must be enable to use sec_ipc.
		For more information for , see
		“Documentation/devicetree/bindings/mailbox/tcc803x_multi_mailbox/tcc_multi_mbox.txt”
		in kernel directory.

Example:

	tcc_thsm@0 {
		compatible = "telechips,tcc-thsm";
		status = "okay";
	};
```

## Documentation/devicetree/bindings/char/tcc_wdma.txt
```
This is for 'telechips,tcc_wdma'.

Required properties for display:
	-compatible:
		"telechips,tcc_wdma"

-------------------------------------------------------------------------------

Example:

		wdma_drv0:wdma_drv@0 {
		compatible = "telechips,tcc_wdma";
		clocks = <&clk_ddi DDIBUS_VIOC>;
		wdma-fbdisplay = <&fbdisplay>;
		scalers = <&vioc_scaler VIOC_SCALER0>, <&vioc_scaler VIOC_SCALER0>;       /* id:1, path:20 (wdma 0 path), 21(wdma 1 path) */

		wdmas = <&vioc_wdma VIOC_WDMA00>, <&vioc_wdma VIOC_WDMA01>;   /* id:1, path: wmix output mixed pah */
		wmixs = <&vioc_wmix VIOC_WMIX0>, <&vioc_wmix VIOC_WMIX1>;      /* id:1, path: input rdma mixed path */
		status = "okay";
	};
```

## Documentation/devicetree/bindings/char/vioc_mgr.txt
```
* Device Tree Bindings for Telechips VIOC Manager

Required properties:

- status     : disable or enable the device node
- compatible : property name that conveys the platform architecture identifiers,
               as 'telechips,switch'
- mbox-names : the name of mailbox
- mboxes     : specifies the channel for the mailbox (IPC)
- mbox-id    : specifies the mailbox id for vioc manager

Example
-------
	vioc_mgr0: vioc_mgr@0 {
		compatible = "telechips,vioc_mgr";
		device-name ="vioc_mgr_sub";
		mbox-names ="sub-vioc";
		mboxes = <&cb_mbox TCC_CB_MBOX_VIOC>;
		mbox-id = TCC_MBOX_VIOC_ID;
		status = "okay";
	};
```
