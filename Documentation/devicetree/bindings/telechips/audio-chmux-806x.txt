## Documentation/devicetree/bindings/telechips/audio-chmux-806x.txt
```
* Device Tree Bindings for audio-chmux-806x

Required properties:

- compatible : property name that conveys the platform architecture identifiers,
               as 'telechips,switch'
- dai           :
- spdif         :
- status        : disable or enable the device node


Example
-------
	&audio_chmux {
	    compatible = "telechips,audio-chmux-806x";
	    //dai = <3 99 1 0 99 99 99>;	// i2s0(x) i2s1(x) i2s2(x) i2s3(x) i2s4(x) i2s5(x) i2s6(x)
	    dai = <3 0 1 0 1 99 99>;	// i2s0(x) i2s1(x) i2s2(x) i2s3(x) i2s4(x) i2s5(x) i2s6(x)
	    spdif = <2 99 99 3 99 99 99>;	// spdif0(x) spdif1(x) spdif2(x) spdif3(x) spdif4(x) spdif5(x) spdif6(x)
	    status = "okay";
	};
```

## Documentation/devicetree/bindings/telechips/audio-chmux-898x.txt
```
* Device Tree Bindings for audio-chmux-898x

Required properties:

- compatible : property name that conveys the platform architecture identifiers,
               as 'telechips,switch'
- dai           :
- spdif         :
- status        : disable or enable the device node


Example
-------
	audio_chmux@XXXXX000{
		compatible = "telechips,audio-chmux-898x";
		dai = <1 0 3 0 1 99 99 99>;	// i2s0(x) i2s1(x) i2s2(x) i2s3(x) i2s4(x) i2s5(x) i2s6(x) i2s7(x)
		spdif = <99 99 4 5 99 99 99>;	// spdif0(x) spdif1(x) spdif2(x) spdif3(x) spdif4(x) spdif5(x) spdif6(x)
		status = "okay";
	};
```

## Documentation/devicetree/bindings/telechips/audio-chmux-899x.txt
```
* Device Tree Bindings for audio-chmux-899x

Required properties:

- compatible : property name that conveys the platform architecture identifiers,
               as 'telechips,switch'
- dai           :
- cdif          :
- spdif         :
- status        : disable or enable the device node


Example
-------
	audio_chmux@16051000{
		compatible = "telechips,audio-chmux-899x";
		dai = <1 99>; // i2s0(x) i2s1(x)
		cdif = <99 99>; // cdif0(x) cdif1(x)
		spdif = <1 99>; // spdif0(x) spdif1(x)
		status = "okay";
	};
```

## Documentation/devicetree/bindings/telechips/audio-chmux-901x.txt
```
* Device Tree Bindings for audio-chmux-901x

Required properties:

- compatible : property name that conveys the platform architecture identifiers,
               as 'telechips,switch'
- dai           :
- cdif          :
- spdif         :
- status        : disable or enable the device node


Example
-------
	audio_chmux@16051000{
		compatible = "telechips,audio-chmux-901x";
		dai = <1 99>; // i2s0(x) i2s1(x)
		cdif = <99 99>; // cdif0(x) cdif1(x)
		spdif = <1>; // spdif0(x)
		status = "okay";
	};
```

## Documentation/devicetree/bindings/telechips/audio-chmux.txt
```
* Device Tree Bindings for audio-chmux-803x

Required properties:

- compatible : property name that conveys the platform architecture identifiers,
               as 'telechips,switch'
- dai           :
- spdif         :
- status        : disable or enable the device node


Example
-------
	audio_chmux@16051000{
		compatible = "telechips,audio-chmux-803x";
	    //dai = <3 99 1 0 99 99 99>;	// i2s0(x) i2s1(x) i2s2(x) i2s3(x) i2s4(x) i2s5(x) i2s6(x)
	    dai = <3 0 1 0 1 99 99>;	// i2s0(x) i2s1(x) i2s2(x) i2s3(x) i2s4(x) i2s5(x) i2s6(x)
	    spdif = <4 99 99 5 99 99 99>;	// spdif0(x) spdif1(x) spdif2(x) spdif3(x) spdif4(x) spdif5(x) spdif6(x)
	    status = "okay";
	};

	audio_chmux@16051000{
	    compatible = "telechips,audio-chmux-805x";
	    dai = <1 0 3 0 1 99 99 99>;	// i2s0(x) i2s1(x) i2s2(x) i2s3(x) i2s4(x) i2s5(x) i2s6(x) i2s7(x)
	    spdif = <99 99 4 5 99 99 99>;	// spdif0(x) spdif1(x) spdif2(x) spdif3(x) spdif4(x) spdif5(x) spdif6(x)
	    status = "okay";
	};

	audio_chmux@16051000{
	    compatible = "telechips,audio-chmux-806x";
	    dai = <3 0 1 0 1 99 99>;	// i2s0(x) i2s1(x) i2s2(x) i2s3(x) i2s4(x) i2s5(x) i2s6(x)
	    spdif = <2 99 99 3 99 99 99>;	// spdif0(x) spdif1(x) spdif2(x) spdif3(x) spdif4(x) spdif5(x) spdif6(x)
	    status = "okay";
	};

	audio_chmux@16051000{
		compatible = "telechips,audio-chmux-898x";
		reg = <0x16051000 0x78>;
		dai = <0 0>; // i2s0(x) i2s1(x)
		cdif = <0 0>; // cdif0(x) cdif1(x)
		spdif = <0 0>; //spdif0(x) spdif1(x)
		status = "disabled";
	};

	audio_chmux: audio_chmux@16051000{
		compatible = "telechips,audio-chmux-899x";
		reg = <0x16051000 0x78>;
		dai = <0 0>; // i2s0(x) i2s1(x)
		cdif = <0 0>; // cdif0(x) cdif1(x)
		spdif = <0 0>; // spdif0(x) spdif1(x)
		status = "disabled";
	};

	audio_chmux@16051000{
		compatible = "telechips,audio-chmux-901x";
		dai = <1 99>; // i2s0(x) i2s1(x)
		cdif = <99 99>; // cdif0(x) cdif1(x)
		spdif = <1>; // spdif0(x)
		status = "okay";
	};
```

## Documentation/devicetree/bindings/telechips/cxd5700.txt
```
* Device Tree Bindings for CXD5700 (ISP-less camera module)

CXD5700 is camera FHD image sensor using MIPI CSI2 output. It is disabled by
default for Telechips EVB.

Required properties:

- status     : disable or enable the device node
- compatible : property name that conveys the platform architecture identifiers,
               as 'sony,cxd5700'
- reg        : I2C slave address
- port       : specifies the endpoint of the sensor (input – port@0 – is optional)

example
-------
cxd5700: cxd5700 {
		/* ISP of camera module */
		status		= "disabled";
		compatible	= "sony,cxd5700";
		reg		= <0x18>;
		ports {
			#address-cells = <1>;
			#size-cells = <0>;

			port@0 {
				reg = <0>;
				cxd5700_in: endpoint {
					remote-endpoint = <&cis>;
					io-direction	= "input";
				};
			};

			port@1 {
				reg = <1>;
				cxd5700_out: endpoint {
					remote-endpoint = <&max9275_in>;
					io-direction	= "output";
				};
			};
		};
	};
```

## Documentation/devicetree/bindings/telechips/ictc.txt
```
* Telechips ICTC(input capture time counter)


Required properties:
- compatible:
        Must be "telechips,ictc".
- interrupts:
        Interrupt source connected to ICTC.
- reg:
            Address of ICTC register with length 0x4d.


Optional properties:
- status:
        This property defines state of ICTC to enabled/disabled.
- clocks:
        Phandle to the clock.
- pinctrl-names:
        Contains only one value - "default".
- pinctrl-0:
        Phandle to pinctrl group for ICTC.
- f-in-gpio:
        A GPIO from which the signal subjected to ICTC comes.
- f-in-rtc-wkup:
        The signal subjected to ICTC comes from RTC_WKUP pin instead of GPIO.
- r-edge:
        Rising edge matching value
- f-edge:
        Falling edge matching value
- edge-maching-value:
        Edge counter matching value
- time-out:
        Timeout value
- duty-rounding-value:
        Duty compare rounding value
- prd-rounding-value:
        Period compare rounding value
- flt-f-mode:
        Filter mode for falling edge
        b00: RST mode
        b01: HD mode
        b10: UD mode
        b11: IMM mode
- flt-r-mode:
        mode for rising edge
        b00: RST mode
        b01: HD mode
        b10: UD mode
        b11: IMM mode
- cmp-err-sel:
        Interrupt selection between period/duty compare result for counting
        falling edge
        b00: Select period compare interrupt
        b01: Select duty compare interrupt
        b1x: Select period and duty compare interrupt
- abs-sel:
        absolute value use
        0: Not use absolute value difference
        1: Use absolute value difference
- edge-sel:
        Select rising edge or falling edge for edge counter
        0: Rising edge selection
        1: Falling edge selection
- tck-pol:
        Pre-scaler output clock polarity change enable
- tck-sel:
        Pre-scaler output clock select
        TCLK_SEL[2:0]: Select divided clock (2, 4, 8, 16, 32, 64, 128, 256)
        TCLK_SEL[3] = b0: Counter out select for output clock
        TCLK_SEL[3] = b1: Bypass clock select for output clock
- lock-en:
        Disable to change external input for capture
- r-edge-int:
        Rising edge interrupt enable
- f-edge-int:
        Falling edge interrupt enable
- df-cnt-full-int:
        Duty and frequency comparing counter full interrupt enable
- f-chg-int:
        Frequency changing interrupt enable
- d-chg-int:
        Duty changing interrupt enable
- e-cnt-full-int:
        Edge counter full interrupt enable
- to-cnt-full-int:
        Timeout counter full interrupt enable
- nf-ed-cnt-full-int:
        Noise-filter and edge detection counter full interrupt enable
- time-stamp-cnt:
        Time Stamp counter enable


Example:

ictc: ictc {
    compatible = "telechips,ictc";
    status = "okay";
    reg = <0x16055000 0x4d>;
    interrupts = <GIC_SPI 97 IRQ_TYPE_LEVEL_HIGH>;
    clocks = <&clk_peri PERI_IC_TC>;
    pinctrl-names = "default";
    pinctrl-0 = <&ictc_f_in>;
    f-in-gpio = <&gph 5 0>;
    r-edge = <100>;
    f-edge = <100>;
    edge-matching-value = <100>;
    time-out = <0>;
    duty-rounding-value = <0x0ffffff0>;
    prd-rounding-value = <0x0fffffff0>;
    flt-f-mode = <0x3>;
    flt-r-mode = <0x3>;
    cmp-err-sel = <0>;
    abs-sel = <1>;
    edge-sel = <0>;
    tck-pol = <0>;
    tck-sel = <0>;
    lock-en = <0>;
    f-chg-int;
};
```

## Documentation/devicetree/bindings/telechips/isp.txt
```
* Device Tree Bindings for ISP (Image Signal Processor)

Required properties:

- status     : disable or enable the device node
- compatible : property name that conveys the platform architecture identifiers,
               as 'maxim,max96701'
- iommu      : specifies iommu configuration
- reg        : specifies memory used in ISP
- reg-names  : specifies the name of reg values

example
-------

	isp0: isp0@1bc80000 {
		compatible = "telechips,tcc805x-isp";
		status = "okay";
		reg =	<0x1bc80000 0x10000>,	/* ISP base */
			<0x1bc90000 0x10000>;	/* ISP memory */
		reg-names = "isp_base", "mem_base";
		ports {
			#address-cells = <1>;
			#size-cells = <0>;
			port@0 {
				reg = <0>;
				isp0_in: endpoint {
					remote-endpoint = <&mipi_csi2_0_out0>;
					io-direction	= "input";
				};
			};
			port@1 {
				reg = <1>;
				isp0_out: endpoint {
					remote-endpoint = <&videoinput4_in>;
					io-direction	= "output";
				};
			};
		};
	};
```

## Documentation/devicetree/bindings/telechips/mailbox-audio.txt
```
* Device Tree Bindings for mailbox-audio

Required properties:

- compatible : property name that conveys the platform architecture identifiers,
               as 'telechips,switch'
- status        : disable or enable the device node


Example
-------
	audio_mbox0: audio_mbox@0 {
		compatible = "telechips,mailbox-audio";
		device-name ="audio-mbox-dev-a53";
		mbox-names ="audio-mbox-a53";
		mboxes = <&mbox1 TCC_MBOX1_CH_SND>;
		status = "disabled";
	};

	audio_mbox1: audio_mbox@1 {
		compatible = "telechips,mailbox-audio-r5";
		device-name ="audio-mbox-dev-r5";
		mbox-names ="audio-mbox-r5";
		mboxes = <&mbox0 TCC_MBOX0_CH_SND>;
		status = "disabled";
	};
```

## Documentation/devicetree/bindings/telechips/max9286.txt
```
* Device Tree Bindings for MAX9286

Required properties:

- status     : disable or enable the device node
- compatible : property name that conveys the platform architecture identifiers,
               as 'maxim,max9286'
- reg        : I2C slave address
- port       : specifies the endpoint of the sensor
- rst-gpios  : specifies reset pin number
- intb-gpios : specifies interrupt pin number
- pwd-gpios  : specifies power pin number

example
-------
	max9286: max9286 {
		/* deserializer */
		status		= "okay";
		compatible	= "maxim,max9286";
		pwd-gpios	= <&gpg 5 1>;
		intb-gpios	= <&gph 11 1>;
		//rst-gpios	= <&gpb 15 1>;	/* mcnex module sensor */
		reg		= <0x48>;	// 0x90 >> 1
		ports {
		      ...
```

## Documentation/devicetree/bindings/telechips/max96701.txt
```
* Device Tree Bindings for MAX96701 (HD camera module)

Required properties:

- status     : disable or enable the device node
- compatible : property name that conveys the platform architecture identifiers,
               as 'maxim,max96701'
- reg        : I2C slave address
- port       : specifies the endpoint of the sensor

example
-------
	max96701: max96701 {
		/* serializer */
		status		= "okay";
		compatible	= "maxim,max96701";
		reg		= <0x40>;
		ports {
			#address-cells = <1>;
			#size-cells = <0>;
			port@0 {
				reg = <0>;
				max96701_in: endpoint {
					//remote-endpoint = <&ar0147_out>;
					//io-direction	= "input";
				};
			};
			port@1 {
				reg = <1>;
				max96701_out: endpoint {
					remote-endpoint = <&max9286_in0>;
					io-direction	= "output";
				};
			};
		};
	};
```

## Documentation/devicetree/bindings/telechips/max96712.txt
```
* Device Tree Bindings for MAX96712

Required properties:

- status     : disable or enable the device node
- compatible : property name that conveys the platform architecture identifiers,
               as 'maxim,max96701'
- reg        : I2C slave address
- ports      : specifies the endpoint of the sensor
- pwd-gpios  : specifies gpio number for power
- intb-gpios : specifies gpio number for interrupt

example
-------
	max96712: max96712 {
		/* deserializer */
		status		= "disabled";
		compatible	= "maxim,max96712";
		pwd-gpios	= <&gpg 5 1>;
		intb-gpios	= <&gph 11 1>;
		reg		= <0x2A>;
		ports {
			#address-cells = <1>;
			#size-cells = <0>;
			/*
			 * 0 ~ 3
			 * input ports. The number is matched with VC
			 *
			 * 4
			 * output port.
			 */
			port@0 {
				reg = <0>;
				max96712_in0: endpoint {
					remote-endpoint = <&max9275_out>;
					io-direction	= "input";
					channel		= <0>;
				};
			};
			...
```

## Documentation/devicetree/bindings/telechips/snd-card.txt
```
* Device Tree Bindings for snd-card

Required properties:

- compatible : property name that conveys the platform architecture identifiers,
               as 'telechips,switch'
- status        : disable or enable the device node


Example
-------
	sound@0 {
		compatible = "telechips,snd-card";
		card-name = "TCC805x EVM Card";
		status = "okay";

		telechips,dai-link@0 {
			stream-name="I2S_0";
			codec,format = "i2s"; // i2s, left_j, right_j
			codec,continuous-clock;
			mclk_div = <16>; // 4,6,8,16
			bclk_ratio = <64>; // 32,48,64fs
			pcm = <&adma2>;
			dai = <&i2s2>;
			codec = <&ak4601>;
			codec,dai-name = "ak4601-aif1";
		};

		telechips,dai-link@1 {
			stream-name="SPDIF_0_TX";
			pcm = <&adma2>;
			dai = <&spdif2>;
			playback-only;
		};

		telechips,dai-link@2 {
			stream-name="SPDIF_1_RX";
			pcm = <&adma3>;
			dai = <&spdif3>;
			capture-only;
		};

		telechips,dai-link@3 {
			stream-name="I2S_3";
			codec,format = "i2s"; // i2s, left_j, right_j
			codec,continuous-clock;
			mclk_div = <16>; // 4,6,8,16
			bclk_ratio = <64>; // 32,48,64fs
			pcm = <&adma3>;
			dai = <&i2s3>;
		};
	};
```

## Documentation/devicetree/bindings/telechips/spdif.txt
```
* Device Tree Bindings for spdif

Required properties:

- compatible       : 
- reg                :
- clocks             :
- clock-frequency :
- adma              :
- status              : disable or enable the device node


Example
-------
	spdif0: spdif@16102000 {
		compatible = "telechips,spdif";
		reg = <0x0 0x16102000 0x0 0x1000>;
		clocks = <&clk_peri PERI_MSPDIF0 &clk_io IOBUS_SPDIF0>;
		clock-frequency = <44100>;
		adma = <&adma0>;
		status = "disabled";
	};
```

## Documentation/devicetree/bindings/telechips/tcc_sc_ufs.txt
```
 * Bindings for Telechisp UFS driver

 Required properties:

 - compatible: must be "telechips,tcc806x-sc-ufs"
 - sc-firmware: protocol driver to communicate with storage core

 Example:

 tcc_sc_ufs: tcc_sc_ufs {
     compatible = "telechips,tcc805x-sc-ufs";
     status = "okay";
     sc-firmware = <&tcc_sc_fw>;
 };
```
