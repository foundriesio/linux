## Documentation/devicetree/bindings/usb/tcc-ohci.txt
```
Telechips USB OHCI controller

Required properties:
 - compatible:  must be "telechips,tcc-ohci"
 - reg:         physical base addresses of the controller and length of memory
                mapped region
 - interrupts:  interrupt should be described here
 - clocks:      phandle list of usb clocks

Optional properties:
 - tpl-support: TPL (Targeted Peripheral List) feature for targeted hosts

Example:

ohci: ohci@11A80000 {
	compatible = "telechips,tcc-ohci";
	reg = <0x11A80000 0x60 0x11DA0010 0x54>;
	interrupts = <GIC_SPI 142 IRQ_TYPE_LEVEL_HIGH>;
	clocks = <&clk_hsio HSIOBUS_USB20H &clk_isoip_top ISOIP_TOP_U20H>;
	tpl-support;
};
```
