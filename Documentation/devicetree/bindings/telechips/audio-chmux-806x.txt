## Documentation/devicetree/bindings/telechips/telechips,pic.txt
```
* Telechips PIC(Programmable Interrupt Controller)

Telechips SoC use ARM GIC(Generic Interrupt Controller) basically
as an interrupt controller. But, ARM GIC support only rising edge triggered
or active high level interrupt. For this reason, the role of the PIC
is minimized to set a polarity of interrupts.

Required properties:
- compatible: Dependent on Telechips SoC
	"telechips,tcc805x-pic"
	"telechips,tcc805x-pic"
	"telechips,tcc803x-pic"
	"telechips,tccsub-ca7-pic"
	"telechips,tcc901x-pic"
	"telechips,tcc899x-pic"
	"telechips,tcc897x-pic"
- reg: Specifies base physical address and size of the registers.
- demarcation: The demarcation of the register set.
	PIC registers have not designed sequentially and divided into two sections.
- max_irq: Total interrupts that Telechips SoC has

Example:
tcc_pic: pic@14100000 {
	compatible = "telechips,tcc805x-pic";
	reg = <0x0 0x141000E0 0x0 0x0018>,  /* pol_0_base */
	      <0x0 0x14600100 0x0 0x0024>,  /* pol_1_base */
	      <0x0 0x14800040 0x0 0x003C>,  /* cmb_cm4_base */
	      <0x0 0x14900040 0x0 0x003C>,  /* strgb_cm4_base */
	      <0x0 0x0 0x0 0x0>;            /* ca7_irqo_en_base */
	demarcation = <192>;
	max_irq = <480>;
};
```

## Documentation/devicetree/bindings/telechips/video-input.txt
```
* Device Tree Bindings for Telechips Video Input Path Driver

VIN (Video INput path) is used to specify the path to receive frame data from
the sensor.

Required properties:

- status     : disable or enable the device node
- compatible : property name that conveys the platform architecture identifiers,
               as 'telechips,switch'
- cifport    : specifies the port number of CIF (camera interface)
- clocks     : specifies clock source of video-input
- rdma       : specifies the index of RDMA used in VIN path
- use_pgl    : specifies whether PGL (Parking Guide Lines) would be mixed or not
- vin        : specifies the index of VIN
- viqe       : specifies the index of VIQE
- deints     : specifies the index of Simple Deinterlacer
- scaler     : specifies the index of scaler
- wmixer     : specifies the index of wmixer
- wdma       : specifies the index of wdma
- fifo       : specifies the index of fifo

Example
-------
	videoinput0: videoinput@0 {
		status		= "okay";
		compatible	= "telechips,video-input";
		cifport		= <&cifport 0>;
		clocks		= <&clk_ddi DDIBUS_VIOC>;
		rdma		= <&vioc_rdma		VIOC_RDMA16>;
		use_pgl		= <1>;
		vin		= <&vioc_vin		VIOC_VIN00>;
		viqe		= <&vioc_viqe		VIOC_VIQE1>;
		viqe_set	= <&viqe_hidden>;
		deintls		= <&vioc_deintls	VIOC_DEINTLS0>;
		scaler		= <&vioc_scaler		VIOC_SCALER2>;
		wmixer		= <&vioc_wmix		VIOC_WMIX5>;
		wdma		= <&vioc_wdma		VIOC_WDMA05>;
		fifo		= <&vioc_fifo		VIOC_FIFO0>;
		port {
			videoinput0_in: endpoint {
				remote-endpoint = <&adv7182_out>;
				io-direction	= "input";
				bus-type	= <0>;
				stream-enable	= <0>;	// VIN_CTRL.SE
				flush-vsync	= <0>;	// VIN_MISC.FVS
			};
		};
	};
```

## Documentation/devicetree/bindings/thermal/tcc-thermal.txt
```
* Temperature Sensor on Telechips SoCs

- compatible : "telechips,tcc-thermal";
- reg : physical base address of the controller and length of memory mapped
	region.
- interrupts : The interrupt number to the cpu.The interrupt specifier format
	depends on the interrupt controller
- throttle_count : Number of throttling table.
- throttle_passive_count : The number of throttle_tables associated with
	throttling.
	Thermal sensor driver supports throttling function.
- cal_type : Type of calibration.
	1. TCC802x/TCC803x/TCC897x support one-point trimming calibration
		TYPE_ONE_POINT_TRIMMING
	2. TCC805x supports two-points trimming calibration
		TYPE_TWO_POINT_TRIMMING
- throttle_table : Operation table according to the temperature
	temp means temperature for operation.
	freq_max_cluster0 is the maximum CPU clock depending on the temperature.
	If it reaches the temperature, the throttling function lowers the CPU
	clock.
- polling-delay-idle : The maximum number of milliseconds to wait between polls
	when checking this thermal zone.
	If you want to use polling check (for throttling or shutdown function),
	set this value.
- polling-delay-passive : The maximum number of milliseconds to wait between
	polls when performing passive cooling (throttling).

Example:

&thermal {
        compatible = "telechips,tcc-thermal";
        reg = <0x14700000 0x4 0x14700030 0x4 0x14200290 0x4 0x1420029C 0x4
               0x14200298 0x4 0x1470000C 0x4 0x14700010 0x4>;

        status = "okay";

        throttle_count = <5>;
        throttle_active_count = <0>;
        throttle_passive_count = <5>;
        interrupts = <GIC_SPI 40 0>;
        cal_type = "TYPE_ONE_POINT_TRIMMING";
        polling-delay-idle = <0>;
        polling-delay-passive = <0>;

        threshold_temp = <85>;

        throttle_table {
                throttle_tab_0 {
                        temp = <75>;
                        freq_max_cluster0 = <1000000>;
                        freq_max_cluster1 = <900000>;
                };
                throttle_tab_1 {
                        temp = <80>;
                        freq_max_cluster0 = <900000>;
                        freq_max_cluster1 = <810000>;
                };
                throttle_tab_2 {
                        temp = <85>;
                        freq_max_cluster0 = <800000>;
                        freq_max_cluster1 = <720000>;
                };
                throttle_tab_3 {
                        temp = <90>;
                        freq_max_cluster0 = <700000>;
                        freq_max_cluster1 = <630000>;
                };
                throttle_tab_4 {
                        temp = <95>;
                        freq_max_cluster0 = <600000>;
                        freq_max_cluster1 = <540000>;
                };
        };
};
```

## Documentation/devicetree/bindings/timer/telechips,timer.txt
```
* Telechips Timer Counter

Required properties:
- compatible: Must be "telechips,timer".
- reg: Specifies base physical address and size of the registers.
- interrupts: A list of 6 interrupt; one per timer channel.
- clocks: Should contain a reference to timer counter clock.
- clock-frequency: The rate of the clock that drives the timer counter, in Hz.

Optional properties:
- tcc-timer-reserved: Reserve a timer for the LPO clocksource.
- tcc-timer-reserved-for-wdt: Reserve a timer to kick watchdog.

Example:

tcc_timer: timer@14300000 { /* tc0~tc5 */
	compatible = "telechips,timer";
	reg = <0x0 0x14300000 0x0 0xa0>;
	interrupts = <GIC_SPI 33 0>,
		     <GIC_SPI 34 0>,
		     <GIC_SPI 35 0>,
		     <GIC_SPI 36 0>,
		     <GIC_SPI 37 0>,
		     <GIC_SPI 38 0>;
	clocks = <&clk_peri PERI_TCT>;
	clock-frequency = <12000000>;

	/* timer 0 and 1 are reserved for watchdog (default) */
	tcc-timer-reserved-for-wdt = <0 1>;
};
```

## Documentation/devicetree/bindings/ufs/tcc-ufs.txt
```
* Telechips Universal Flash Storage (UFS) Host Controller

tcc-ufs nodes are defined to describe on-chip UFS host controllers, UNIPRO and MPHY.
Each UFS controller instance should have its own node.

Required properties:
- compatible	: 
- reg		: <registers mapping>
- interrupts	: <interrupt mapping for UFS host controller IRQ>

Example for a setup :

tcc_ufs: tcc_ufs@1D280000 {
    compatible = "telechips,tcc-ufs";
    reg =   <0x0 0x1d280000 0x0 0x2000>,
            <0x0 0x1d270000 0x0 0x4000>,
            <0x0 0x1d274000 0x0 0x4000>,
            <0x0 0x1d2c0000 0x0 0xC0>,
            <0x0 0x1d290000 0x0 0x400>,
            <0x0 0x1dff0000 0x0 0x40>;
    reg-names = "ufs-hci", "ufs-unipro", "ufs-mphy", "ufs-sbus-config", "ufs-fmp", "ufs-sec";
    interrupts = <GIC_SPI 325 IRQ_TYPE_LEVEL_HIGH>;
    status = "okay";
};
```

## Documentation/devicetree/bindings/usb/dwc2.yaml
```yaml
# SPDX-License-Identifier: GPL-2.0
%YAML 1.2
---
$id: http://devicetree.org/schemas/usb/dwc2.yaml#
$schema: http://devicetree.org/meta-schemas/core.yaml#

title: DesignWare HS OTG USB 2.0 controller Bindings

maintainers:
  - Rob Herring <robh@kernel.org>

properties:
  compatible:
    oneOf:
      - const: brcm,bcm2835-usb
      - const: hisilicon,hi6220-usb
      - items:
          - const: rockchip,rk3066-usb
          - const: snps,dwc2
      - items:
          - enum:
              - rockchip,px30-usb
              - rockchip,rk3036-usb
              - rockchip,rk3188-usb
              - rockchip,rk3228-usb
              - rockchip,rk3288-usb
              - rockchip,rk3328-usb
              - rockchip,rk3368-usb
              - rockchip,rv1108-usb
          - const: rockchip,rk3066-usb
          - const: snps,dwc2
      - const: lantiq,arx100-usb
      - const: lantiq,xrx200-usb
      - items:
          - enum:
              - amlogic,meson8-usb
              - amlogic,meson8b-usb
              - amlogic,meson-gxbb-usb
              - amlogic,meson-g12a-usb
          - const: snps,dwc2
      - const: amcc,dwc-otg
      - const: apm,apm82181-dwc-otg
      - const: snps,dwc2
      - const: st,stm32f4x9-fsotg
      - const: st,stm32f4x9-hsotg
      - const: st,stm32f7-hsotg
      - const: st,stm32mp15-fsotg
      - items:
          - const: st,stm32mp15-hsotg
          - const: snps,dwc2
      - const: samsung,s3c6400-hsotg

  reg:
    maxItems: 1

  interrupts:
    maxItems: 1

  clocks:
    maxItems: 1

  clock-names:
    items:
      - const: otg

  resets:
    items:
      - description: common reset
      - description: ecc reset
    minItems: 1

  reset-names:
    items:
      - const: dwc2
      - const: dwc2-ecc
    minItems: 1

  phys:
    maxItems: 1

  phy-names:
    const: usb2-phy

  power-domains:
    maxItems: 1

  vbus-supply:
    description: reference to the VBUS regulator. Depending on the current mode
      this is enabled (in "host" mode") or disabled (in "peripheral" mode). The
      regulator is updated if the controller is configured in "otg" mode and the
      status changes between "host" and "peripheral".

  vusb_d-supply:
    description: phandle to voltage regulator of digital section,

  vusb_a-supply:
    description: phandle to voltage regulator of analog section.

  usb33d-supply:
    description: reference to the VBUS and ID sensing comparators supply, in
      order to perform OTG operation, used on STM32MP15 SoCs.

  dr_mode:
    enum: [host, peripheral, otg]

  otg-rev:
    description:
      Tells usb driver the release number of the OTG and EH supplement with
      which the device and its descriptors are compliant, in binary-coded
      decimal (i.e. 2.0 is 0200H). This property is used if any real OTG
      features (HNP/SRP/ADP) is enabled. If ADP is required, otg-rev should be
      0x0200 or above.
    $ref: /schemas/types.yaml#/definitions/uint32
    enum: [0x0100, 0x0120, 0x0130, 0x0200]

  hnp-disable:
    description:
      Tells OTG controllers we want to disable OTG HNP. Normally HNP is the
      basic function of real OTG except you want it to be a srp-capable only B
      device.
    type: boolean

  srp-disable:
    description:
      Tells OTG controllers we want to disable OTG SRP. SRP is optional for OTG
      device.
    type: boolean

  adp-disable:
    description:
      Tells OTG controllers we want to disable OTG ADP. ADP is optional for OTG
      device.
    type: boolean

  usb-role-switch:
    $ref: /schemas/types.yaml#/definitions/flag
    description: Support role switch.

  role-switch-default-mode:
    enum: [host, peripheral]
    description: indicating if usb-role-switch is enabled, the default operation
      mode of controller at init.

  g-rx-fifo-size:
    $ref: /schemas/types.yaml#/definitions/uint32
    description: size of rx fifo size in gadget mode.

  g-np-tx-fifo-size:
    $ref: /schemas/types.yaml#/definitions/uint32
    description: size of non-periodic tx fifo size in gadget mode.

  g-tx-fifo-size:
    $ref: /schemas/types.yaml#/definitions/uint32-array
    description: size of periodic tx fifo per endpoint (except ep0) in gadget mode.

  snps,need-phy-for-wake:
    $ref: /schemas/types.yaml#/definitions/flag
    description: If present indicates that the phy needs to be left on for 
      remote wakeup during suspend.

  snps,reset-phy-on-wake:
    $ref: /schemas/types.yaml#/definitions/flag
    description: If present indicates that we need to reset the PHY when we 
      detect a wakeup. This is due to a hardware errata.

  wakeup-source:
    $ref: /schemas/types.yaml#/definitions/flag
    description: If present indicates this device has wakeup capabilities

required:
  - compatible
  - reg
  - interrupts
  - clocks
  - clock-names

additionalProperties: false

examples:
  - |
      usb@101c0000 {
        compatible = "rockchip,rk3066-usb", "snps,dwc2";
        reg = <0x10180000 0x40000>;
        interrupts = <18>;
        clocks = <&usb_otg_ahb_clk>;
        clock-names = "otg";
        phys = <&usbphy>;
        phy-names = "usb2-phy";
      };

...
```

## Documentation/devicetree/bindings/usb/tcc-dwc2.txt
```
Telechips USB DWC2 controller

Required properties:
 - compatible:          must be "telechips,dwc2"
 - reg:                 physical base addresses of the controller and length of
                        memory mapped region
 - interrupts:          interrupt should be described here
 - clocks:              phandle list of usb clocks
 - clock-names:         must be "otg"
 - phy:                 phy provider specifier
 - phy-names:           must be "usb2-phy"
 - telechips,mhst_phy:	must be <&mhst_phy>

Optional properties:

Example:

dwc_otg: dwc_otg@11980000 {
	compatible = "telechips,dwc2";
	reg = <0x11980000 0xcfff 0x11900000 0x108 0x11940000 0x60>;
	interrupts = <GIC_SPI 145 IRQ_TYPE_LEVEL_HIGH>,
                     <GIC_SPI 147 IRQ_TYPE_LEVEL_HIGH>;
	clocks = <&clk_hsio HSIOBUS_USB20H>;
	clock-names = "otg";
	phy = <&dwc_otg_phy>;
	phy-names = "usb2-phy";
	telechips,mhst_phy = <&mhst_phy>;
};
```

## Documentation/devicetree/bindings/usb/tcc-dwc3.txt
```
Telechips USB DWC3 controller

Required properties:
 - compatible:          must be "telechips,tcc-dwc3"
 - clocks:              phandle list of usb clocks
 - telechips,dwc3_phy:  must be <&dwc3_phy>
 - #address-cells:      should be <1> if the device has sub-nodes with 'reg'
                        property
   #size-cells:         should be <1> if the device has sub-nodes with 'reg'
                        property
 - ranges:              allows valid 1:1 translation between child's address
                        space and parent's address space

Optional properties:
 - tpl-support:         TPL(Targeted Peripheral List) feature for targeted hosts

Example:

dwc3: dwc3_platform {
	compatible = "telechips,tcc-dwc3";
	clocks = <&clk_fbus FBUS_HSIO>;
	telechips,dwc3_phy = <&dwc3_phy>;
	#address-cells = <1>;
	#size-cells = <1>;
	ranges;
	tpl-support;

	dwc3 {
		compatible = "snps,dwc3";
		reg = <0x11B00000 0xCFFF>;
		interrupts = <GIC_SPI 152 IRQ_TYPE_LEVEL_HIGH>;
		telechips,dwc3_phy = <&dwc3_phy>;
	};
};
```

## Documentation/devicetree/bindings/usb/tcc-ehci.txt
```
Telechips USB EHCI controller

Required properties:
 - compatible:          must be "telechips,tcc-ehci"
 - reg:                 physical base addresses of the controller and length of
                        memory mapped region
 - interrupts:          interrupt should be described here
 - clocks:              phandle list of usb clocks
 - telechips,ehci_phy:	must be <&ehci_phy>

Optional properties:
 - tpl-support:         TPL(Targeted Peripheral List) feature for targeted hosts

Example:

ehci: ehci@11A00000 {
	compatible = "telechips,tcc-ehci";
	reg = <0x11A00000 0x108 0x11DA0010 0x54>;
	interrupts = <GIC_SPI 142 IRQ_TYPE_LEVEL_HIGH>;
	clocks = <&clk_hsio HSIOBUS_USB20H &clk_isoip_top ISOIP_TOP_U20H>;
	telechips,ehci_phy = <&ehci_phy>;
	tpl-support;
};
```
