## Documentation/devicetree/bindings/power/reset/telechips,restart.txt
```
Telechips restart driver

A system reset is done by setting the PMU registers.

Required properties:
- compatible: should be "telechips,restart".

Optional properties:
- reg: Specifies the base address of the PMU register
```

## Documentation/devicetree/bindings/pwm/pwm-tcc.txt
```
Telechips PWM drivers

Required properties:
- compatible		: "telechips,pwm"
- reg				: Physical base address and size of the controller's register area.
- tcc,pwm-number	: Should be 4. Total number of ports supported by the chip.
					  Refer to Full Specification for ports infomation.
- #pwm-cells		: Should be 2. See pwm.txt in this directory for a description of
  the cells format.
- clocks			: phandle to input clock.
- clock-frequency	: Desired PWM frequency in Hz.

- pinctrl-names		: Sould be "default".
- pinctrl-0			: phandle to pinctrl function.
- gfb-port			: Port mapping number for PDM0, PDM1, PDM2, PDM3
- status			: Activation status

Note: You can control PWM unit in a simple way by automatically generating a
LUT using a Linux Kernel generic LDE driver. Refer to the "Application Not for
PWM" documentation.

Example:

pwm:pwm@16030000 { /* pwm */
		compatible = "telechips,pwm";
		reg = <0x16030000 0x90 0x1605104C 0x4 0x16051094 0x4>;
		tcc,pwm-number = <4>;
		#pwm-cells = <2>;
		clocks = <&clk_peri PERI_PDM &clk_io IOBUS_PWM>;
		clock-frequency = <400000000>;

		pinctrl-names ="default";
		pinctrl-0 = <&led_pin_a>;
		gfb-port = <52 0 0 0>;     //port mapping number for PDM0, PDM1, PDM2, PDM3
		status = "okay";
};
```

## Documentation/devicetree/bindings/regulator/rt5028.txt
```
 * RICHTEK RT5028 pmic

 Required properties:

 - compatible:   must be "Richtek,rt5028"
 - reg:      the i2c slave address of the regulator. It should be 0x3f.

 Optional properties:

 - int-gpios:   a reference to the rt5028 interrupt, if available.

 Any standard regulator properties can be used to configure.

 Example:

 rt5028@3f {
    compatible = "richtek,rt5028";
    reg = <0x3f>;
    int-gpios = <&gpe 31 0>;

    regulators {
        RT5028_ID_BUCK1: buck1 {
            regulator-name = "vdd_core";
            regulator-min-microvolt = <700000>;
            regulator-max-microvolt = <1800000>;
            regulator-always-on;
        };
        RT5028_ID_BUCK2: buck2 {
            regulator-name = "vdd_mem";
            regulator-min-microvolt = <700000>;
            regulator-max-microvolt = <1800000>;
            regulator-always-on;
        };
        RT5028_ID_BUCK3: buck3 {
            regulator-name = "vdd_cpu";
            regulator-min-microvolt = <700000>;
            regulator-max-microvolt = <3600000>;
            regulator-always-on;
	};
```

## Documentation/devicetree/bindings/remoteproc/rproc-srm.txt
```
Remoteproc System Resource Manager
----------------------------------

The remoteproc SRM (System Resource Manager) handles resources allocated
to remote processors.
This makes it possible for remote proc to reserve and initialize system
resources for a peripheral assigned to a coprocessor.

The devices are grouped in a core node

Core
====
Required properties:
- compatible: should be "rproc-srm-core"

Dev
===
Required properties:
- compatible: should be "rproc-srm-dev"

Optional properties:
- reg: register base address and length
- clocks: clocks required by the coprocessor
- clock-names: see clock-bindings.txt
- pinctrl-x: pins configurations required by the coprocessor
- pinctrl-names: see pinctrl-bindings.txt.
	"rproc_default" is a special pin configuration which is applied except
	if the 'early-booted' property is set.
	In a general way, it is recommended to use names prefixed with "rproc_".
- x-supply: power supplies required by the coprocessor
- interrupts: see interrupts.txt
- interrupt-parent: see interrupts.txt
- interrupt-names: see interrupts.txt

Example:
	system_resources {
		compatible = "rproc-srm-core";

		mmc0: sdhci@09060000 {
			compatible = "rproc-srm-dev";
			reg = <0x09060000 0x100>;
			pinctrl-names = "rproc_default", "rproc_idle";
			pinctrl-0 = <&pinctrl_mmc0>;
			pinctrl-1 = <&pinctrl_mmc1>;
			clock-names = "mmc", "icn";
			clocks = <&clk_s_c0_flexgen CLK_MMC_0>,
				 <&clk_s_c0_flexgen CLK_RX_ICN_HVA>;
			vdda-supply = <&vdda>;
		};

		button {
			compatible = "rproc-srm-dev";
			interrupt-parent = <&gpioa>;
			interrupts = <5 1>;
			interrupt-names = "gpio_key";
		};
	};
```

## Documentation/devicetree/bindings/reset/telechips,reset.txt
```
Telechips Reset Controller

The reset controllers provide reset signals of perpheral devices.

Required properties:
- compatible: should be one of the following:
  - "telechips,reset" for PMU software reset
  - "telechips,vpubus-reset" for VPU software reset
  - "telechips,ddibus-reset" for DDI software reset
  - "telechips,iobus-reset" for IO software reset
  - "telechips,hsiobus-reset" for HSIO software reset

The reset of the properties should follow the generic reset description found
in reset.txt.

Example:
	reset: reset-controller@140000b4 {
		compatible "telechip,reset";
		#reset-cells = <1>;
	};

	pcie@11800000 {
		...
		resets = <&reset RESET_PCIE>;
		...
	};
```

## Documentation/devicetree/bindings/riscv/sifive/fu540.txt
```
SiFive FU540 SoC architecture device tree bindings
--------------------------------------------------

Platforms based on the SiFive FU540 RISC-V SoC should follow the
scheme described below:

SoCs
----

Each device tree root node must specify one of the following
compatible-string values:

- Freedom Unleashed 540 rev. C000, or "FU540"
  compatible = "sifive,fu540-c000", "sifive,fu540"

Boards
------

Boards based on the FU540 SoC should specify the following
compatible-string values:

- HiFive-Unleashed rev. A00 board
  compatible = "sifive,hifive-unleashed-a00-fu540",
	       "sifive,hifive-unleashed-fu540"
```

## Documentation/devicetree/bindings/rng/telechips,tcc-rng.txt
```
Telechips Random Number Generator

Required properties:

- compatible  : Should be "telechips,tcc-rng".
- reg         : Specifies base physical address and size of the registers map.
- clocks      : Phandle to clock-controller plus clock-specifier pair.

Example for tcc897x:

	trng@71EB0100 {
		compatible = "telechips,tcc-rng";
		reg = <0x71EB0100 0x100>;
		clocks = <&clk_hsio HSIOBUS_TRNG>;
		status = "okay";
	};

Example for tcc803x, tcc899x or tcc901x:

	trng@11DB0100 {
		compatible = "telechips,tcc-rng";
		status = "okay";
	};
```

## Documentation/devicetree/bindings/rtc/telechips,rtc.txt
```
* Telechips RTC(Real Time Clock)

Required properties:
- compatible: Must be "telechips,rtc".
- reg: Specifies base physical address and size of the registers.
- interrupts: A single interrupt specifier.
- clocks: Must contain one or more entry, for the RTC IP block.


Optional properties:
These properties are available at tcc805x.
- rtc_clock: Clocksource for the RTC
- rtc_timeout: RTC timeout in seconds for Suspend-To-RAM Telechips solution.
	The system will be transit to the power-down mode when it is expired
	after entering suspend mode.

Example:

rtc: rtc@0x16480000 {
	compatible = "telechips,rtc";
	reg = <0x0 0x16480000 0x0 0x50>;
	clocks = <&clk_io IOBUS_RTC>;
	interrupts = <GIC_SPI 73 0>;
	/* Clocksource for RTC, 1: XTAL, 2: OSC */
	rtc_clock = <1>;
	/* RTC timeout in seconds for Suspend-To-RAM */
	rtc_timeout = <172800>;
};
```

## Documentation/devicetree/bindings/sound/telechips,adma.txt
```
* Device Tree Bindings for adma

Required properties:

- compatible : Property name that conveys the platform architecture identifiers,
               as 'telechips,adma'
- reg : Audio DMA register to use.
- clocks : IOBUS clock of Audio DMA to use.
- interrupts : Audio DMA IRQ to use.
- have-hopcnt-clear : Whether to use hopcnt (hop counter)clear.
                      Hopcnt clear suppports DMA stop at anytime.
                      From TCC802x, hopcnt clear funtion is supported.
- adrcnt-mode : Whether to use adrcnt (address counter).
                Adrcnt supports buffer size in multiplex of 32.
                From TCC803x, adrcnt function is supported.
- status : disable or enable the device node.

Example
-------
	adma0: adma@16100000 {
		compatible = "telechips,adma";
		reg = <0x0 0x16100000 0x0 0x200>;
		clocks = <&clk_io IOBUS_ADMA0>;
		interrupts = <GIC_SPI 80 IRQ_TYPE_LEVEL_HIGH>;
		have-hopcnt-clear = <1>;
		adrcnt-mode = <1>;
	};
```

## Documentation/devicetree/bindings/sound/telechips,asrc.txt
```
* Device Tree Bindings for asrc

Required properties:

- compatible : Property name that conveys the platform architecture identifiers,
               as 'telechips,asrc'
- reg : ASRC register to use.
- clocks : Peri/IOBUS clock of ASRC and reference to use.
           In order of reference clock peri, ASRC IOBUS clock.
- clock-names : The name of clocks.
- dma : DMA to use.
- mcaudio : The link of DAIF node to ASRC by M2P and P2M path.
- max-ch-per-pair : Maximum data channel to SRC.
- path-type : Path setting in each pair.
- sync-mode : SRC sync setting.
- async-refclk : Reference clock setting in each pair.
- status : disable or enable the device node.

Example
-------
	asrc0: asrc@16500000 {
		compatible = "telechips,asrc";
		reg = <0x0 0x16500000 0x0 0x1000>;
		interrupts = <GIC_SPI 98 IRQ_TYPE_LEVEL_HIGH>;
		clocks = <&clk_peri PERI_AUX0_INPUT &clk_peri PERI_AUX1_INPUT &clk_peri PERI_AUX0_OUTPUT &clk_peri PERI_AUX1_OUTPUT &clk_io IOBUS_ASRC>;
		clock-names = "aux_in0", "aux_in1", "aux_out0", "aux_out1", "asrc_hclk";
		dma = <&pl080_0>;
		mcaudio = <&i2s0 &i2s4 &i2s5 &i2s6>;
		max-ch-per-pair= <8 2 2 2>;
		path-type = <0 0 0 0>; // 0:m2m, 1:m2p, 2:p2m
		sync-mode = <1 1 1 1>; // 0:async, 1:sync
		async-refclk = <99 99 99 99>; //0:DAI0_LRCK, 1:DAI1_LRCK, 2:DAI2_LRCK, 3:DAI3_LRCK, 99:AUXCLK
		status = "disabled";
	};
```

## Documentation/devicetree/bindings/sound/telechips,asrc_m2m_pcm.txt
```
* asrc_m2m_pcm

Required properties:

- compatible : property name that conveys the platform architecture identifiers,
               as 'telechips,switch'

Example
-------
	asrc_m2m_pcm0: asrc_m2m_pcm@0 {
		compatible = "telechips,asrc_m2m_pcm";
		status = "disabled";
	};

	asrc_m2m_pcm1: asrc_m2m_pcm@1 {
		compatible = "telechips,asrc_m2m_pcm";
		status = "disabled";
	};

	asrc_m2m_pcm2: asrc_m2m_pcm@2 {
		compatible = "telechips,asrc_m2m_pcm";
		status = "disabled";
	};

	asrc_m2m_pcm3: asrc_m2m_pcm@3 {
		compatible = "telechips,asrc_m2m_pcm";
		status = "disabled";
	};
```

## Documentation/devicetree/bindings/sound/telechips,cdif.txt
```
* Device Tree Bindings for cdif

Required properties:

- compatible : Property name that conveys the platform architecture identifiers,
               as 'telechips,cdif'
- reg : CDIF register to use.
- clocks : Peri/IOBUS clock of CDIF and audio filter to use.
           In order of CDIF peri, CDIF IOBUS, audio filter peri clock.
- clock-frequency : Default frame sync clock.
- status : disable or enable the device node.

Example
-------
cdif0: cdif@16101080 {
	compatible = "telechips,cdif";
	reg = <0x16101080 0x20 0x16101000 0x50>;
	clocks = <&clk_peri PERI_MDAI0
	          &clk_io IOBUS_DAI0
			  &clk_peri PERI_MFLT0_CDIF>;
	clock-frequency = <48000>;
	status = "disabled";
};
```

## Documentation/devicetree/bindings/sound/telechips,i2s.txt
```
* Device Tree Bindings for i2s

Required properties:

- compatible : Property name that conveys the platform architecture identifiers,
               as 'telechips,i2s'
- reg : I2S register to use.
- clocks : Peri/IOBUS clock of DAIF and audio filter to use.
           In order of DAIF peri, DAIF IOBUS, audio filter peri clock.
- clock-frequency : Default frame sync clock.
- interrupts   : DAIF IRQ to use.
- have-fifo-clear : Whether to use fifoclear.
                    fifoclear suppports removing previous playback/capture data.
                    From TCC802x, fifoclear funtion is supported.
- audio-filter   : Whether to use audio filter.
                   From TCC805x, both data and clock audio filter is supported.
- block-type   : Stereo or 7.1 multi-channel selection.
- adma : Audio DMA to use.
- status : disable or enable the device node.

Example
-------
	i2s0: i2s@16101000 {
		compatible = "telechips,i2s";
		reg = <0x0 0x16101000 0x0 0x50>,
		      <0x0 0x16100080 0x0 0x8>;
		clocks = <&clk_peri PERI_MDAI0
		          &clk_io IOBUS_DAI0
				  &clk_peri PERI_MFLT0_DAI>;
		clock-frequency = <48000>;	// Default LRCK
		interrupts = <GIC_SPI 81 IRQ_TYPE_LEVEL_HIGH>;
		have-fifo-clear = <1>;
		audio-filter = <0>;
		// 0: disable, 1: clock only, 2: data only, 3: data and clock
		block-type = <1>;
		// 0: Stereo 1: 7.1CH
		adma = <&adma0>;
		status = "disabled";
	};
```

## Documentation/devicetree/bindings/sound/telechips,spdif.txt
```
* Device Tree Bindings for spdif

Required properties:

- compatible : Property name that conveys the platform architecture identifiers,
               as 'telechips,spdif'
- reg : SPDIF register to use.
- clocks : Peri/IOBUS clock of SPDIF to use.
           In order of SPDIF peri and SPDIF IOBUS clock.
- clock-frequency : Default frame sync clock.
- adma : Audio DMA to use.
- status : disable or enable the device node.

Example
-------
	spdif0: spdif@16102000 {
		compatible = "telechips,spdif";
		reg = <0x0 0x16102000 0x0 0x1000>;
		clocks = <&clk_peri PERI_MSPDIF0 &clk_io IOBUS_SPDIF0>;
		clock-frequency = <44100>;
		adma = <&adma0>;
		status = "disabled";
	};
```

## Documentation/devicetree/bindings/sound/telechips,vir-i2s.txt
```
* Device Tree Bindings for i2s
This driver is only for T-sound SDK.
Required properties:

- compatible : property name that conveys the platform architecture identifiers,
               as 'telechips,vir-i2s'
- status       : disable or enable the device node

Example
-------
	vi2s0: vi2s@0 {
		compatible = "telechips,vir-i2s";
		status = "disabled";
	};

	vi2s1: vi2s@1 {
		compatible = "telechips,vir-i2s";
		status = "disabled";
	};

	vi2s2: vi2s@2 {
		compatible = "telechips,vir-i2s";
		status = "disabled";
	};

	vi2s3: vi2s@3 {
		compatible = "telechips,vir-i2s";
		status = "disabled";
	};
```

## Documentation/devicetree/bindings/spi/spi-dw.txt
```
Synopsys DesignWare SPI master

Required properties:
- compatible: should be "snps,designware-spi"
- #address-cells: see spi-bus.txt
- #size-cells: see spi-bus.txt
- reg: address and length of the spi master registers
- interrupts: should contain one interrupt
- clocks: spi clock phandle
- num-cs: see spi-bus.txt

Optional properties:
- cs-gpios: see spi-bus.txt
- renesas,rzn1-cs-mode: specify software/hardware modes for CS lines.
  This version of the controller has a 'software mode' that allows the
  SPI layer to control the CS line as it sees fit, instead of letting the
  hardware toggle it -- this is necessary for talking to flash chips, eeproms
  etc. The value is a bitfield, with bits corresponds to individual lines, and
  '1' means 'use software CS' and 0 means 'default to hardware mode'.

Example:

spi: spi@4020a000 {
	compatible = "snps,designware-spi";
	interrupts = <11 1>;
	reg = <0x4020a000 0x1000>;
	clocks = <&pclk>;
	num-cs = <2>;
	cs-gpios = <&banka 0 0>;
	renesas,rzn1-cs-mode = <0x3>;
};
```
