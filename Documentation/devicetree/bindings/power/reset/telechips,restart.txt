## Documentation/devicetree/bindings/spi/spi-hi6220.txt
```
Hi6220 SPI controller

Required properties:
- compatible : "arm,pl022", "arm,primecell"
- reg : Offset and length of the register set for the device
- interrupts : Should contain SPI controller interrupt
- num-cs : total number of chipselects

Required Board Specific Properties:

- #address-cells: should be 1.
- #size-cells: should be 0.

Optional properties:
- cs-gpios : should specify GPIOs used for chipselects.
  The gpios will be referred to as reg = <index> in the SPI child nodes.
  If unspecified, a single SPI device without a chip select can be used.
- dmas : Two or more DMA channel specifiers following the convention outlined
         in bindings/dma/dma.txt
- dma-names: Names for the dma channels, if present. There must be at
	     least one channel named "tx" for transmit and named "rx" for
             receive.

Example:
             spi_0: spi@f7106000 {
			compatible = "arm,pl022", "arm,primecell";
			reg = <0x0 0xf7106000 0x0 0x1000>;
			#address-cells = <1>;
			#size-cells = <0>;
			interrupts = <0 50 4>;
			bus-id = <0>;
			enable-dma = <1>;
			dmas =	<&dma0 12 &dma0 13>;
			dma-names = "rx", "tx";

			clocks = <&clock_sys HI6220_SPI_CLK>;
			clock-names = "apb_pclk";
			pinctrl-names = "default";
			pinctrl-0 = <&spi0_pmx_func &spi0_cfg_func>;
			num-cs = <4>;
			cs-gpios = <&gpio6 2 0>, <&gpio6 3 0>, <&gpio6 4 0>, <&gpio6 5 0>;

			status = "ok";
		};
```

## Documentation/devicetree/bindings/spi/spi-tcc.txt
```
Telechips GPSB Controller for SPI Master/Slave

Genral Purpose Serial Bus (GPSB) Controller supports SPI Master / Slave mode
There are 6 GPSB controllers.
3 GPSB controllers (Controller-0/1/2) have 2 buffers (TX FIFO, RX FIFO) with dedicated DMA.
3 GPSB controllers (Controller-3/4/5) have 2 buffers (TX FIFO, RX FIFO) without dedicated DMA.
the following is FIFO size depending on bit width.
- 32-bit x 8-depth
- 16-bit x 16-depth
-  8-bit x 16-dpeth


Required properties:
- compatible	: depending on the SoC this should be one of:
		"telechips,tcc-spi-slave"
		"telechips,tcc-spi"
		"telechips,tcc805x-spi"
		"telechips,tcc803x-spi"
		"telechips,tcc897x-spi"
		"telechips,tcc899x-spi"
		"telechips,tcc901x-spi"
- reg		: Base address and size of the controllers memory area
- interrupts	: Interrupt Specifier
- clocks	: phandle of the GPSB clock
- #address-cells: <1>, as required by generic SPI binding
- #size-cells	: <0>, also as required by generic SPI binding
- pinctrl-names	: Should be "idle","active"
- pinctrl-0	: phandle to pinctrl function in idle state
- pinctrl-1	: phandle to pinctrl function in active state
- gpsb-id	: SPI ID
- gpsb-port	: gpsb port number
Note:
GPIO used for GPSB are named as number. you can find port number in Chip Specification.
the following property is available on gpsb 3 ~ 5, because there are no dedicated-dma.
- dmas		: Must contain a list of two references to DMA specifiers,
		  one for transmission, and one for reception.
- dma-names	: Must contain a list of two DMA names, "tx" and "rx".


Optional properties:
- access-control0/1/2/3	: address filtering
			DMA can access only a region of address.
			If the region of DMA address is out of the range that you set in device tree,
			GPSB Send 0 and cannot read the data.
- spi-slave		: Empty property indicating the SPI controller is used in slave mode.
- prd-enable		: Capture at every even-numbered order edge of SCK.
- sdoe-enable		: SDO is driven only when CS signal tells active.
- write-threshold	: Transmit FIFO threshold for interrupt/DMA request.
- read-threshold	: Receive FIFO threshold for interrupt/DMA request.

Optional properties (master mode only):
- recovery-time		: Increase recovery-time.
- hold-time		: Increase hold-time.
- setup-time		: Increase setup-time.
Note: Please refer the Full/Chip Specification for more detail.
- ctf-mode-disable	: boolean, If the property is exist, GPSB transfer in single mode.
			for more detail in "TCCxxxx Common BSP-User Guide for Driver" Document.
- cs-gpios		: gpios chip select.
- num-cs		: total number of chipselects.

If cs-gpios is used the number of chip selects will be increased automatically
with max(cs-gpios > hw cs).
So if for example the controller has 2 CS lines, and the cs-gpios
property looks like this:
cs-gpios = <&gpg 8 0>,<&gpa 30 0>;

Optional subnodes:
	Subnodes are use to represent the SPI slave devices connected to the SPI
	master. They follow the generic SPI bindings as outlined in spi-bus.txt.


Example:
	/* GPSB Controller 0 - SPI Master */
	gpsb0: gpsb0@16900000 {
		compatible = "telechips,tcc803x-spi";
		reg = <0x16900000 0x38>,   /* base address */
			<0x16960000 0x20>, /* Port Configuration register */
			<0x16980000 0x20>; /* GPSB_0_AC */
		interrupts = <GIC_SPI 55 IRQ_TYPE_LEVEL_HIGH>;
		clocks = <&clk_peri PERI_GPSB0 &clk_io IOBUS_GPSB0>;
		gpsb-id = <0>;

		//access-control0 = <0x20000000 0xC0000000>; /* DRAM */

		status = "okay";
		gpsb-port = <22>;
		pinctrl-names = "idle", "active";
		pinctrl-0 = <&gpsb22_bus_idle>;
		pinctrl-1 = <&gpsb22_bus_spi>;

		/* cs-gpios */
		cs-gpios = <&gpg 8 0>,<&gpa 30 0>;

		spidev@0 {
			compatible = "rohm,dh2228fv";
			reg = <0>;
			spi-max-frequency = <2000000>;
		};
		spidev@1 {
			compatible = "rohm,dh2228fv";
			reg = <1>;
			spi-max-frequency = <2000000>;
		};
	};

	or

	/* GPSB Controller 3 - SPI Slave */
	gpsb3: gpsb3@16930000 {
		compatible = "telechips,spi-slave";
		reg = <0x16930000 0x38 0x16960000 0x20>;
		interrupts = <GIC_SPI 58 IRQ_TYPE_LEVEL_HIGH>;
		clocks = <&clk_peri PERI_GPSBMS0 &clk_io IOBUS_GPSB3>
		#address-cells = <1>;
		#size-cells = <0>;

		/* With DMA-engine */
		dmas = <&dma0 0 3 &dma0 1 9>;
		dma-names = "tx", "rx";

		gpsb-id = <3>;
		pinctrl-names = "idle", "active";
		pinctrl-0 = <&gpsb19_bus_idle>;
		pinctrl-1 = <&gpsb19_bus_spi>;
		gpsb-port = <19>;
		spi-slave;
		slave@0 {
			compatible = "rohm,dh2228fv";
			reg = <0>;
			spi-max-frequency = <20000000>;
		};
	};
```

## Documentation/devicetree/bindings/spi/tcc-gpsb-tsif.txt
```
Telechips GPSB Controller for TSIF(Transport Stream Inteface)

Genral Purpose Serial Bus (GPSB) Controller supports SPI Master / Slave mode
There are 6 GPSB controllers.
3 GPSB controllers (Controller-0/1/2) have 2 buffers (TX FIFO, RX FIFO) with dedicated DMA.
3 GPSB controllers (Controller-3/4/5) have 2 buffers (TX FIFO, RX FIFO) without dedicated DMA.
the following is FIFO size depending on bit width.
- 32-bit x 8-depth
- 16-bit x 16-depth
-  8-bit x 16-dpeth

Required properties:
- compatible	: depending on the SoC this should be one of:
		"telechips,tcc89xx-tsif"
		"telechips,tcc805x-tsif"
		"telechips,tcc803x-tsif"
		"telechips,tcc897x-tsif"
		"telechips,tcc899x-tsif"
		"telechips,tcc901x-tsif"
- reg		: Base address and size of the controllers memory area
- interrupts	: Interrupt Specifier
- clocks	: phandle of the GPSB clock
- #address-cells: Should be <1>
- #size-cells	: Should be <0>
- pinctrl-names	: Should be "idle","active"
- pinctrl-0	: phandle to pinctrl function in idle state
- pinctrl-1	: phandle to pinctrl function in active state
- gpsb-id	: TSIF ID
- gpsb-port	: gpsb port number
Note:
GPIO used for GPSB are named as number. you can find port number in Chip Specification.
the following property is available on gpsb 3 ~ 5, because there are no dedicated-dma.
- dmas		: Must contain a list of two references to DMA specifiers,
		  one for transmission, and one for reception.
- dma-names	: Must contain a list of two DMA names, "tx" and "rx".


Optional properties:
- access-control0/1/2/3	: address filtering
			DMA can access only a region of address.
			If the region of DMA address is out of the range that you set in device tree,
			GPSB Send 0 and cannot read the data.

Example:
	/* GPSB Controller 1 - TSIF */
	gpsb1: gpsb1@16910000 {
		compatible = "telechips,tcc803x-tsif";
		reg = <0x16910000 0x38>, /* base address */
		      <0x16960000 0x20>, /* Port Configuration register */
		      <0x16970000 0x84>, /* PID register */
		      <0x16980020 0x20>; /* GPSB_1_AC */
		interrupts = <GIC_SPI 56 IRQ_TYPE_LEVEL_HIGH>;
		clocks = <&clk_peri PERI_GPSB1 &clk_io IOBUS_GPSB1>;
		gpsb-id = <0>;

		//access-control0 = <0x20000000 0xC0000000>; /* DRAM */
		//access-control1 = <0x00000000 0x00000000>;
		//access-control2 = <0x00000000 0x00000000>;
		//access-control3 = <0x00000000 0x00000000>;

		gpsb-port = <15>;
		pinctrl-names = "idle", "active";
		pinctrl-0 = <&gpsb15_bus_idle>;
		pinctrl-1 = <&gpsb15_bus_tsif>;
		status = "okay";
	};

	/* GPSB Controller 3 - TSIF */
	gpsb3: gpsb3@16930000 {
		compatible = "telechips,tcc803x-tsif";
		reg = <0x16930000 0x38 0x16960000 0x20>;
		interrupts = <GIC_SPI 58 IRQ_TYPE_LEVEL_HIGH>;
		clocks = <&clk_peri PERI_GPSBMS0 &clk_io IOBUS_GPSB3>;
		gpsb-id = <1>;

		// With DMA-engine
		dmas = <&dma0 0 3 &dma0 1 9>;
		dma-names = "tx", "rx";

		gpsb-port = <16>;
		pinctrl-names = "idle", "active";
		pinctrl-0 = <&gpsb16_bus_idle>;
		pinctrl-1 = <&gpsb16_bus_tsif>;
		status = "okay";
	};
```

## Documentation/devicetree/bindings/staging/android/ion/tcc-ion.txt
```
* Telechips Ion driver

Required properties:
- compatible: must be "telechips,tcc-ion"
- reg: id and type of Ion heap
```

## Documentation/devicetree/bindings/staging/android/ion/telechips,tcc-ion.txt
```
Device Tree ION bindings for tcc-ion

Required properties:
- compatible: shall be "telechips,tcc-ion"
- telechips,ion-heap-name: shall be the corresponding names of the heap
```

## Documentation/devicetree/bindings/telechips/adma.txt
```
* Device Tree Bindings for adma

Required properties:

- compatible   :
- reg             :
- clocks         :
- interrupts     :
- have-hopcnt-clear :
- adrcnt-mode :

Example
-------
	adma0: adma@16100000 {
		compatible = "telechips,adma";
		reg = <0x0 0x16100000 0x0 0x200>;
		clocks = <&clk_io IOBUS_ADMA0>;
		interrupts = <GIC_SPI 80 IRQ_TYPE_LEVEL_HIGH>;
		have-hopcnt-clear = <1>;
		adrcnt-mode = <1>;
	};
```

## Documentation/devicetree/bindings/telechips/ar0147.txt
```
* Device Tree Bindings for AR0147 (ISP-less camera module)

AR0147 is camera image sensor which has no inner-ISP. Basically, it is disabled
by default for Telechips EVB.

Required properties:

- status     : disable or enable the device node
- compatible : property name that conveys the platform architecture identifiers,
               as 'onnn,ar0147'
- reg        : I2C slave address
- port       : specifies the endpoint of the sensor (output only)

example
-------
	ar0147: ar0147 {
		status		= "disabled";
		compatible	= "onnn,ar0147";
		reg		= <0x10>;
		port {
			ar0147_out: endpoint {
				remote-endpoint = <&max96701_in>;
				io-direction	= "output";
			};
		};
	};
```

## Documentation/devicetree/bindings/telechips/asrc-card.txt
```
* Device Tree Bindings for asrc-card

Required properties:

- compatible : property name that conveys the platform architecture identifiers,
               as 'telechips,switch'
- card-name       : 
- status          : disable or enable the device node
- asrc            : 
- codec, dai-name : 
- i2s             : 
- codec           :  
- codec,dai-name  : 
- asrc-jm2p-pairs : 
- asrc-p2m-pairs  :
- mclk_div        :
- bclk_ratio      :
- samplerate      : default samplerate
- format          : default format
- channels        : default chnnels

Example
-------
	sound@0 {
		compatible = "telechips,asrc-card";
		card-name = "TCC805x EVM Card";
		status = "okay";

		asrc = <&asrc0>;

		telechips,dai-link@0 {
			codec,format = "i2s";

			i2s = <&i2s0>;
			codec = <&ak4601>;
			codec,dai-name = "ak4601-aif1";

			asrc-m2p-pairs = <0 1 2>;
			asrc-p2m-pairs = <3>;

			mclk_div = <16>; // 4,6,8,16
			bclk_ratio = <64>; // 32,48,64fs
			samplerate = <48000>;
			format = <0>; // 0:S16LE, 1:S24LE
			channels = <2>; //2, 4, 6, 8
		};
	};
```

## Documentation/devicetree/bindings/telechips/asrc.txt
```
* Device Tree Bindings for asrc

Required properties:

- compatible : property name that conveys the platform architecture identifiers,
               as 'telechips,switch'
- reg        :
- interrupts :
- clocks     :
- clock-name :
- dma        :
- mcaudio    :
- max-ch-per-pair :
- path-type  :
- sync-mode  :
- async-refclk :
- status     :

Example
-------
	asrc0: asrc@16500000 {
		compatible = "telechips,asrc";
		reg = <0x0 0x16500000 0x0 0x1000>;
		interrupts = <GIC_SPI 98 IRQ_TYPE_LEVEL_HIGH>;
		clocks = <&clk_peri PERI_AUX0_INPUT &clk_peri PERI_AUX1_INPUT &clk_peri PERI_AUX0_OUTPUT &clk_peri PERI_AUX1_OUTPUT &clk_io IOBUS_ASRC>;
		clock-names = "aux_in0", "aux_in1", "aux_out0", "aux_out1", "asrc_hclk";
		dma = <&pl080_0>;
		mcaudio = <&i2s0 &i2s4 &i2s5 &i2s6>;
		max-ch-per-pair= <8 2 2 2>;
		path-type = <0 0 0 0>; // 0:m2m, 1:m2p, 2:p2m
		sync-mode = <1 1 1 1>; // 0:async, 1:sync
		async-refclk = <99 99 99 99>; //0:DAI0_LRCK, 1:DAI1_LRCK, 2:DAI2_LRCK, 3:DAI3_LRCK, 99:AUXCLK
		status = "disabled";
	};
```
