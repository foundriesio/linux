## Documentation/devicetree/bindings/media/platform/tcc-hwdemux/hwdmx-core/hwdmx_test.txt
```
Hardware demux test

Required properies:
	-compatible:
		"telechips,hwdemux_test"

Optional properties:

Examples:
	tcc_hwdemux_test {
                 compatible = "telechips,hwdemux_test";
        };
```

## Documentation/devicetree/bindings/media/platform/tcc-hwdemux/hwdmx-drv/hwdmx.txt
```
Hardware Demux Driver for TSIF

Required properties:
	-compatible:
		"telechips,tcc89xx-hwdmx-tsif"
		"telechips,tcc90xx-hwdmx-tsif"

Optional properties:
	-tsif-id:
		tsif index (max:2)
	-tsif-port:
		tsif port number
	-pinctrl-names:
		pinctrl name for status
	-pinctrl-0:
		setting of idle for pinctrl for tsif data/valid/clock/sync
	-pinctrl-1:
		setting of active for pinctrl for tsif data/valid/clock/sync
	-clocks:
		tsif clock for peri_tsrx
	-clock-names:
		tsif clock name

Example:
	tcc_hwdmx_tsif@0 {
                compatible = "telechips,tcc89xx-hwdmx-tsif";
                tsif-id = <0>;
                tsif-port = <0>;
                pinctrl-names = "idle", "active";
                pinctrl-0 = <&ts0_idle>;
                pinctrl-1 = <&ts0_active>;
                clocks = <&clk_peri PERI_TSRX0>;
                clock-names = "tsrx0";
        };

        tcc_hwdmx_tsif@1 {
                compatible = "telechips,tcc89xx-hwdmx-tsif";
                tsif-id = <1>;
                tsif-port = <1>;
                pinctrl-names = "idle", "active";
                pinctrl-0 = <&ts1_idle>;
                pinctrl-1 = <&ts1_active>;
                clocks = <&clk_peri PERI_TSRX1>;
                clock-names = "tsrx1";
        };
```

## Documentation/devicetree/bindings/media/platform/tcc-hwdemux/isdbt-ctrl/tcc_isdbt_control.txt
```
TCC ISDBT Broadcasting Control(Power, Reset..)

Required properties:
	-compatible:
		"telechips,tcc_isdbt_ctrl"

Optional properties:
	-pw-gpios:
		gpio port for all tuner power control

	-dxb0-gpios:
		gpio port for reset/power_down of TCC353X 1st device

	-dxb1-gpios:
		gpio port for reset/power_down of TCC353X 2nd device

	-ant-gpios:
		gpio port for antenna power

Example:
	tcc_isdbt_ctrl {
                compatible = "telechips,tcc_isdbt_ctrl";
                pw-gpios = <&gpa 23 0>;
                dxb0-gpios = <&gpa 22 0>, <&gpa 21 0>, <0>, <0>;
                dxb1-gpios = <&gpa 31 0>, <&gpa 25 0>, <0>, <0>;
                ant-gpios = <0>, <0>;
        };
```

## Documentation/devicetree/bindings/media/platform/tcc-hwdemux/tcc-demux/tcc-demux-core/tca_hwdemux_tsif.txt
```
Hardware demux core for TCC897X

Required properies:
        -compatible:
                "telechips,hwdemux"

Optional properties:
        -status:
                hwdemux device status
	-clocks:
		clock for cmbus

Examples:
	hwdemux: cm_bus {
                compatible = "telechips,hwdemux";
                status = "okay";
                clocks = <&clk_fbus FBUS_CMBUS>,
                       <&clk_peri PERI_CMBUS_TSIF0>,
                       <&clk_peri PERI_CMBUS_TSIF1>,
                       <&clk_peri PERI_CMBUS_TSIF2>,
                       <&clk_peri PERI_CMBUS_TSIF3>;
        };
```

## Documentation/devicetree/bindings/media/platform/tcc-hwdemux/tcc-demux/tcc-demux-drv/tcc_dxb_kernel.txt
```
LinuxTV driver Module

Required properties:
	-compatible:
		"telechips,tcc_dxb_drv"
		"telechips,tcc_dxb_drv,TS0"
		"telechips,tcc_dxb_drv,TS1"
		"telechips,tcc_dxb_drv,TS2"
		"telechips,tcc_dxb_drv,TS3"
		"telechips,tcc_dxb_drv,TS4"
		"telechips,tcc_dxb_drv,TS5"
		"telechips,tcc_dxb_drv,TS6"
		"telechips,tcc_dxb_drv,TS7"


Optional properties:

Example:
	tcc_dxb_drv {
                compatible = "telechips,tcc_dxb_drv";
        };
```
