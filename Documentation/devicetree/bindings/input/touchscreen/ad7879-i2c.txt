## Documentation/devicetree/bindings/input/touchscreen/ad7879-i2c.txt
```
* Analog Devices AD7879-1/AD7889-1 touchscreen interface (I2C)

Required properties:
- compatible: must be "adi,ad7879-1"
- reg: i2c slave address
- interrupt-parent: the phandle for the interrupt controller
- interrupts: touch controller interrupt
- resistance-plate-x		: total resistance of X-plate (for pressure
				  calculation)
- touchscreen-min-pressure	: pressure threshold value
- touchscreen-max-pressure	: maximum reported pressure
- touchscreen-swapped-x-y	: X and Y axis are swapped (boolean)
				  Swapping is done after inverting the axis
Optional properties:
- first-conversion-delay	: 0-12 in 128us steps (starting with 128us)
				  13: 2.560ms
				  14: 3.584ms
				  15: 4.096ms
- acquisition-time		: 0: 2us
				  1: 4us
				  2: 8us
				  3: 16us
- median-filter-size		: 0: disabled
				  1: 4 measurements
				  2: 8 measurements
				  3: 16 measurements
- averaging			: 0: 2 middle values (1 if median disabled)
				  1: 4 middle values
				  2: 8 middle values
				  3: 16 values
- conversion-interval:		: 0: convert one time only
				  1-255: 515us + val * 35us (up to 9.440ms)

Example:

	ad7879@2c {
		compatible = "adi,ad7879-1";
		reg = <0x2c>;
		interrupt-parent = <&gpio1>;
		interrupts = <13 IRQ_TYPE_EDGE_FALLING>;
		resistance-plate-x = <120>;
		touchscreen-min-pressure = <0>;
		touchscreen-max-pressure = <4096>;
		first-conversion-delay = /bits/ 8 <3>;
		acquisition-time = /bits/ 8 <1>;
		median-filter-size = /bits/ 8 <2>;
		averaging = /bits/ 8 <1>;
		conversion-interval = /bits/ 8 <255>;
	};
```

## Documentation/devicetree/bindings/input/touchscreen/colibri-vf50-ts.txt
```
* Toradex Colibri VF50 Touchscreen driver

Required Properties:
- compatible must be toradex,vf50-touchctrl
- io-channels: adc channels being used by the Colibri VF50 module
- xp-gpios: FET gate driver for input of X+
- xm-gpios: FET gate driver for input of X-
- yp-gpios: FET gate driver for input of Y+
- ym-gpios: FET gate driver for input of Y-
- pen-detect-gpios: GPIO for pen detect irq
- pen-pullup-gpios: GPIO for pen pullup
- pinctrl-names: "idle", "default", "gpios"
- pinctrl-0: pinctrl node for idle state gpio pinmux
- pinctrl-1: pinctrl node for touch detection state pinmux
- pinctrl-2: pinctrl node for gpios functioning as FET gate drivers

Example:

	touchctrl: vf50_touchctrl {
		compatible = "toradex,vf50-touchctrl";
		io-channels = <&adc1 0>,<&adc0 0>,
				<&adc0 1>,<&adc1 2>;
		xp-gpios = <&gpio0 13 GPIO_ACTIVE_LOW>;
		xm-gpios = <&gpio2 29 GPIO_ACTIVE_HIGH>;
		yp-gpios = <&gpio0 12 GPIO_ACTIVE_LOW>;
		ym-gpios = <&gpio0 4 GPIO_ACTIVE_HIGH>;
		pen-detect-gpios = <&gpio0 8 GPIO_ACTIVE_HIGH>;
		pen-pullup-gpios = <&gpio0 9 GPIO_ACTIVE_HIGH>;
		pinctrl-names = "idle","default","gpios";
		pinctrl-0 = <&pinctrl_touchctrl_idle>;
		pinctrl-1 = <&pinctrl_touchctrl_default>;
		pinctrl-2 = <&pinctrl_touchctrl_gpios>;
		status = "disabled";
	};
```

## Documentation/devicetree/bindings/input/touchscreen/fusion_F0710A.txt
```
* TouchRevolution Fusion 7" and 10" multi-touch controller

Required properties:
- compatible: must be "touchrevolution,fusion-f0710a"
- reg: I2C address of the chip
- gpios: The interrupt and reset GPIO's.(see GPIO binding[1] for more details)

[1]: Documentation/devicetree/bindings/gpio/gpio.txt

Example:
	&i2c1 {
		status = "okay";

		pcap@10 {
			compatible = "touchrevolution,fusion-f0710a";
			reg = <0x10>;
			gpios = <&gpio6 10 0
				 &gpio6  9 0
				>;
		};

		/* ... */
	};
```

## Documentation/devicetree/bindings/input/touchscreen/tcc-tsc-serdes.txt
```
Maxim Serializer/Deserializer for setting Touch of Telechips EVB

Using Maxim Device:
max96751, max96851, max96878

Required properties:
- compatible	: Should be "telechips,tcc803x-tsc-serdes"
- reg		: Device address

Example:
		tsc_serdes {
			compatible = "telechips,tcc803x-tsc-serdes";
			reg = <0x6A>;
		};
```

## Documentation/devicetree/bindings/interrupt-controller/csky,mpintc.txt
```
===========================================
C-SKY Multi-processors Interrupt Controller
===========================================

C-SKY Multi-processors Interrupt Controller is designed for ck807/ck810/ck860
SMP soc, and it also could be used in non-SMP system.

Interrupt number definition:
  0-15  : software irq, and we use 15 as our IPI_IRQ.
 16-31  : private  irq, and we use 16 as the co-processor timer.
 31-1024: common irq for soc ip.

Interrupt triger mode:
 IRQ_TYPE_LEVEL_HIGH (default)
 IRQ_TYPE_LEVEL_LOW
 IRQ_TYPE_EDGE_RISING
 IRQ_TYPE_EDGE_FALLING

Interrupt priority range: 0-255

=============================
intc node bindings definition
=============================

	Description: Describes SMP interrupt controller

	PROPERTIES

	- compatible
		Usage: required
		Value type: <string>
		Definition: must be "csky,mpintc"
	- #interrupt-cells
		Usage: required
		Value type: <u32>
		Definition: <3>
	- interrupt-controller:
		Usage: required

Examples: ("interrupts = <irq_num IRQ_TYPE_XXX priority>")
---------

	intc: interrupt-controller {
		compatible = "csky,mpintc";
		#interrupt-cells = <3>;
		interrupt-controller;
	};

	device: device-example {
		...
		interrupts = <34 IRQ_TYPE_EDGE_RISING 254>;
		interrupt-parent = <&intc>;
	};
```

## Documentation/devicetree/bindings/mailbox/mailbox-tcc-sc.txt
```
Telechips Mailbox device for TCC805x Storage Core

Required properties:
- compatible: Should be "telechips,mailbox-tcc-sc"
- reg: Specifices base physical address and size of the registers
- interrupt: The interrupt numbers of Rx and Tx-done
- #mbox-cells: Must be at least 1. Number of cells in a mailbox

Optional properties:
N/A

Examples:
a72_sc_mbox: mbox@0x1D200000 {
    status = "okay";
    compatible = "telechips,tcc805x-mailbox-sc";
    reg = <0x0 0x1D200000 0x0 0x80>;
    interrupts = <GIC_SPI 319 IRQ_TYPE_LEVEL_HIGH>,
               <GIC_SPI 329 IRQ_TYPE_LEVEL_HIGH>;
    #mbox-cells = <1>;
};

tcc_sc_fw: tcc_sc_fw {
    compatible = "telechips,tcc805x-sc-fw";
	status = "okay";
	mboxes = <&a72_sc_mbox 0>;
};
```

## Documentation/devicetree/bindings/mailbox/tcc-hlc-mailbox.txt
```
Telechips Mailbox device for Hypervisor Less Communication

Required properties:
- compatible: Should be "telechips,hlc-mbox"
- device-name : the name of the device
- mbox-name: Should be "hlc-mbox-a53"
- mboxes : specifies the channel for the mailbox (IPC)

Optional properties:
N/A

Examples:

hlc_mbox2: hlc_mbox@0 {
    compatible = "telechips,hlc-mbox";
    device-name = "hlc-mbox-dev-a53";
    mbox-names ="hlc-mbox-a53";
    mboxes = <&mbox0 TCC_MBOX0_CH_HLC>;
};
```

## Documentation/devicetree/bindings/mailbox/tcc803x_multi_mailbox/tcc_multi_mbox.txt
```
Telechips Mailbox device for TCC803x

Required properties:
- compatible:
	telechips,multichannel-mailbox

- reg:
	start address of mailbox

- interrupts:
	interrupt number of mailbox
	<Rx interrupt number>

- #mbox-cells: Must be at least 1. Number of cells in a mailbox
	specifier.
- max-channel:
	number of mailbox channel

Example:
	mbox1: mbox@0x17A00000 {
		compatible = "telechips,multichannel-mailbox";
		reg = <0x17A00000 0x100>;
		interrupts = <GIC_SPI 188 IRQ_TYPE_LEVEL_HIGH>;
		#mbox-cells = <1>;
		max-channel = <TCC_MBOX1_CH_MAX>;
```

## Documentation/devicetree/bindings/mailbox/tcc805x_multi_mailbox/tcc_multi_mbox.txt
```
Telechips Mailbox device for TCC805x

Required properties:
- compatible:
	telechips,multichannel-mailbox

- reg:
	start address of mailbox

- interrupts:
	interrupt number of mailbox
	<Rx interrupt number> <TX done interrupt number>

- #mbox-cells: Must be at least 1. Number of cells in a mailbox
	specifier.
- max-channel:
	number of mailbox channel

Example:

	micom_mbox: mbox@0x1BA10000 {
		compatible = "telechips,multichannel-mailbox";
		reg = <0x0 0x1BA10000 0x0 0x100>;
		interrupts = <GIC_SPI 440 IRQ_TYPE_LEVEL_HIGH>,
				   <GIC_SPI 441 IRQ_TYPE_LEVEL_HIGH>;
		#mbox-cells = <1>;
		max-channel = <TCC_MICOM_MBOX0_MAX>;
	};
```

## Documentation/devicetree/bindings/mailbox/tcc805x_multi_mailbox/tcc_multi_mbox_test.txt
```
Telechips Mailbox test device for TCC805x

Required properties:
- compatible:
	telechips,mbox-test

- device-name: device name

- mbox-names: List of identifier strings for each mailbox channel.

- mboxes: List of phandle and mailbox channel specifiers.

- mbox-id: TCC_MBOX_TEST_ID

Example:

	mbox_test0: mbox_test0 {
		compatible = "telechips,mbox_test";
		device-name = "micom_mbox_test";
		mbox-names ="mbox_test";
		mboxes = <&micom_mbox TCC_MICOM_MBOX0_TEST>;
		mbox-id = TCC_MBOX_TEST_ID;
	};
```

## Documentation/devicetree/bindings/mailbox/tcc_sec_ipc.txt
```
This is for "Telechips sec-ipc device"

Required properties:
	- compatible:
		- CORE <-> M4: telechips,sec-ipc-m4
		- CORE <-> HSM: telechips,sec-ipc-hsm
		- CORE <-> A7: telechips,sec-ipc-a7
		- CORE <-> A53: telechips,sec-ipc-a53
		- CORE <-> A72: telechips,sec-ipc-a72
		- CORE <-> R5: telechips,sec-ipc-r5
	-reg:
		Specifies base physical address and size of the registers map.

Optional properties:
	-tcc multi mbox:
		Telechips Mailbox device Telechips Mailbox device
		This device file must be enable to use sec_ipc.
		For more information for , see
		“Documentation/devicetree/bindings/mailbox/tcc805x_multi_mailbox/tcc_multi_mbox.txt”
		in kernel directory.

Example:

	sec-ipc-hsm {
		compatible = "telechips,sec-ipc-hsm";
		mbox-names = "sec-ipc-hsm";
		mboxes = <&hsm_mbox TCC_HSM_MBOX0>;
		mbox-id = TCC_MBOX_HSM_ID;
	};
```

## Documentation/devicetree/bindings/mailbox/tcc_sp_ipc.txt
```
This is for "Telechips sp-ipc device"

Required properties:
	- compatible:
		- CORE <-> M4(SP): telechips,sp
	-reg:
		Specifies base physical address and size of the registers map.

Optional properties:
	- mailbox-tcc:
		Telechips Mailbox device Telechips Mailbox device
		This device file must be enable to use sp_ipc.

Example:

	sec-ipc-m4 {
		compatible = "telechips,sec-ipc-m4";
		mbox-names = "sec-ipc-m4";
		mboxes = <&sec_ipc 0>;
		mbox-id = TCC_MBOX_HSM_ID;
	};
```

## Documentation/devicetree/bindings/media/i2c/ar0144.txt
```
* Device Tree Bindings for AR0144 (ISP-less camera module)

AR0144 is camera image sensor which outputs only IR data. 
Basically, it is disabled by default for Telechips EVB.

Required properties:

- status     : disable or enable the device node
- compatible : property name that conveys the platform architecture identifiers,
               as 'onnn,ar0144'
- reg        : I2C slave address
- port       : specifies the endpoint of the sensor (output only)

example
-------
	ar0144: ar0144 {
		status		= "disabled";
		compatible	= "onnn,ar0144";
		reg		= <0x10>;
		port {
			ar0144_out: endpoint {
				remote-endpoint = <&max96701_in>;
				io-direction	= "output";
			};
		};
	};
```

## Documentation/devicetree/bindings/media/i2c/ar0820.txt
```
* Device Tree Bindings for AR0820

AR0820 is camera image sensor. 
Basically, it is disabled by default for Telechips EVB.

Required properties:

- status     : disable or enable the device node
- compatible : property name that conveys the platform architecture identifiers,
               as 'onnn,ar0820'
- reg        : I2C slave address
- port       : specifies the endpoint of the sensor (output only)

example
-------
	ar0820: ar0820 {
		status		= "disabled";
		compatible	= "onnn,ar0820";
		reg		= <0x10>;
		port {
			ar0820_out: endpoint {
				remote-endpoint = <&max9295_in>;
				io-direction	= "output";
			};
		};
	};
```

## Documentation/devicetree/bindings/media/i2c/arxxxx.txt
```
* Device Tree Bindings for ARXXXX (ISP-less camera module)

ARXXXX is camera image sensor which has no inner-ISP. Basically, it is disabled
by default for Telechips EVB.

Required properties:

- status     : disable or enable the device node
- compatible : property name that conveys the platform architecture identifiers,
               as 'onnn,arxxxx'
- reg        : I2C slave address
- port       : specifies the endpoint of the sensor (output only)

example
-------
	arxxxx: arxxxx {
		status		= "disabled";
		compatible	= "onnn,arxxxx";
		reg		= <0x50>;
		port {
			arxxxx_out: endpoint {
				remote-endpoint = <&max96701_in>;
				io-direction	= "output";
			};
		};
	};
```

## Documentation/devicetree/bindings/media/i2c/isl79988.txt
```
* Device Tree Bindings for ISL79988 (Embedded Video Decoder)

ISL79988 is video decoder used in Telechips EVB.

Required properties:

- status     : disable or enable the device node
- compatible : property name that conveys the platform architecture identifiers,
               as 'intersil,isl79988'
- reg        : I2C slave address
- cifport    : specifies CIF port
- rst-gpios  : specifies reset pin number
- port       : specifies the endpoint of the sensor

example
-------
	isl79988: isl79988 {
		status		= "okay";
		compatible	= "intersil,isl79988";
		pinctrl-names	= "default";
		pinctrl-0	= <&cam0_clk &cam0_data_8bit>;
		cifport		= <0>;
		rst-gpios	= <&gpb 14 0>;
		reg		= <0x44>;	// 0x88 >> 1
		port {
			isl79988_out: endpoint {
				remote-endpoint = <&videoinput0_in>;
				io-direction	= "output";
				bus-width	= <8>;
			};
		};
	};
```

## Documentation/devicetree/bindings/media/i2c/max9275.txt
```
* Device Tree Bindings for MAX9275

Required properties:

- status     : disable or enable the device node
- compatible : property name that conveys the platform architecture identifiers,
               as 'maxim,max9275'
- reg        : I2C slave address
- port       : specifies the endpoint of the sensor

example
-------
	max9275: max9275 {
		/* serializer */
		status		= "disabled";
		compatible	= "maxim,max9275";
		reg		= <0x40>;
		ports {
			#address-cells = <1>;
			#size-cells = <0>;
			port@0 {
				reg = <0>;
				max9275_in: endpoint {
					remote-endpoint = <&cxd5700_out>;
					io-direction	= "input";
				};
			};
			port@1 {
				reg = <1>;
				max9275_out: endpoint {
					remote-endpoint = <&max96712_in0>;
					io-direction	= "output";
				};
			};
		};
	};
```

## Documentation/devicetree/bindings/media/i2c/max9295.txt
```
* Device Tree Bindings for MAX9295

Required properties:

- status     : disable or enable the device node
- compatible : property name that conveys the platform architecture identifiers,
               as 'maxim,max9295'
- reg        : I2C slave address
- port       : specifies the endpoint of the sensor

example
-------
	max9295: max9295 {
		/* serializer */
		status		= "okay";
		compatible	= "maxim,max9295";
		reg		= <0x62>;
		ports {
			#address-cells = <1>;
			#size-cells = <0>;
			port@0 {
				reg = <0>;
				max9295_in: endpoint {
					remote-endpoint = <&ar0820_out>;
					io-direction	= "input";
				};
			};
			port@1 {
				reg = <1>;
				max9295_out: endpoint {
					remote-endpoint = <&max96712_in0>;
					io-direction	= "output";
				};
			};
		};
	};
```

## Documentation/devicetree/bindings/media/i2c/max96705.txt
```
* Device Tree Bindings for MAX96705

Required properties:

- status     : disable or enable the device node
- compatible : property name that conveys the platform architecture identifiers,
               as 'maxim,max96705'
- reg        : I2C slave address
- port       : specifies the endpoint of the sensor

example
-------
	max96705: max96705 {
		/* serializer */
		status		= "okay";
		compatible	= "maxim,max96705";
		reg		= <0x40>;
		ports {
			#address-cells = <1>;
			#size-cells = <0>;
			port@0 {
				reg = <0>;
				max96705_in: endpoint {
					remote-endpoint = <&ar0144_out>;
					io-direction	= "input";
				};
			};
			port@1 {
				reg = <1>;
				max96705_out: endpoint {
					remote-endpoint = <&max96712_in0>;
					io-direction	= "output";
				};
			};
		};
	};
```

## Documentation/devicetree/bindings/media/platform/tcc-hwdemux/hwdmx-core/hwdmx_core.txt
```
Hardware demux core

Required properies:
	-compatible:
		"telechips,hwdemux"

Optional properties:
	-status:
		hwdemux device status

Examples:
	hwdemux: cm_bus@19000000 {
                 compatible = "telechips,hwdemux";
                 status = "okay";
        };
```
