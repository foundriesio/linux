## Documentation/devicetree/bindings/gpu/panel-tcc-dpv14.txt
```
This is for 'telechips,drm-lvds-dpv14-X'.

Required properties for display:
	-compatible:
		"telechips,drm-lvds-dpv14-0"
		"telechips,drm-lvds-dpv14-1"
		"telechips,drm-lvds-dpv14-2"
		"telechips,drm-lvds-dpv14-3"

-------------------------------------------------------------------------------

Example:

		drm_dpv14_0:drm_dpv14_0 {
		#address-cells = <1>;
		#size-cells = <0>;
		compatible = "telechips,drm-lvds-dpv14-0";
		status = "okay";

		lcdc-mux-select = <0>;

		display-timings {
			native-mode = <&timing_dpv14_0>;
			timing_dpv14_0: 1920x720p60 {
				clock-frequency = <88200000>;
				hactive = <1920>;
				vactive = <720>;
				hfront-porch = <30>;
				hback-porch = <30>;
				hsync-len = <4>;
				hsync-active = <0>;
				vback-porch = <9>;
				vfront-porch = <10>;
				vsync-len = <2>;
				vsync-active = <0>;
				de-active = <1>;
				pixelclk-active = <1>;
			};
		};
		port@0 {
			reg = <0>;
			dpv14_0_input_0: endpoint {
				remote-endpoint = <&lcd_display_out>;
			};
		};
		port@1 {
			reg = <1>;
			dpv14_0_input_1: endpoint {
				remote-endpoint = <&ext_display_out>;
			};
		};
		port@2 {
			reg = <2>;
			dpv14_0_input_2: endpoint {
				remote-endpoint = <&third_display_out>;
			};
		};
		port@3 {
			reg = <3>;
			dpv14_0_input_3: endpoint {
				remote-endpoint = <&fourth_display_out>;
			};
		};
	};

	drm_dpv14_1:drm_dpv14_1 {
		#address-cells = <1>;
		#size-cells = <0>;
		compatible = "telechips,drm-lvds-dpv14-1";
		status = "okay";

		lcdc-mux-select = <1>;

		display-timings {
			native-mode = <&timing_dpv14_1>;
			timing_dpv14_1: 1920x720p60 {
				clock-frequency = <88200000>;
				hactive = <1920>;
				vactive = <720>;
				hfront-porch = <30>;
				hback-porch = <30>;
				hsync-len = <4>;
				hsync-active = <0>;
				vback-porch = <9>;
				vfront-porch = <10>;
				vsync-len = <2>;
				vsync-active = <0>;
				de-active = <1>;
				pixelclk-active = <1>;
			};
		};
		port@0 {
			reg = <0>;
			dpv14_1_input_0: endpoint {
				remote-endpoint = <&lcd_display_out>;
			};
		};
		port@1 {
			reg = <1>;
			dpv14_1_input_1: endpoint {
				remote-endpoint = <&ext_display_out>;
			};
		};
		port@2 {
			reg = <2>;
			dpv14_1_input_2: endpoint {
				remote-endpoint = <&third_display_out>;
			};
		};
		port@3 {
			reg = <3>;
			dpv14_1_input_3: endpoint {
				remote-endpoint = <&fourth_display_out>;
			};
		};
	};
```

## Documentation/devicetree/bindings/gpu/panel-tcc-lvds.txt
```
This is for Telechips lvds panel driver.

Required properties for display:
	-compatible:
		"telechips,drm-lvds-fld0800"
		"telechips,drm-lvds-tm123xdhp90"

-------------------------------------------------------------------------------

Example:
	drm_tm123xdhp90:drm_tm123xdhp90 {
		#address-cells = <1>;
		#size-cells = <0>;
		compatible = "telechips,drm-lvds-tm123xdhp90";
		status = "disabled";
		lvds0 = <&lvds_phy>;

		mode = <LVDS_DUAL>;   /* 0: single 1: dual */
		phy-ports = <PHY_PORT_D0 PHY_PORT_D1>; /*port main, port sub*/
		lcdc-mux-select = <2>;
		data-mapping = "vesa-24";
		lane-main = <DATA3_LANE CLK_LANE DATA2_LANE DATA1_LANE DATA0_LANE>;
		lane-sub = <DATA0_LANE DATA1_LANE DATA2_LANE CLK_LANE DATA3_LANE>;
		vcm = <1200>;
		vsw = <500>;

		display-timings {
			native-mode = <&timing_tm123xdhp90>;
			timing_tm123xdhp90: 1920x720p60 {
				clock-frequency = <88200000>;
				hactive = <1920>;
				vactive = <720>;
				hfront-porch = <28>;
				hback-porch = <28>;
				hsync-len = <8>;
				hsync-active = <0>;
				vback-porch = <10>;
				vfront-porch = <10>;
				vsync-len = <2>;
				vsync-active = <0>;
				de-active = <1>;
				pixelclk-active = <1>;
			};
		};
		port@0 {
			reg = <0>;
			tm123xdhp90_input_0: endpoint {
				remote-endpoint = <&lcd_display_out>;
			};
		};
		port@1 {
			reg = <1>;
			tm123xdhp90_input_1: endpoint {
				remote-endpoint = <&ext_display_out>;
			};
		};
		port@2 {
			reg = <2>;
			tm123xdhp90_input_2: endpoint {
				remote-endpoint = <&third_display_out>;
			};
		};
		port@3 {
			reg = <3>;
			tm123xdhp90_input_3: endpoint {
				remote-endpoint = <&fourth_display_out>;
			};
		};
	};

	drm_fld0800:drm_fld0800 {
		#address-cells = <1>;
		#size-cells = <0>;
		compatible = "telechips,drm-lvds-fld0800";
		status = "disabled";
		lvds0 = <&lvds_phy>;

		mode = <LVDS_SINGLE>;   /* 0: single 1: dual */
		phy-ports = <PHY_PORT_S0>; /*port main, port sub*/
		lcdc-mux-select = <3>;
		data-mapping = "vesa-24";
		lane-main = <DATA0_LANE DATA1_LANE DATA2_LANE CLK_LANE DATA3_LANE>;
		vcm = <1200>;
		vsw = <400>;
		display-timings {
			native-mode = <&timing_fld0800>;
			timing_fld0800: 1024x600p60 {
				clock-frequency = <51200000>;
				hactive = <1024>;
				vactive = <600>;
				hfront-porch = <147>;
				hback-porch = <147>;
				hsync-len = <19>;
				hsync-active = <0>;
				vback-porch = <10>;
				vfront-porch = <25>;
				vsync-len = <2>;
				vsync-active = <0>;
				de-active = <1>;
				pixelclk-active = <1>;
			};
		};
		port@0 {
			reg = <0>;
			fld0800_input_0: endpoint {
				remote-endpoint = <&lcd_display_out>;
			};
		};
		port@1 {
			reg = <1>;
			fld0800_input_1: endpoint {
				remote-endpoint = <&ext_display_out>;
			};
		};
		port@2 {
			reg = <2>;
			fld0800_input_2: endpoint {
				remote-endpoint = <&third_display_out>;
			};
		};
		port@3 {
			reg = <3>;
			fld0800_input_3: endpoint {
				remote-endpoint = <&fourth_display_out>;
			};
		};
	};
```

## Documentation/devicetree/bindings/hwmon/sht3x.txt
```
Sensirion SHT3x Humidity and Temperature Sensor

Required node properties:
- compatible: "sensirion,sht3x" or "sensirion,sts3x"
- reg: I2C bus address of the device

Optional properties:
- sensirion,blocking-io: enable blocking mode on i2c
- sensirion,no-high-precision: disable high accuracy

Example sht3x node:

sensor {
	compatible = "sensirion,sht3x";
	reg = <0x4a>;
}
```

## Documentation/devicetree/bindings/i2c/i2c-imx.txt
```
* Freescale Inter IC (I2C) and High Speed Inter IC (HS-I2C) for i.MX

Required properties:
- compatible :
  - "fsl,imx1-i2c" for I2C compatible with the one integrated on i.MX1 SoC
  - "fsl,imx21-i2c" for I2C compatible with the one integrated on i.MX21 SoC
  - "fsl,vf610-i2c" for I2C compatible with the one integrated on Vybrid vf610 SoC
- reg : Should contain I2C/HS-I2C registers location and length
- interrupts : Should contain I2C/HS-I2C interrupt
- clocks : Should contain the I2C/HS-I2C clock specifier

Optional properties:
- clock-frequency : Constains desired I2C/HS-I2C bus clock frequency in Hz.
  The absence of the propoerty indicates the default frequency 100 kHz.
- dmas: A list of two dma specifiers, one for each entry in dma-names.
- dma-names: should contain "tx" and "rx".

Examples:

i2c@83fc4000 { /* I2C2 on i.MX51 */
	compatible = "fsl,imx51-i2c", "fsl,imx21-i2c";
	reg = <0x83fc4000 0x4000>;
	interrupts = <63>;
};

i2c@70038000 { /* HS-I2C on i.MX51 */
	compatible = "fsl,imx51-i2c", "fsl,imx21-i2c";
	reg = <0x70038000 0x4000>;
	interrupts = <64>;
	clock-frequency = <400000>;
};

i2c0: i2c@40066000 { /* i2c0 on vf610 */
	compatible = "fsl,vf610-i2c";
	reg = <0x40066000 0x1000>;
	interrupts =<0 71 0x04>;
	dmas = <&edma0 0 50>,
		<&edma0 0 51>;
	dma-names = "rx","tx";
};

The driver can provide recovery functionality for cases were the bus gets
stuck with SDA pulled low.
In order to enable this one has to specify an additional pinctrl property with
the name 'recovery' to mux GPIO functionality on SDA/SCL and a gpios
property with the GPIOs for SDA/SCL.
The lack of the gpios property disables the functionality.

Examples:
&i2c3 {
        clock-frequency = <100000>;
        pinctrl-names = "default", "recovery";
        pinctrl-0 = <&pinctrl_i2c3_1>;
        pinctrl-1 = <&pinctrl_i2c3_recovery_1>;
        gpios = <&gpio3 18 0 /* sda */
                 &gpio3 17 0 /* scl */
                >;
        status = "disabled";
};

When e.g. a device driver detects a stuck bus
int i2c_recover_bus(struct i2c_adapter *adap)
can be called to try to recover the bus.
```

## Documentation/devicetree/bindings/i2c/i2c-mux-tcc.txt
```
Telechips I2C Bus Mux

This binding describes an I2C bus multiplexer to route the I2C signals,
and represents port configuration (selection) using the device tree bindings.

                                                .-----.  .-----.
                                                | dev |  | dev |
.------------------------------.                '-----'  '-----'
| SoC                          |                  |        |
|                             /|------------------+--------'
| .-----. .-------.  .-------+ | child bus A, on MUX value set to 0
| | I2C |-| CHMux | -| GPMux | |
| '-----' '-------'  '--+----+ |
|                       |     \| child bus B, on MUX value set to 1
|                    .--+----. |---------------+--------+--------.
|                    |Pinmux | |               |        |        |
|                    '-------' |            .-----.  .-----.  .-----.
'------------------------------'            | dev |  | dev |  | dev |
                                            '-----'  '-----'  '-----'

Required properties:
- compatible: Name for matching with the drivers depending on chipset
              "telechips,tcc-i2c-mux" (available all chipset except tcc802x)

- reg: The I2C port configuration address. should be 0x163c0000

- i2c-parent: The phandle of the I2C bus that this multiplexer's master-side
port is connected to.

* Standard I2C mux properties. See i2c-mux.txt in this directory.

* I2C child bus nodes. See i2c-mux.txt in this directory.
For each i2c child node, an I2C child bus will be created. They will
be numbered based on their order in the device tree.

* I2C transactions to devices behind all I2C multiplexers connected to
the same parent adapter that this multiplexer is connected to are blocked
for the full duration of the complete multiplexed I2C transaction.

* The properties of mux-locked or parent-locked multiplexers are discussed
in more detail in Documentation/i2c/i2c-topology.

Note: I2C mux is parsing port number from pinctrl name of i2c child node.
so, please be following the pattern as like i2cxx_bus, xx is port number.
you can find port number in Chip Specification or pinctrl device tree.

Example:

i2cmux@163c0000 {
	compatible = "telechips,i2c-mux";
	reg = <0x0 0x163c0000 0x0 0x10>;
	#address-cells = <1>;
	#size-cells = <0>;

	i2c-parent = <&i2c1>;

	i2c@0 {
		reg = <0>;
		pinctrl-0 = <&i2c6_bus>;
		#address-cells = <1>;
		#size-cells = <0>;

		mxt_touch@4b {
			compatible = "atmel,maxtouch";
			status = "okay";
			reg = <0x4b>;
			pinctrl-names = "default";
			pinctrl-0 = <&tsc0_default>;

			interrupt-parent = <&gpsd1>;
			interrupts = <9 IRQ_TYPE_EDGE_FALLING>;
		};
	};

	i2c@1 {
		reg = <1>;
		pinctrl-0 = <&i2c33_bus>;
		#address-cells = <1>;
		#size-cells = <0>;

		mxt_touch@4d {
			compatible = "atmel,maxtouch";
			status = "disabled";
			reg = <0x4d>;
			pinctrl-names = "default";
			pinctrl-0 = <&tsc1_sv01>;

			interrupt-parent = <&gpa>;
			interrupts = <21 IRQ_TYPE_EDGE_FALLING>;
		};

		mxt_touch@4f {
			compatible = "atmel,maxtouch";
			status = "disabled";
			reg = <0x4f>;
			pinctrl-names = "default";
			pinctrl-0 = <&tsc2_sv01>;

			interrupt-parent = <&gpc>;
			interrupts = <13 IRQ_TYPE_EDGE_FALLING>;
		};
	};

	i2c@2 {
		reg = <2>;
		pinctrl-0 = <&i2c37_bus>;
		#address-cells = <1>;
		#size-cells = <0>;

		dp_serializer:max96851@60 {
			compatible  = "maxim,serdes";
			reg = <0x60>;
		};
		dp_deserializer0:max96878@48 {
			compatible  = "maxim,serdes";
			reg = <0x48>;
		 };
		dp_deserializer1:max96878@4a {
			compatible  = "maxim,serdes";
			reg = <0x4a>;
		};
		dp_deserializer2:max96878@4c {
			compatible  = "maxim,serdes";
			reg = <0x4c>;
		};
		dp_deserializer3:max96878@68 {
			compatible  = "maxim,serdes";
			reg = <0x68>;
		};
	};
};
```

## Documentation/devicetree/bindings/i2c/i2c-slave-tcc-chdrv.txt
```
Device tree configuration for Telechips I2C Slave Controller

Required properties:
- compatible	: depending on the SoC this should be one of:
		"telechips,i2c-slave"
		"telechips,tcc803x-i2c-slave"
		"telechips,tcc897x-i2c-slave"
		"telechips,tcc899x-i2c-slave"
		"telechips,tcc901x-i2c-slave"
- reg		: Physical base address and size of the controller's register area.
- interrupts	: Interrupt specifier.
- clocks	: phandle to input clock.
- #address-cells: Should be 1.
- #size-cells	: Should be 0.
- id		: I2C Slave device bus ID
- pinctrl-names	: Should be "default"
- pinctrl-0	: phandle to pinctrl function
- port-mux	: I2C port number

Optional properties:
- dmas		: Must contain a list of two references to DMA specifier.
- dmas-names	: Should be "tx", "rx".
- status	: Activation status

Note:
GPIO used for I2C SCL/SDA are named as number. you can find port number in Chip Specification.

Examples:

	i2cslave0: i2cslave@16380000 {
		compatible = "telechips,i2c-slave";
		reg = <0x16380000 0x28 0x163c0000 0x10>;
		interrupts = <GIC_SPI 65 IRQ_TYPE_LEVEL_HIGH>;
		clocks = <&clk_io IOBUS_I2C_S0>;
		#address-cells = <1>;
		#size-cells = <0>;
		id = <0>;
		status = "disabled";

		/* USE DMA-engine */
		//dmas = <&dma0 0 24>, <&dma0 1 28>;
		//dma-names = "tx", "rx";
	};
```

## Documentation/devicetree/bindings/i2c/i2c-sw-edid.txt
```
Simulated I2C adapter which provides EDID data out of the device tree

Required properties:
- compatible :
  - "sw-edid" for I2C compatible with the one integrated on i.MX1 SoC
- edit-data :
  - a list of 8 bit values representing the EDID data.

Examples:

i2c-sw-edid {
	compatible = "sw-edid";
	edid-data = [
		00 FF ff FF FF FF FF 00 06 AF 3C 10 00 00 00 00
		00 16 01 04 90 1F 11 78 02 10 B5 97 58 57 92 26
		00 FF FF FF FF FF FF FF 01 01 01 01 01 01 01 01
		01 01 01 01 01 01 CE 1D 56 D2 50 00 26 30 10 10
		3E 00 35 AD 10 00 00 18 DF 13 56 D2 50 00 26 30
		10 10 3E 00 35 AD 10 00 00 18 00 00 00 00 00 00
		00 00 00 00 00 00 00 00 00 00 00 00 00 00 00 02
		00 0C 39 CC 0D 3C 64 0F 0C 1B 6F 20 20 20 00 d8
	];
	#address-cells = <1>;
	#size-cells = <0>;

	/* device driver which is using the simulated I2C device */
	hdmi_ddc: edid@50 {
		compatible = "fsl,imx6-hdmi-i2c";
		reg = <0x50>;
	};
};
```
