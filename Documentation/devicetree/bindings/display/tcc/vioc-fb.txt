## Documentation/devicetree/bindings/display/tcc/vioc-fb.txt
```
This is for 'telechips,vioc-fb'.

Required properties for display:
    -compatible:
        "telechips,vioc-fb"

-------------------------------------------------------------------------------

Example:
	fbdisplay: fbdisplay@12000000 {
		compatible = "telechips,vioc-fb";
		reg = <0x12000000 0x10000>;
		telechips,fbdisplay_num = <0>;
		telechips,rdma_arbitor=<&vioc_rdma_arbitor>;
		memory-region = <&pmap_fb_video &pmap_fb1_video>;

		fbdisplay0:fbdisplay0@12000000{
			telechips,disp = <&vioc_disp VIOC_DISP0>;
			telechips,wmixer = <&vioc_wmix VIOC_WMIX0>;
			telechips,rdma = <&vioc_rdma VIOC_RDMA00 VIOC_RDMA01 VIOC_RDMA02 VIOC_RDMA03>;
			telechips,wdma = <&vioc_wdma VIOC_WDMA00>;
		};

		fbdisplay1:fbdisplay1@12000100{
			telechips,disp = <&vioc_disp VIOC_DISP1>;
			telechips,wmixer = <&vioc_wmix VIOC_WMIX1>;
			telechips,rdma = <&vioc_rdma VIOC_RDMA04 VIOC_RDMA05 VIOC_RDMA06 VIOC_RDMA07>;
			telechips,wdma = <&vioc_wdma VIOC_WDMA01>;
		};
	};
```

## Documentation/devicetree/bindings/display/tcc/vioc_lut.txt
```
This is for 'telechips,vioc_lut'.

Required properties for display:
	-compatible:
		"telechips,vioc_lut"

-------------------------------------------------------------------------------

Example:
	vioc_lut:vioc_lut@12009000{
		compatible = "telechips,vioc_lut";
		reg = <0x12009000 0x800>,
		      /* VIOC_REMAP */
		      <0x12045000 0x800>;
		dev_max = <2>; /* 0: DEV0, 1: DEV1 and 2: DEV2 */
		vioc_max = <4>; /* 3: VIOC_LUT0, 4: VIOC_LUT1, 5: VIOC_LUT2 and 6: VIOC_LUT3 */
		status = "okay";
	};
```

## Documentation/devicetree/bindings/display/tcc/vioc_lut_3d_dx.txt
```
This is for 'telechips,vioc_lut_3d_d0' and 'telechips,vioc_lut_3d_d1'.

Required properties for display:
	-compatible:
		"telechips,vioc_lut_3d_d0"
		"telechips,vioc_lut_3d_d1"

-------------------------------------------------------------------------------

Example:
```

## Documentation/devicetree/bindings/display/tcc/vioc_pixel_mapper.txt
```
This is for 'telechips,vioc_pixel_mapper'.

Required properties for display:
	-compatible:
		"telechips,vioc_pixel_mapper"

-------------------------------------------------------------------------------

Example:
```

## Documentation/devicetree/bindings/display/tcc/viqe_madi.txt
```
This is for 'telechips,viqe_madi'.

Required properties for display:
	-compatible:
		"telechips,viqe_madi"

-------------------------------------------------------------------------------

Example:
   viqe_madi:viqe_madi {
        compatible = "telechips,viqe_madi";
        status = "okay";
    };
```

## Documentation/devicetree/bindings/display/tcc/wmixer_drv.txt
```
This is for 'telechips,wmixer_drv'.

Required properties for display:
	-compatible:
		"telechips,wmixer_drv"

-------------------------------------------------------------------------------

Example:
	wmixer_drv0: wmixer_drv@0 {
		compatible = "telechips,wmixer_drv";
		reg = <0x0 0x0>;	/* Dummy regs. */
		clocks = <&clk_ddi DDIBUS_VIOC>;
		rdmas = <&vioc_rdma VIOC_RDMA17>;
		wmixs = <&vioc_wmix VIOC_WMIX6>;
		wdmas = <&vioc_wdma VIOC_WDMA08>;
		status = "disabled";	/* RDMA15 path is used by scaler_drv1 */
	};

	wmixer_drv1: wmixer_drv@1 {
		compatible = "telechips,wmixer_drv";
		reg = <0x1 0x0>;	/* Dummy regs. */
		clocks = <&clk_ddi DDIBUS_VIOC>;
		rdmas = <&vioc_rdma VIOC_RDMA13>;
		scalers = <&vioc_scaler VIOC_SCALER0>;	/* id:0, path:15 */
		wmixs = <&vioc_wmix VIOC_WMIX3>;	/* id:3, path:- TODO: WMIX_MAX occurs error*/
		wdmas = <&vioc_wdma VIOC_WDMA03>;
		status = "okay";
	};
```

## Documentation/devicetree/bindings/dma/tcc-dma.txt
```
* Telechips GDMA controller

Required properties:
- compatible: "telechips,tcc897x-dma"
              "telechips,tcc899x-dma"
              "telechips,tcc803x-dma"
              "telechips,tcc805x-dma"
              "telechips,tcc901x-dma"
- reg: Specification for the controllers memory mapped register map
- interrupts: Specification for the controllers interrupt
- #dma-cells: Must be 2
- dma-channels: Contains the total number of DMA channels supported by DMAC
- dma-requests: Contains the total number of DMA requests supported by DMAC
- channel-priority: Priority of channels
- clocks: Phandle and specifier to the controllers clock
- clock-names: Clock names

Clients required properties:
- dmas: List of DMA controller phandle, request channel and external request
- dma-names: Names of the aforementioned requested channels

Example:

dma0: dma@16020000 {
	compatible = "telechips,tcc803x-dma";
	reg = <0x16020000 0x94>, /* base address */
	      <0x1605101C 0x04>; /* DMAREQSEL0 */
	interrupts = <GIC_SPI 51 IRQ_TYPE_LEVEL_HIGH>;
	#dma-cells = <2>;
	dma-channels = <3>;
	dma-requests = <32>;
	channel-priority = <0>;
	clocks = <&clk_io IOBUS_DMA0>;
	clock-names = "dmac0";
};

device@12345678 {
	...
	dmas = <&dma0 0 3 &dma0 1 9>;
	dma-names = "tx", "rx";
	...
};
```

## Documentation/devicetree/bindings/extcon/extcon-ptn5150.yaml
```yaml
# SPDX-License-Identifier: GPL-2.0-only OR BSD-2-Clause
%YAML 1.2
---
$id: https://protect2.fireeye.com/url?k=a3f36db3-ffe06f4e-a3f21e28-0cc47a336902-2f52d4c9190310c3&q=1&u=http%3A%2F%2Fdevicetree.org%2Fschemas%2Fextcon%2Fextcon-ptn5150.yaml%23
$schema: https://protect2.fireeye.com/url?k=59835ffc-05905d01-59822c67-0cc47a336902-306bd2691e458c36&q=1&u=http%3A%2F%2Fdevicetree.org%2Fmeta-schemas%2Fcore.yaml%23

title: PTN5150 CC (Configuration Channel) Logic device

maintainers:
  - Krzysztof Kozlowski <krzk@kernel.org>

description: |
  PTN5150 is a small thin low power CC logic chip supporting the USB Type-C
  connector application with CC control logic detection and indication
  functions.  It is interfaced to the host controller using an I2C interface.

properties:
  compatible:
    const: nxp,ptn5150

  int-gpios:
    deprecated: true
    description:
      GPIO pin (input) connected to the PTN5150's INTB pin.
      Use "interrupts" instead.

  interrupts:
    maxItems: 1

  reg:
    maxItems: 1

  vbus-gpios:
    description:
      GPIO pin (output) used to control VBUS. If skipped, no such control
      takes place.

required:
  - compatible
  - interrupts
  - reg

additionalProperties: false

examples:
  - |
    #include <dt-bindings/gpio/gpio.h>
    #include <dt-bindings/interrupt-controller/irq.h>
    i2c {
        #address-cells = <1>;
        #size-cells = <0>;

        ptn5150@1d {
            compatible = "nxp,ptn5150";
            reg = <0x1d>;
            interrupt-parent = <&msmgpio>;
            interrupts = <78 IRQ_TYPE_LEVEL_HIGH>;
            vbus-gpios = <&msmgpio 148 GPIO_ACTIVE_HIGH>;
        };
    };
```

## Documentation/devicetree/bindings/firmware/tcc_sc_fw.txt
```
Telechips SC Firmware Protocol Driver

Required properties:
- compatible: Should be "telechips,tcc805x-sc-fw".
- mboxes: The phandle of mailbox controller and the mailbox specifier.

Optional properties:
N/A

Examples:
a72_sc_mbox: mbox@0x1D200000 {
    status = "okay";
    compatible = "telechips,tcc805x-mailbox-sc";
    reg = <0x0 0x1D200000 0x0 0x80>;
    interrupts = <GIC_SPI 319 IRQ_TYPE_LEVEL_HIGH>,
               <GIC_SPI 329 IRQ_TYPE_LEVEL_HIGH>;
    #mbox-cells = <1>;
};

tcc_sc_fw: tcc_sc_fw {
    compatible = "telechips,tcc805x-sc-fw";
	status = "okay";
	mboxes = <&a72_sc_mbox 0>;
};

tcc_sc_ufs: tcc_sc_ufs {
    compatible = "telechips,tcc805x-sc-ufs";
    status = "okay";
    sc-firmware = <&tcc_sc_fw>;
};
```

## Documentation/devicetree/bindings/firmware/telechips,pm-fw.txt
```
Telechips Power Management Firmware Driver

Power management firmware driver for TCC805x which is used for:
1. Communication with internal MCU (Cortex-R5) for power management such as
   power down or suspend.
2. DA9062 PMIC Control for entering/exiting STR mode, in case of APs are in
   charge of controlling PMIC. (e.g. TCC805x EVBs)
3. User-level interface (sysfs & uevent) for connecting user-level system on
   AP and internal MCU.

Requeried properties:
- compatible: Should be "telechips,pm-fw"
- mboxes: List of phandle and mailbox channel specifiers.  Only the first set
  of phandle and mailbox channel is valid, and other sets are ignored.
- mbox-names: List of identifier strings for each mailbox channel.  As above,
  onltye the first identifier string is valid, and others are ignored.
- mbox-id: Abbreviated identifier string for mailbox channel.  The string
  length must be in 3 ~ 6 characters (excluding null termination).

Example:
	tcc_pm_fw {
		compatible = "telechips,pm-fw";
		mbox-names ="power-mbox";
		mboxes = <&mailbox 0>;
		mbox-id = "POWER";
	};
```

## Documentation/devicetree/bindings/firmware/telechips,pmi.txt
```
Telechips Power Management Interface (PMI) Driver

Telechips Power Management Interface (PMI) driver offers the communication
interface with internal MCU (Cortex-R5) on TCC805x SoC family, for power
management.

Required properties:
- compatible: Should be "telechips,pmi"
- mboxes: List of phandle and mailbox channel specifiers.  Only the first set
  of phandle and mailbox channel is valid, and other sets are ignored.
- mbox-id: Should be "POWER0"

Example:
	pmi {
		compatible = "telechips,pmi";
		mboxes = <&mbox_node 1>;
		mbox-id = "POWER0";
	};
```

## Documentation/devicetree/bindings/gpio/gpio-tcc.txt
```
Required properties:
 - compatible:
        "telechips,tcc-gpio"
 - reg: The gpio address range, relative to the gpio range
	<cell num>
        1 : gpio base address(ap)
        2 : range of gpio base address
 - gpio-controller : Indicates this device is a GPIO controller
 - #gpio-cells :
    <cell num>
         1 : pin number
         2 : polarity
              <value>
                [0] : for active high
                [1] : for active low
 - reg-offset: Offset from gpio base address
 - source-num: External interrupt source number of gpio pin
               Multiple ranges can be registered
    <cell num>
       1 : Count of source number ranges
//First source number ranges
       2 : start pin number
       3 : base source number
       4 : number of pin
//Second number ranges
       5 : start pin number 
       6 : base source number
       7 : number of pin
//Next number ranges
      ...
 - pin-info:
    <cell num>
       1 : offset from gpio base address
       2 : start pin number
       3 : count of gpio pin
 - interrupt-cells: Should be two. The first cell is the GPIO Number. The
                    second cell is used to specify flags. The following
                    subset of flags is supported:
     - trigger type:
       1 = low to high edge triggered
       2 = high to low edge triggered
       4 = active high level-sensitive
       8 = active low level-sensitive
 - interrupt-controller: Identifies the node as an interrupt controller
 - interrupts: The interrupt number to fthe cpu.The interrupt specifier format 
               depends on the interrupt controller

Optional properties:

Example:
gpio: gpio@14200000 {
    compatible = "telechips,tcc-gpio";
    reg = <0x14200000 0x300>;
};

&gpio {
               interrupts = <GIC_SPI 0 0>,
                            <GIC_SPI 1 0>,
                            <GIC_SPI 2 0>,
                            <GIC_SPI 3 0>,
                            <GIC_SPI 4 0>,
                            <GIC_SPI 5 0>,
                            <GIC_SPI 6 0>,
                            <GIC_SPI 7 0>,
                            <GIC_SPI 8 0>,
                            <GIC_SPI 9 0>,
                            <GIC_SPI 10 0>,
                            <GIC_SPI 11 0>,
                            <GIC_SPI 12 0>,
                            <GIC_SPI 13 0>,
                            <GIC_SPI 14 0>,
                            <GIC_SPI 15 0>,
                            <GIC_SPI 16 0>,
                            <GIC_SPI 17 0>,
                            <GIC_SPI 18 0>,
                            <GIC_SPI 19 0>,
                            <GIC_SPI 20 0>,
                            <GIC_SPI 21 0>,
                            <GIC_SPI 22 0>,
                            <GIC_SPI 23 0>,
                            <GIC_SPI 24 0>,
                            <GIC_SPI 25 0>,
                            <GIC_SPI 26 0>,
                            <GIC_SPI 27 0>,
                            <GIC_SPI 28 0>,
                            <GIC_SPI 29 0>,
                            <GIC_SPI 30 0>,
                            <GIC_SPI 31 0>;

        gpa: gpa {
        reg-offset = <0x0>;
        gpio-controller;
        #gpio-cells = <2>;
        interrupt-controller;
        #interrupt-cells = <2>;
        source-num = <1 0 1 32>;
        label = "gpioa";
        gpio-ranges = <&pinctrl 0 0 32>;
        };
};

&pinctrl {
    pinctrl_gpio {
    gpa {
        pin-info = <0x0 0 32>;
    };

    gpb {
        pin-info = <0x40 0 29>;
    };
...
};
```

## Documentation/devicetree/bindings/gpu/hisilicon,hi6220.txt
```
 * Hisilicon hi6220 SoC's Display Subsystem for HiKey board

 ** display-subsystem: Master device for binding DRM sub-components
    This master device is parent node and it will be responsible to bind all
    sub-components devices node.
    - Required properties :
      - compatible: "hisilicon,display-subsystem".
      - #address-cells, #size-cells: Must be present if the device has sub-nodes.
      - ranges: to allow probing of subdevices.
      - dma-coherent: Present if dma operations are coherent.

 ** ade: Graphic overlay, Graphic post-processing, display timing control.
    This device is child node of display-subsystem
    - Required properties :
      - compatible: "hisilicon,hi6220-ade".
      - reg: physical base address of the ADE register and length of memory
	region.
      - reg-names: Should contain the reg names "ade_base" and "media_base".
      - interrupt: The interrupt number to the cpu. Defines the interrupt
        by ADE.
      - clocks: The clocks needed by the ADE module.
      - clock-names: the name of the clocks.

 ** dsi: support mipi dsi interface
    This device is child node of display-subsystem
    - Required properties :
      - compatible: "hisilicon,hi6220-dsi".
      - reg: physical base address of the DSI register and length of memory
	region.
      - clocks: The clocks needed by the DSI module.
      - clock-names: the name of the clocks.
      -	encoder-slave: phandles to a 'encoder-slave' subnode which DSI connect
        ADV7533 in order to support hdmi display.

Example:

	display-subsystem {
		compatible = "hisilicon,drm-hi6220";
		#address-cells = <2>;
		#size-cells = <2>;
		ranges;
		dma-coherent;

		ade: ade@f4100000 {
			compatible = "hisilicon,hi6220-ade";
			reg = <0x0 0xf4100000 0x0 0x7800>,
			      <0x0 0xf4410000 0x0 0x1000>;
			reg-names = "ade_base",
				    "media_base";
			interrupts = <0 115 4>;

			clocks = <&media_ctrl HI6220_ADE_CORE>,
				 <&media_ctrl HI6220_CODEC_JPEG>,
				 <&media_ctrl HI6220_ADE_PIX_SRC>;
			/*clock name*/
			clock-names  = "clk_ade_core",
				       "aclk_codec_jpeg_src",
				       "clk_ade_pix";
		};

		dsi {
			compatible = "hisilicon,hi6220-dsi";
			reg = <0x0 0xf4107800 0x0 0x100>;
			clocks = <&media_ctrl  HI6220_DSI_PCLK>;
			clock-names = "pclk_dsi";
			encoder-slave = <&adv7533>;
		};
	};
```
