## Documentation/devicetree/bindings/i2c/i2c-tcc.txt
```
Device tree configuration for Telechips I2C Master Controller

Required properties:
- compatible	: Name for matching with the drivevrs depending on chipset
		Should be
		"telechips,tcc805x-i2c"
		"telechips,tcc803x-i2c"
		"telechips,tcc802x-i2c"
		"telechips,tcc901x-i2c"
		"telechips,tcc899x-i2c"
		"telechips,tcc897x-i2c"
		"telechips,i2c"
- reg		: Physical base address and size of the controller's register area.
- interrupts	: Interrupt specifier.
- clocks	: phandle to input clock.
- #address-cells: Should be 1.
- #size-cells	: Should be 0.
- pinctrl-names	: Should be "default"
- pinctrl-0	: phandle to pinctrl function
- port-mux	: I2C port number

Optional properties:
- peri-clock-frequency	: Desired I2C peripheral frequency in Hz, default is 4MHz.
- clock-frequency	: Desired I2C bus frequency in Hz, default is 100kHz.
- interrupt_mode	: interrupt-base transfer, default is not used interrupt.
- noise_filter		: Desired I2C Noise filtering time in ns, default is 50ns
- status		: Activation status

Note:
GPIO used for I2C SCL/SDA are named as number. you can find port number in Chip Specification.
I2C bus frequency is generated from I2C peripheral frequency which is divided by prescale.
If i2c transfer between irqsave function, you should set interrupt_mode to 0.

Examples:

	i2c0: i2c@16300000 {
		reg = <0x16300000 0x1c 0x163c0000 0x10 0x16340004 0x04>;
		compatible = "telechips,tcc803x-i2c";
		interrupts = <GIC_SPI 61 IRQ_TYPE_LEVEL_HIGH>;
		clocks = <&clk_peri PERI_I2C0 &clk_io IOBUS_I2C_M0 &clk_fbus FBUS_IO>;
		#address-cells = <1>;
		#size-cells = <0>;
		interrupt_mode = <0>;

		pinctrl-names = "default";
		pinctrl-0 = <&i2c11_bus>;
		port-mux = <11>;
		clock-frequency = <400000>;
		status = "okay";

		dummy@60 {
			compatible = "dummy";
			reg = <0x60>;
		};
	};
```

## Documentation/devicetree/bindings/iio/adc/stmpe-adc.txt
```
STMPE ADC driver
----------------

Required properties:
 - compatible: "st,stmpe-adc"

Optional properties:
Note that the ADC is shared with the STMPE touchscreen, so if using both the
settings should be the same.
If they are not, the last one to be initialized will win.
- st,sample-time: ADC converstion time in number of clock.  (0 -> 36 clocks, 1 ->
  44 clocks, 2 -> 56 clocks, 3 -> 64 clocks, 4 -> 80 clocks, 5 -> 96 clocks, 6
  -> 144 clocks), recommended is 4.
- st,mod-12b: ADC Bit mode (0 -> 10bit ADC, 1 -> 12bit ADC)
- st,ref-sel: ADC reference source (0 -> internal reference, 1 -> external
  reference)
- st,adc-freq: ADC Clock speed (0 -> 1.625 MHz, 1 -> 3.25 MHz, 2 || 3 -> 6.5 MHz)

Node name must be stmpe_adc and should be child node of stmpe node to
which it belongs.

Example:

	stmpe_adc {
		compatible = "st,stmpe-adc";
		st,sample-time = <4>;
		st,mod-12b = <1>;
		st,ref-sel = <0>;
		st,adc-freq = <1>;
	};
```

## Documentation/devicetree/bindings/iio/adc/tcc-adc.txt
```
Telechips A/D converter Controller

Required properties:
- compatible: depending on the SoC this should be one of:
		"telechips,adc",
		"telechips,tcc803x-adc",
		"telechips,tcc805x-adc",
- reg: the physical base address and length of the registers
- #io-channel-cells: must be 1, see ../iio-bindings.txt

Note: the following property is available on "telechips,adc"
- clocks: phandle and clock identifier
- clock-frequency: Desired ADC peripharl freiquency
- ckin-frequency: Desired ADC Sampling frequency
		  "ckin-frequency" is generated from "clock-frequency" which is divided by prescale.


Optional properties:
- adc-12bit-resolution: boolean, If the property is exist, A/D converts data to 12 bits.
- adc-delay : A/D conversion delay value. It depends on clock-frequency value.
              A/D conversion is delayed by counting clock of "clock-frequency".

Example:

	adc: adc@16050000 {
		compatible = "telechips,adc";
		reg = <0x16050000 0x24 0x1440000C 0x4>;
		clocks = <&clk_peri PERI_TSADC &clk_io IOBUS_TSADC &clk_isoip_top ISOIP_TOP_TSADC>;
		clock-frequency = <12000000>;
		ckin-frequency  = <1000000>;
		adc-12bit-resolution;
		adc-delay = <150>;
		#io-channel-cells = <1>;
		status = "okay";
	};

	or

	adc: adc@1b700000 {
		compatible = "telechips,tcc805x-adc";
		reg = <0x0 0x1b700000 0x0 0xAC>,
		      <0x0 0x1b931088 0x0 0x4>;
		#io-channel-cells = <1>;
		status = "okay";
	};
```

## Documentation/devicetree/bindings/input/tc_touch_share/tc_touch_receive.txt
```
Telechips Touch Sharing Single Touch Device

Required properties:
- compatible:
    telechips,tcc_touch_receive

- mbox-names:
	tr-mbox

- mboxes:
	<&cb_mbox TCC_CB_MBOX_TCHSHARE>

- mbox-id:
	TCC_MBOX_TCHSHARE_ID

Optional properties for sub-core single touch device:
- xmax: Sub-core Single Touch Device X coordinate Max range
	<1920>
- ymax: Sub-core Single Touch Device Y coordinate Max range
	<720>

Example:
	touch_share {
	    compatible = "telechips,tcc_touch_receive";
		mbox-names ="tr-mbox";
		mboxes = <&cb_mbox TCC_CB_MBOX_TCHSHARE>;
		mbox-id = TCC_MBOX_TCHSHARE_ID;
		xmax = <1920>;
		ymax = <720>;
};
```

## Documentation/devicetree/bindings/input/tcc-keypad.txt
```
Telechips Keypad device tree bindings

Required properties:
- compatible		: "telechips,tcckey";
- io-channels		: Phandle to an ADC channel, ADC Channel number
- io-channel-names	: Should be "buttons".

Optional Properties:
- poll-interval		: Poll interval time in milliseconds, default is 20ms.

Each button (key) is represented as a sub-node of "telechips,tcckey":
Required subnode-properties:
- label			: Descriptive name of the key.
- linux,code		: Keycode to emit.
- voltage-range		: the range of ADC input when this key is pressed.

Example:

	tcckey@0 {
		compatible = "telechips,tcckey";
		io-channels = <&adc 0>;
		io-channel-names = "buttons";
		status = "okay";
		button-enter{
			label = "enter";
			linux,code = <KEY_ENTER>;
			voltage-range = <0x00 0x83>;
		};
		button-setup{
			label = "setup";
			linux,code = <KEY_SETUP>;
			voltage-range = <0x732 0x8CC>;
		};
		button-menu{
			label = "menu";
			linux,code = <KEY_MENU>;
			voltage-range = <0x9E5 0xC18>;
		};
	};
```
