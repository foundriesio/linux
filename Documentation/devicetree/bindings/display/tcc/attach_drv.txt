## Documentation/devicetree/bindings/display/tcc/tcc_component.txt
```
This is for 'telechips,tcc-component'.

Required properties for display:
    -compatible:
        "telechips,tcc-component"

-------------------------------------------------------------------------------

Example:
	component {
		status = "disabled";
		compatible = "telechips,tcc-component";
		clocks = <&clk_peri PERI_LCD0 &clk_peri PERI_LCD1>;
		vioc-frequency = <74250000>;
		scaler = <&vioc_scaler VIOC_SCALER1>;
		config = <&vioc_config>;
		ddicfg = <&ddi_config>;
	};
```

## Documentation/devicetree/bindings/display/tcc/tcc_component_adv7343.txt
```
This is for 'component-adv7343-i2c'.

Required properties for display:
    -compatible:
        "component-adv7343-i2c"

-------------------------------------------------------------------------------

Example:
		adv7343@20 {
			compatible = "component-adv7343-i2c";
			reg = <0x2b>;	/* ALSB=1, Write=0x56, Read=0x57 */
		};
```

## Documentation/devicetree/bindings/display/tcc/tcc_composite.txt
```
This is for 'telechips,tcc-composite'.

Required properties for display:
    -compatible:
        "telechips,tcc-composite"

-------------------------------------------------------------------------------

Example:
	composite {
		status = "disabled";
		compatible = "telechips,tcc-composite";
		clocks = <&clk_peri PERI_LCD0 &clk_peri PERI_LCD1>;
		vioc-frequency = <27000000>;
		scaler = <&vioc_scaler VIOC_SCALER1>;
		config = <&vioc_config>;
		ddicfg = <&ddi_config>;
	};
```

## Documentation/devicetree/bindings/display/tcc/tcc_lcd.txt
```
This is for 'telechips drm display'.

Required properties for display:
	-compatible:
		- PRIMARY : "telechips,tcc-drm-lcd"
		- PRIMARY_V1.x : "telechips,tcc-drm-lcd-v1.0"
		- SECOND : "telechips,tcc-drm-ext"
		- SECOND_V1.x : "telechips,tcc-drm-ext-v1.0"
		- THIRD : "telechips,tcc-drm-third"
		- THIRD_V1.x : "telechips,tcc-drm-third-v1.0"
		- FOURTH : "telechips,tcc-drm-fourth"
		- FOURTH_V1.x : "telechips,tcc-drm-fourth-v1.0"
		- SCREEN SHARE : "telechips,tcc-drm-screen-share"
	-reg:
		physical base address of the controller and length
		of memory mapped region.
	-display_device:
		This property defines the display device of panel.
			-The first argument is the phandle of vioc_disp.
			-The second argument is the block number of the display
		  device, which is specified as VIOC_DISPn.
	-lcdc-mux-select:
		This property defines the LCD mux.
		If TCCDRM has DRM panel LVDS and uses it as one of display
		output, TCCDRM uses this lcdc-mux-select instead of
		lcdc-mux-select of TCCDRM. Because, in this case,
		lcdc-mux-select of DRM panel LVDS takes precedence.
		Note: This property is valid only in TCCDRM V1.2.0 or higher
		      on TCC805x SDK.
	- wmixer:
		This property defines the WMIX of panel.
			-The first argument is phandle of vioc_wmix.
			-The second argument is the block number of wmix, which
			 is specified as VIOC_WMIXn.
	-rdma:
		This property defines the RDMA of plane. Up to 4 RDMA can be
		specified.
			-The first argument is the phandle of vioc_rdma.
			-The second to fourth arguments are the block numbers
			 of vioc_rdma, which is specified as VIOC_RDMAn.
	-planes:
		This property defines the plane property for RDMA defined in
		RDMA property.
		Therefore, the number of plane properties must be the same as
		the number of RDMA properties.
		The names of plane properties are as follows:
			-Primary plane: “primary”
			-Cursor plane: “cursor”
			-Overlay plane: “overlay”
		Note: There must be only one primary property.
	-port:
		This property defines a panel such as LVDS that can be
		connected to CRTC.
		Refer to “Documentation/devicetree/bindings/graph.txt” for more
		information.
		Note: This property is valid only in TCCDRM V1.2.0 or higher
		      on TCC805x SDK.

Optional properties for display:
	-display-timings:
		The resolution of panel is set through this display-timing
		property.
		For more information for display-timing node, see
		“Documentation/devicetree/bindings/display/panel/display-timing.txt”
		in kernel directory.

-------------------------------------------------------------------------------

Example:

tcc-drm-lcd {
	compatible = "telechips,tcc-drm-xxx-v1.0";
	display_device = <&vioc_disp VIOC_DISP0>;
	lcdc-mux-select = <0>;
	wmixer = <&vioc_wmix VIOC_WMIX0>;
	rdma = <&vioc_rdma VIOC_RDMA00 VIOC_RDMA01 VIOC_RDMA02 VIOC_RDMA03>;
	planes = "primary","cursor","overlay","overlay";
	connector_type = “DP”;
	status = "okay";
	port@0 {
		#address-cells = <1>;
		#size-cells = <0>;
		reg = <0>;
		lcd_display_out: endpoint {
		//remote-endpoint = <&tm123xdhp90_input_0>;
		//remote-endpoint = <&fld0800_input_0>;
	};
};
```

## Documentation/devicetree/bindings/display/tcc/tcc_overlay.txt
```
This is for 'telechips,tcc_overlay'.

Required properties for display:
	-compatible:
		"telechips,tcc_overlay"

-------------------------------------------------------------------------------

Example:
   tcc_overlay: tcc_overlay_drv {
        compatible = "telechips,tcc_overlay";
        fbdisplay-overlay = <&fbdisplay>;
        rdmas = <&vioc_rdma VIOC_RDMA00 VIOC_RDMA01 VIOC_RDMA02 VIOC_RDMA03 VIOC_RDMA04 VIOC_RDMA05 VIOC_RDMA06 VIOC_RDMA07>;
        wmixs = <&vioc_wmix VIOC_WMIX0 VIOC_WMIX1>;
        status = "okay";
    };
```

## Documentation/devicetree/bindings/display/tcc/tcc_viqe.txt
```
This is for 'telechips,tcc_viqe'.

Required properties for display:
	-compatible:
		"telechips,tcc_viqe"

-------------------------------------------------------------------------------

Example:

	tcc_viqe: tcc_video_viqe {
		compatible = "telechips,tcc_viqe";
		status = "disabled";

		tcc_viqe_viqe_common {
			telechips,viqe,0 = <&vioc_viqe VIOC_VIQE0>;
			telechips,viqe,1 = <&vioc_viqe VIOC_VIQE1>;
			vioc_deintls = <VIOC_DEINTLS0>;
			board_num=<0>;
		};

		tcc_video_viqe_lcd {
			telechips,wmixer = <&vioc_wmix VIOC_WMIX1>;
			telechips,rdma,60 = <&vioc_rdma VIOC_RDMA07>;
			telechips,disp = <&vioc_disp VIOC_DISP1>;
			telechips,sc = <&vioc_scaler VIOC_SCALER1>;
			viqe_rdma_num_60 = <VIOC_VIQE_RDMA_07>;
			sc_rdma_num_60 = <VIOC_SC_RDMA_07>;
		};

		tcc_video_viqe_external {
			telechips,wmixer = <&vioc_wmix VIOC_WMIX0>;
			telechips,rdma,60 = <&vioc_rdma VIOC_RDMA03>;
			telechips,disp = <&vioc_disp VIOC_DISP0>;
			telechips,sc = <&vioc_scaler VIOC_SCALER1>;
			viqe_rdma_num_60 = <VIOC_VIQE_RDMA_03>;
			sc_rdma_num_60 = <VIOC_SC_RDMA_03>;
		};

		tcc_video_viqe_external_sub {
			telechips,wmixer = <&vioc_wmix VIOC_WMIX0>;
			telechips,rdma,60 = <&vioc_rdma VIOC_RDMA02>;
			telechips,disp = <&vioc_disp VIOC_DISP0>;
			telechips,sc = <&vioc_scaler VIOC_SCALER4>;
			viqe_rdma_num_60 = <VIOC_VIQE_RDMA_02>;
			sc_rdma_num_60 = <VIOC_SC_RDMA_02>;
		};

		tcc_video_main_m2m{
			main_rdma_num_m2m = <VIOC_VIQE_RDMA_16>;
			telechips,main_rdma,m2m = <&vioc_rdma VIOC_RDMA16>;
		};

		tcc_video_sub_m2m {
			sub_rdma_num_m2m = <VIOC_VIQE_RDMA_07>;
			telechips,sub_rdma,m2m = <&vioc_rdma VIOC_RDMA07>;
		};

		tcc_video_scaler_main_m2m {
			clocks = <&clk_ddi DDIBUS_VIOC>;
			m2m_sc_rdma = <&vioc_rdma VIOC_RDMA16>;
			m2m_sc_scaler = <&vioc_scaler VIOC_SCALER1>;	/* id:1, path:17 */
			m2m_sc_wmix = <&vioc_wmix VIOC_WMIX5>;	/* id:5, path:6 */
			m2m_sc_wdma = <&vioc_wdma VIOC_WDMA06>;
			m2m_sc_scaler_path = <VIOC_SC_RDMA_16>;
			m2m_sc_settop_support = <1>;
		};

		tcc_video_scaler_sub_m2m {
			clocks = <&clk_ddi DDIBUS_VIOC>;
			m2m_sc_rdma = <&vioc_rdma VIOC_RDMA07>;
			m2m_sc_scaler = <&vioc_scaler VIOC_SCALER3>;	/* id:3, path:7 */
			m2m_sc_wmix = <&vioc_wmix VIOC_WMIX1>;	/* id:1, path:3 */
			m2m_sc_wdma = <&vioc_wdma VIOC_WDMA01>;
			m2m_sc_scaler_path = <VIOC_SC_RDMA_07>;
			m2m_sc_settop_support = <1>;
		};
	};
```

## Documentation/devicetree/bindings/display/tcc/tcc_vsync.txt
```
This is for 'telechips,tcc_vsync'.

Required properties for display:
	-compatible:
		"telechips,tcc_vsync"

-------------------------------------------------------------------------------

Example:
   tcc_vsync_drv {
        compatible = "telechips,tcc_vsync";
        display-vioc0 = <&vioc_disp VIOC_DISP0>;
        display-vioc1 = <&vioc_disp VIOC_DISP1>;
        status = "okay";
    };
```

## Documentation/devicetree/bindings/display/tcc/v4l2_vout.txt
```
This is for 'telechips,v4l2_vout'.

Required properties for display:
	-compatible:
		"telechips,v4l2_vout"

-------------------------------------------------------------------------------

Example:
	vout_drv0: vout_drv@0 {
		compatible = "telechips,v4l2_vout";
		reg = <0x0 0x0>; /* Dummy regs. */
		clocks = <&clk_ddi DDIBUS_VIOC>;

		rdma = <&vioc_rdma VIOC_RDMA03 VIOC_RDMA07>;
		wmix = <&vioc_wmix VIOC_WMIX0 VIOC_WMIX1>;
		disp = <&vioc_disp VIOC_DISP0 VIOC_DISP1>;

		subplane_rdma = <&vioc_rdma VIOC_RDMA02>;
		m2m_subplane_rdma = <&vioc_rdma VIOC_RDMA13>;
		m2m_rdma = <&vioc_rdma VIOC_RDMA12>;
		m2m_wmix	= <&vioc_wmix VIOC_WMIX3>;
		m2m_wdma = <&vioc_wdma VIOC_WDMA03>;

		deintl_block = <&vioc_viqe VIOC_VIQE0>;
		scaler = <&vioc_scaler VIOC_SCALER1>;

		status = "disabled";
	};

	vout_drv1: vout_drv@1 {
		compatible = "telechips,v4l2_vout";
		reg = <0x1 0x0>; /* Dummy regs. */
		clocks = <&clk_ddi DDIBUS_VIOC>;

		rdma = <&vioc_rdma VIOC_RDMA07>;
		wmix = <&vioc_wmix VIOC_WMIX1>;
		disp = <&vioc_disp VIOC_DISP1>;

		subplane_rdma = <&vioc_rdma VIOC_RDMA05>;
		m2m_subplane_rdma = <&vioc_rdma VIOC_RDMA15>;
		m2m_rdma = <&vioc_rdma VIOC_RDMA14>;
		m2m_wmix	= <&vioc_wmix VIOC_WMIX4>;
		m2m_wdma = <&vioc_wdma VIOC_WDMA04>;

		deintl_block = <&vioc_deintls VIOC_DEINTLS0>;
		scaler = <&vioc_scaler VIOC_SCALER3>;

		status = "disabled";
	};
```
