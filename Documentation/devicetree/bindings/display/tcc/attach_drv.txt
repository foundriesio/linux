## Documentation/devicetree/bindings/display/tcc/attach_drv.txt
```
This is for 'telechips,attach_drv'.

Required properties for display:
	-compatible:
		"telechips,attach_drv"

-------------------------------------------------------------------------------

Example:
	attach_drv0: attach_drv@0 {
		compatible = "telechips,attach_drv";
		reg = <0x0 0x0>;	/* Dummy regs. */
		clocks = <&clk_ddi DDIBUS_VIOC>;
		scaler = <&vioc_scaler VIOC_SCALER0>;
		wdma = <&vioc_wdma VIOC_WDMA00>;
		wmix = <&vioc_wmix VIOC_WMIX1>;
		rdma = <&vioc_rdma VIOC_RDMA05>;
		status = "okay";
	};

	attach_drv1: attach_drv@1 {
		compatible = "telechips,attach_drv";
		reg = <0x1 0x0>;	/* Dummy regs. */
		clocks = <&clk_ddi DDIBUS_VIOC>;
		scaler = <&vioc_scaler VIOC_SCALER4>;
		wdma = <&vioc_wdma VIOC_WDMA01>;
		wmix = <&vioc_wmix VIOC_WMIX0>;
		rdma = <&vioc_rdma VIOC_RDMA01>;
		status = "okay";
	};
```

## Documentation/devicetree/bindings/display/tcc/chromainterpolator_drv.txt
```
This is for 'telechips,chromainterpolator_drv'.

Required properties for display:
	-compatible:
		"telechips,chromainterpolator_drv"

-------------------------------------------------------------------------------

Example:
```

## Documentation/devicetree/bindings/display/tcc/fb_cr.txt
```
This is for 'telechips,fb_cr'.

Required properties for display:
    -compatible:
        "telechips,fb_cr"

-------------------------------------------------------------------------------

Example:
	fb_cr: fb_cr@12000000{
		compatible = "telechips,fb_cr";
		status = "okay";

		/* the number of interrupt source which is needed to be cleared */
		telechips,num_comp = <2>;

		/* android & linux video driver interrupt, fbdisplay interrupt */
		telechips,vioc_comp = <VIOC_WDMA03 VIOC_DISP0>;
	};
```

## Documentation/devicetree/bindings/display/tcc/graphic.2d.txt
```
This is for 'telechips,graphic.2d'.

Required properties for display:
	-compatible:
		"telechips,graphic.2d"

-------------------------------------------------------------------------------

Example:
	graphic2d:graphic2d@1A400000 {
	 	compatible = "telechips,graphic.2d";
	 	reg = <0x1A400000 0x1000>;
	 	interrupts = <GIC_SPI 133 IRQ_TYPE_LEVEL_HIGH>;
	 	clocks =<&clk_fbus FBUS_G2D>;
	 	status ="disabled";
	};
```

## Documentation/devicetree/bindings/display/tcc/hdmi_panel.txt
```
This is for
	'telechips,hdmi640x480tu'
	'telechips,hdmi1280x720'
	'telechips,hdmi1920x720'
	'telechips,adv7613'
	'telechips,hdmi1920x1080'
	'telechips,hdmi4k'
	'telechips,pvlbjt_020_01'


-------------------------------------------------------------------------------

Example:
    hdmi640x480tu {
        compatible = "telechips,hdmi640x480tu";
        status = "okay";
    };

Example:
    panel_1920x720 {
        status = "disable";
        compatible = "telechips,hdmi1920x720";
        clocks = <&clk_peri PERI_LCD0>, <&clk_peri PERI_LCD1>, <&clk_peri PERI_HDMI>, <&clk_ddi DDIBUS_HDMI>, <&clk_isoip_top ISOIP_TOP_HDMI>;
        clock-names = "lcdc0-clk", "lcdc1-clk", "hdmi-pclk", "hdmi-hclk", "hdmi-phy";
    };

Example:
       hdmi_adv7613 {
            compatible = "telechips,adv7613";
            reg=<0x4C>;
            hdmi-ext-panel = <1>; // HDMI EXT PANEL
            main-slave = <0x4C>;
            cec-slave = <0x40>;
            info-slave = <0x3E>;
            dpll-slave = <0x26>;
            ksv-slave = <0x32>;
            edid-slave = <0x36>;
            hdmi-slave = <0x34>;
            cp-slave = <0x22>;
            lvds-slave = <0x60>;
            backlight-on-gpios = <&gpma 27 0>;  // BACKLIGHT ON
            power-on-gpios = <&gpc 8 0>;        // LCD_ON
            reset-gpios = <&gpc 9 0>;       // LCD_RST
            pinctrl-0 = <&hdmi_panel>;
        };

Example:
    panel {
        status = "okay";
        compatible = "telechips,hdmi1920x1080";
    };
```

## Documentation/devicetree/bindings/display/tcc/hdmi_v1.4.txt
```
Telechips HDMI v1.4 Drivers
===========================

The HDMI transmitter is consist of a Samsung HDMI 1.4 TX controller IP and
Samsung  PHY IP.

Required properties for hdmi v1.4:
	-compatible:
		- HDMI : "telechips,tcc897x-hdmi"
	-reg:
		physical base address
		- 0 :Controller register base address,
		- 1 :HDMI register base address,
		- 2 :HDMI PHY configuration register base address,
		- 3 :HDCP register base address,
		- 4 :RGB register base address,
		- 5 :AES register base address,
		- 7 :SPDIF Receiver register base address and
		- 8 :I2S Receiver register base address
	-reg-names:
	-interrupt-parent: Specifies the phandle to the parent interrupt
			   controller
	-interrupts: The number of HDMI interrupts
	-clocks: Clocks for HDMI controller
	-clock-names:
	-vioc-frequency:

-------------------------------------------------------------------------------
Example:

hdmi@72300000 {
	compatible = "telechips,tcc897x-hdmi";
	reg = < 0x72300000 0x100
		0x72310000 0x7000
		0x72360000 0x100
		0x72317000 0x200
		0x7231D500 0x100
		0x72320000 0x100
		0x72330000 0x100
		0x72340000 0x100 >;
	reg-names = "hdmi_ctrl",
		"hdmi_core",
		"hdmi_phy",
		"hdmi_hdcp",
		"hdmi_rgb",
		"hdmi_aes",
		"hdmi_spdif",
		"hdmi_i2s";
	interrupt-parent = <&gic>;
	interrupts = <GIC_SPI 34 IRQ_TYPE_LEVEL_HIGH>;
	clocks = <&clk_peri PERI_HDMI
			&clk_ddi DDIBUS_HDMI
			&clk_peri PERI_HDMI_PCLK
			&clk_isoip_top ISOIP_TOP_HDMI
			&clk_peri PERI_HDMIA
			>;
	clock-names = 	"hdmi_ref_clk",
			"hdmi_ddibus",
			"hdmi_phy_apb",
			"hdmi_pmu_iso",
			"hdmi_audio";
	/* spdif block */
	spdif-audio = <3>;  /* 0: audio0, 3: audio3 - default*/
	spdif-block0 = <&spdif0>; /* spdif0 is map to audio0 */
	spdif-block1 = <&spdif1>; /* spdif1 is map to audio3 */

	vioc-frequency = <27>;
	status = "disabled";
};
```

## Documentation/devicetree/bindings/display/tcc/hdmi_v1.4_cec.txt
```
Telechips CEC driver for HDMI v1.4
==================================

The HDMI transmitter is consist of a Samsung HDMI 1.4 TX controller IP and
Samsung  PHY IP.

Required properties for CEC:
	-compatible:
		- "telechips,tcc897x-hdmi-cec"
	-reg:
		Physical base address.
	-reg-names:
	-interrupt-parent: Specifies the phandle to the parent interrupt
			   controller.
	-interrupts: The number of CEC interrupts
	-clocks: Clocks for CEC controller.
	-clock-names:
	-clock-frequency: Clock frequency for CEC controller.
	-pinctrl-names: Set to "default".
	-pinctrl-0: List of phandles pointing to pin configuration nodes
		    for CEC.

-------------------------------------------------------------------------------
Example:

cec@72370000 {
	compatible = "telechips,tcc897x-hdmi-cec";
	reg = <0x76061000 0x200>;
	reg-names = "hdmi_ctrl", "hdmi_cec";
	pinctrl-names = "default";
	pinctrl-0 = <&hdmi_cec>;
	interrupt-parent = <&gic>;
	interrupts = <GIC_SPI 55 IRQ_TYPE_LEVEL_HIGH>;
	clocks = <&clk_peri PERI_IOB_CEC>;
	clock-names = "cec_core_clock";
	clock-frequency = <24000000>;
	status = "disabled";
};
```

## Documentation/devicetree/bindings/display/tcc/hdmi_v1.4_hpd.txt
```
Telechips Hotplug Detect Driver for HDMI v1.4
=============================================

Required properties for HPD:
	-compatible:
		- "telechips,tcc897x-hdmi-hpd".
	-pinctrl-names: Set to "default".
	-pinctrl-0: List of phandles pointing to pin configuration nodes
		    for HPD.
	-gpios:  GPIO used to get Hotplug Detect signal.

Optional properties:

-------------------------------------------------------------------------------
Example:

hpd@72310000 {
	compatible = "telechips,tcc897x-hdmi-hpd";
	pinctrl-names = "default";
	pinctrl-0 = <&hdmi_hpd>;
	gpios = <&gphdmi 1 0>;
	status = "disabled";
};
```

## Documentation/devicetree/bindings/display/tcc/hdmi_v2.txt
```
This is for Telechips HDMI v2.0 Driver

Required properties for HDMI:
	-compatible: "telechips,tcc897x-hdmi"
	-reg:
		physical base address
		- 0 :HDMI Link base address,
		- 1 :HDMI HDCP2.2 base address,
		- 2 :HDMI PHY base address,
		- 3 :I2C Port register base address,
		- 4 :IOBUS Configuration register base address,
	-reg-names:
	-interrupts: The number of HDMI interrupts.
	-clocks: Clocks for HDMI controller.
	-clock-names:
	-clock-frequency: Clock frequency for HDMI Link.
	-hdmi_i2c_port_mapping:
		Maps the I2C/DDC master of HDMI Link with I2C Port of PAD.
	-hdmi_i2c_port_disable:
		Connection status of I2C port and DDC pin.
			-0: DDC pin is connected to I2C port.
			-1: DDC pin is not connected to I2C port.
	-fixd_video_id_code: Fixed Video Identification Code.
	-audio_if_selection_ofst: Offset for HDMI AUDIO I/F Selection Register.
	-audio_rx_chmux: Offset for HDMI RX and TX Channel Mux Selection
			 Register.
	-hdmi_ref_src_clock:
		Set reference source clock of HDMI PHY.
			-0: PAX_XIN (X-TAL)
			-1: HDMI_XIN (HDMI X-TAL)
			-2: HDMI_PERI_CLK (CKC)
			-3: PMU_XIN

Optional properties for display:
	-vendor_name: Vendor name consists of eight 7-bit ASCII.
	-product_description:
		Product Description consists of sixteen 7-bit ASCII.
	-source_informaion:
		Source information.

-------------------------------------------------------------------------------

Example:

hdmi_tx_20: hdmi_tx_20@12400000 {
	compatible = "telechips,dw-hdmi-tx";
	/* Register */
	reg = <0x12400000 0x20000 0x12440000 0x1000 0x12480000 0x1000 0x163C0000 0x10 0x16051000 0x100>;
	reg-names = "hdmi_link", "hdcp_2.2", "hdmi_phy", "i2c_port_cfg", "iobus_configure";
	/* Interrupt */
	interrupts = <GIC_SPI 123 IRQ_TYPE_LEVEL_HIGH>,
			<GIC_SPI 126 IRQ_TYPE_LEVEL_HIGH>,
			<GIC_SPI 127 IRQ_TYPE_LEVEL_HIGH>;
	interrupt-names = "hdmi_link", "hdcp_2.2", "hdmi_cec";
	/* Clocks */
	clocks = <&clk_peri PERI_HDMI_CORE>,
			<&clk_peri PERI_HDMI_AUDIO>,
			<&clk_peri PERI_HDMI_PCLK>,
			<&clk_peri PERI_HDMI_CEC>,
			<&clk_peri PERI_HDMI_HDCP14>,
			<&clk_peri PERI_HDMI_HDCP22>,
			<&clk_ddi DDIBUS_HDMI>,
			<&clk_isoip_ddi ISOIP_DDB_HDMI>,
			<&clk_ddi DDIBUS_VIOC>;
	clock-names = "hdmi_ref_clk",
			"hdmi_spdif_clk",
			"hdmi_apb_clk",
			"hdmi_cec",
			"hdmi_hdcp14",
			"hdmi_hdcp22",
			"hdmi_ddibus",
			"hdmi_isoip_ddibus",
			"ddi_bus";
	clock-frequency = <50000000>;
	/* Pinctrl and gpio */
	pinctrl-names = "default";
	pinctrl-0 = <&hdmi_hpd>;
	gpios = <&gpc 14 0>;

	/* DDC */
	hdmi_i2c_port_disable = <1>;
	hdmi_i2c_port_mapping = <0xc 0xff 0x1d>; /* offset mask value */

	/* Source Product Description */
	vendor_name = "TCC";
	product_description = "TCC8031";
	source_information = <1>; /* Digital STB */

	audio_if_selection_ofst = <0x58>;
	audio_rx_tx_chmux = <0x98>;

	/* fixed video identification code 4: 1280x720p 60Hz */
	fixd_video_id_code = <4>;

	verbose = <0>; // 0 disable, 1 basic, 2 io
	status = "okay";
};
```

## Documentation/devicetree/bindings/display/tcc/hdmi_v2_cec.txt
```
This is for Telechips CEC driver for HDMI v2.0.

Required properties for display:
	-compatible:
		- "telechips,dw-hdmi-cec"
	-reg:
		physical base address of the CEC controller.
	-reg:
		physical base address
		- 0 : HDMI CEC base address
		- 1 : HDMI CEC Interrupt base address
		- 2 : IOBUS Configuration base address
	-pinctrl-names: Set to "default".
	-pinctrl-0: List of phandles pointing to pin configuration nodes
		    for HPD.

-------------------------------------------------------------------------------

Example:

hdmi_cec_20: hdmi_cec_20@16053000 {
	compatible = "telechips,dw-hdmi-cec";
	reg = <0x16053000 0x100 0x16053400 0x400 0x16051054 0x4>;
	reg-names = "cec_controller", "cec_irq_controller", "cec_clock_select";
	interrupts = <GIC_SPI 70 IRQ_TYPE_LEVEL_HIGH>,
			<GIC_SPI 71 IRQ_TYPE_LEVEL_HIGH>;
	clocks = <&clk_io IOBUS_CEC1>;
	clock-names = "iobus_cfg_cec";
	pinctrl-names = "default";
	pinctrl-0 = <&hdmi_cec>;
	status = "disabled";
};
```

## Documentation/devicetree/bindings/display/tcc/lcd_drm_dummy.txt
```
This is for 'telechips,lcd_drm_dummy'.

Required properties for display:
	-compatible:
		"telechips,lcd_drm_dummy"

-------------------------------------------------------------------------------

Example:
	lcd_drm_dummy {
		compatible = "telechips,lcd_drm_dummy";
		status = "disabled";
	};
```

## Documentation/devicetree/bindings/display/tcc/lvds-ed090na.txt
```
This is for 'telechips,lvds-ed090na'.

Required properties for display:
	-compatible:
		"telechips,lvds-ed090na"

-------------------------------------------------------------------------------

Example:
   ed090na {
        compatible = "telechips,lvds-ed090na";
        status = "okay";
    };
```

## Documentation/devicetree/bindings/display/tcc/lvds-fld0800.txt
```
This is for 'telechips,lvds-fld0800' and 'telechips,fb-lvds-fld0800'.

Required properties for display:
	-compatible:
		"telechips,lvds-fld0800"
		"telechips,fb-lvds-fld0800"

-------------------------------------------------------------------------------

Example:
   fld0800 {
        compatible = "telechips,lvds-fld0800";
        status = "okay";
        lvds0 = <&lvds>;
        //power-on-gpios = ; //LCD_ON
        display-on-gpios = <&gpd 6 0>; //LCD_DISP
        reset-gpios = <&gpf 19 0>; //LCD_RST
        lvds-stby-gpios = <&gpb 19 0>; //LCD_DE = LVDS_STBY in LVDS
        //lvds-power-gpios = ; //LVDS_EN
        //lvds-power-gpios1 = ; //V_5V0_EN
    };
```

## Documentation/devicetree/bindings/display/tcc/lvds-pvlbjt020.txt
```
This is for 'telechips,lvds-pvlbjt020'.

Required properties for display:
	-compatible:
		"telechips,lvds-pvlbjt020"

-------------------------------------------------------------------------------

Example:
   pvlbjt020 {
        compatible = "telechips,lvds-pvlbjt020";
        status = "okay";
    };
```

## Documentation/devicetree/bindings/display/tcc/lvds-tm123xdhp90.txt
```
This is for 'telechips,lvds-tm123xdhp90' and 'telechips,fb-lvds-tm123xdhp90'.

Required properties for display:
	-compatible:
		"telechips,lvds-tm123xdhp90"
		"telechips,fb-lvds-tm123xdhp90"

-------------------------------------------------------------------------------

Example:
&tm123xdhp90 {
    compatible = "telechips,lvds-tm123xdhp90";
    status = "okay";
    lvds0 = <&lvds_phy>;
    power-on-gpios = <&gpb 17>; // LCD_ON
    reset-gpios = <&gpb 18 0>;  // LCD_RST
    /*
     * display-on-gpios = ;     // LCD_DISP
     * lvds-stby-gpios = ;      // LCD_DE = LVDS_STBY in LVDS
     * lvds-power-gpios = ;     // LVDS_EN
     * lvds-power-gpios1 = ;    // V_5V0_EN
     */
    mode = <1>;     /* 0: single 1: dual */
    ports = <2 3 4>;
    mux_select = <0>; /*lcdc mux select */
};
```

## Documentation/devicetree/bindings/display/tcc/scaler_drv.txt
```
This is for 'telechips,scaler_drv' and 'telechips,scaler_drv_common'

Required properties for display:
	-compatible:
		"telechips,scaler_drv"
		"telechips,scaler_drv_common"

-------------------------------------------------------------------------------

Example:
	scaler_drv_common: scaler_drv_common@1 {
		compatible = "telechips,scaler_drv_common";
		reg = <0x1 0x0>;
		clocks = <&clk_ddi DDIBUS_VIOC>;
		interrupts = <GIC_SPI 20 IRQ_TYPE_LEVEL_HIGH>;
		status = "disabled";
	};

	scaler_drv1: scaler_drv@1 {
		compatible = "telechips,scaler_drv";
		reg = <0x1 0x0>;
		clocks = <&clk_ddi DDIBUS_VIOC>;
		rdmas = <&vioc_rdma VIOC_RDMA16>;
		scalers = <&vioc_scaler VIOC_SCALER1>;
		wmixs = <&vioc_wmix VIOC_WMIX5>;	/* id:5, path:6 */
		wdmas = <&vioc_wdma VIOC_WDMA06>;
		settop_support = <0>;
		status = "okay";
	};

	scaler_drv3: scaler_drv@3 {
		compatible = "telechips,scaler_drv";
		reg = <0x3 0x0>;
		clocks = <&clk_ddi DDIBUS_VIOC>;
		rdmas = <&vioc_rdma VIOC_RDMA07>;
		scalers = <&vioc_scaler VIOC_SCALER3>;
		wmixs = <&vioc_wmix VIOC_WMIX1>;	/* id:1, path:2 */
		wdmas = <&vioc_wdma VIOC_WDMA01>;
		settop_support = <0>;
		status = "okay";
	};
```
