## arch/arm64/configs/tcc805x_a53_subcore_defconfig
```kconfig
CONFIG_CROSS_COMPILE="aarch64-none-linux-gnu-"
CONFIG_LOCALVERSION="-tcc"
# CONFIG_LOCALVERSION_AUTO is not set
# CONFIG_SWAP is not set
CONFIG_SYSVIPC=y
CONFIG_NO_HZ_IDLE=y
CONFIG_HIGH_RES_TIMERS=y
CONFIG_BSD_PROCESS_ACCT=y
CONFIG_BSD_PROCESS_ACCT_V3=y
CONFIG_TASKSTATS=y
CONFIG_TASK_DELAY_ACCT=y
CONFIG_TASK_XACCT=y
CONFIG_TASK_IO_ACCOUNTING=y
CONFIG_IKCONFIG=y
CONFIG_IKCONFIG_PROC=y
CONFIG_MEMCG=y
CONFIG_RT_GROUP_SCHED=y
CONFIG_CGROUP_FREEZER=y
CONFIG_CGROUP_CPUACCT=y
CONFIG_CGROUP_DEBUG=y
CONFIG_NAMESPACES=y
CONFIG_SCHED_AUTOGROUP=y
CONFIG_KALLSYMS_ALL=y
CONFIG_EMBEDDED=y
# CONFIG_COMPAT_BRK is not set
CONFIG_CC_STACKPROTECTOR_STRONG=y
CONFIG_MODULES=y
CONFIG_MODULE_UNLOAD=y
CONFIG_MODULE_FORCE_UNLOAD=y
CONFIG_MODVERSIONS=y
# CONFIG_BLK_DEV_BSG is not set
CONFIG_PARTITION_ADVANCED=y
# CONFIG_IOSCHED_DEADLINE is not set
# CONFIG_IOSCHED_CFQ is not set
CONFIG_ARM64_TCC_BUILD=y
CONFIG_ARCH_TCC=y
CONFIG_ARCH_TCC805X=y
CONFIG_TCC805X_CA53Q=y
CONFIG_PCI=y
# CONFIG_PCIEAER is not set
CONFIG_PCIE_DW_PLAT=y
CONFIG_PCI_DOLPHIN3=y
CONFIG_PCI_HOST_GENERIC=y
CONFIG_PREEMPT=y
CONFIG_KSM=y
CONFIG_CMA=y
# CONFIG_CORE_DUMP_DEFAULT_ELF_HEADERS is not set
CONFIG_COMPAT=y
CONFIG_PM_AUTOSLEEP=y
CONFIG_PM_WAKELOCKS=y
CONFIG_CPU_IDLE=y
# CONFIG_CPU_FREQ is not set
CONFIG_NET=y
CONFIG_PACKET=y
CONFIG_UNIX=y
# CONFIG_ANDROID_PARANOID_NETWORK is not set
# CONFIG_WIRELESS is not set
CONFIG_DEVTMPFS=y
CONFIG_DEVTMPFS_MOUNT=y
# CONFIG_PREVENT_FIRMWARE_BUILD is not set
CONFIG_DMA_CMA=y
CONFIG_CMA_SIZE_PERCENTAGE=15
CONFIG_CMA_SIZE_SEL_PERCENTAGE=y
# CONFIG_TCC_SCALER is not set
CONFIG_SCSI=m
# CONFIG_SCSI_PROC_FS is not set
CONFIG_BLK_DEV_SD=m
CONFIG_CHR_DEV_SG=m
# CONFIG_SCSI_LOWLEVEL is not set
# CONFIG_INPUT_LEDS is not set
CONFIG_INPUT_EVDEV=y
# CONFIG_INPUT_KEYBOARD is not set
# CONFIG_INPUT_MOUSE is not set
CONFIG_TCC_TOUCH_SHARE=y
# CONFIG_SERIO_SERPORT is not set
CONFIG_SERIO_AMBAKMI=y
# CONFIG_LEGACY_PTYS is not set
CONFIG_SERIAL_AMBA_PL011=y
CONFIG_SERIAL_AMBA_PL011_CONSOLE=y
CONFIG_HW_RANDOM=y
# CONFIG_HW_RANDOM_CAVIUM is not set
CONFIG_HW_RANDOM_TCC=y
# CONFIG_TCC_BT_DEV is not set
# CONFIG_DEVPORT is not set
CONFIG_TCC_HSM=y
# CONFIG_TCC_WDMA is not set
CONFIG_I2C_CHARDEV=y
CONFIG_I2C_MUX=y
CONFIG_PINCTRL_TCC_SCFW=y
CONFIG_GPIO_SYSFS=y
CONFIG_REBOOT_MODE_TCC=y
# CONFIG_HWMON is not set
CONFIG_THERMAL=y
CONFIG_TCC_THERMAL=y
CONFIG_WATCHDOG=y
CONFIG_TCC_805X_CBUS_WATCHDOG=y
CONFIG_REGULATOR=y
CONFIG_REGULATOR_FIXED_VOLTAGE=y
CONFIG_REGULATOR_GPIO=y
# CONFIG_RC_CORE is not set
# CONFIG_VGA_ARB is not set
CONFIG_DRM=y
# CONFIG_VIOC_MAP_DECOMP is not set
# CONFIG_TCC_G2D is not set
# CONFIG_FB_VIOC is not set
# CONFIG_VIOC_CORERESET_SUPPORT is not set
CONFIG_FB_NEW=y
# CONFIG_HDMI_DISPLAY_LASTFRAME is not set
# CONFIG_VIDEO_DISPLAY_SWAP_VPU_FRAME is not set
CONFIG_BACKLIGHT_LCD_SUPPORT=y
# CONFIG_LCD_CLASS_DEVICE is not set
CONFIG_BACKLIGHT_CLASS_DEVICE=y
# CONFIG_BACKLIGHT_GENERIC is not set
CONFIG_DUMMY_CONSOLE_COLUMNS=160
CONFIG_DUMMY_CONSOLE_ROWS=64
CONFIG_LOGO=y
# CONFIG_LOGO_LINUX_MONO is not set
# CONFIG_LOGO_LINUX_VGA16 is not set
# CONFIG_LOGO_LINUX_CLUT224 is not set
CONFIG_LOGO_TCC_1920X720_CLUT224=y
CONFIG_UHID=y
CONFIG_USB=y
# CONFIG_USB_PCI is not set
CONFIG_VBUS_CTRL_DEF_ENABLE=y
CONFIG_USB_EHCI_HCD=m
CONFIG_USB_EHCI_TCC=m
CONFIG_USB_EHCI_HCD_PLATFORM=m
CONFIG_USB_OHCI_HCD=m
CONFIG_USB_OHCI_TCC=m
CONFIG_USB_OHCI_HCD_PLATFORM=m
CONFIG_USB_STORAGE=m
CONFIG_TCC_DWC_OTG_PHY=y
CONFIG_TCC_DWC3_PHY=y
CONFIG_MMC=y
# CONFIG_PWRSEQ_EMMC is not set
# CONFIG_PWRSEQ_SIMPLE is not set
# CONFIG_PWRSEQ_SIMPLE_EXT_CLK is not set
CONFIG_MMC_BLOCK_MINORS=16
CONFIG_MMC_TCC_SC=y
CONFIG_NEW_LEDS=y
CONFIG_LEDS_CLASS=y
CONFIG_LEDS_GPIO=y
CONFIG_LEDS_TRIGGERS=y
CONFIG_LEDS_TRIGGER_TIMER=y
CONFIG_LEDS_TRIGGER_HEARTBEAT=y
CONFIG_RTC_CLASS=y
# CONFIG_RTC_INTF_SYSFS is not set
# CONFIG_RTC_INTF_PROC is not set
CONFIG_RTC_DRV_EFI=y
CONFIG_RTC_DRV_TCC=y
CONFIG_VIRTIO_BALLOON=y
CONFIG_VIRTIO_MMIO=y
CONFIG_STAGING=y
CONFIG_LINUX_ANDROID=y
CONFIG_MAILBOX=y
CONFIG_TCC_MULTI_MAILBOX=y
CONFIG_TCC_SEC_IPC=y
CONFIG_TCC_SC_MAILBOX=y
CONFIG_ARM_SMMU=y
CONFIG_PLATFORM_AVN=y
# CONFIG_PWM is not set
CONFIG_PHY_XGENE=y
# CONFIG_TEE is not set
# CONFIG_DMIID is not set
CONFIG_TCC_SC_FW_PROTOCOL=y
CONFIG_TCC_PM_FIRMWARE=y
CONFIG_EXT2_FS=y
CONFIG_EXT3_FS=y
CONFIG_EXT3_FS_POSIX_ACL=y
# CONFIG_DNOTIFY is not set
CONFIG_FUSE_FS=y
CONFIG_VFAT_FS=y
CONFIG_PROC_KCORE=y
CONFIG_PROC_MBOX=y
CONFIG_TMPFS=y
CONFIG_TMPFS_POSIX_ACL=y
# CONFIG_EFIVAR_FS is not set
# CONFIG_MISC_FILESYSTEMS is not set
# CONFIG_NETWORK_FILESYSTEMS is not set
CONFIG_NLS_CODEPAGE_437=y
CONFIG_NLS_ASCII=y
CONFIG_NLS_ISO8859_1=y
CONFIG_NLS_UTF8=y
CONFIG_PRINTK_TIME=y
CONFIG_DYNAMIC_DEBUG=y
CONFIG_DEBUG_INFO=y
CONFIG_MAGIC_SYSRQ=y
CONFIG_DEBUG_VM=y
CONFIG_SOFTLOCKUP_DETECTOR=y
CONFIG_BOOTPARAM_SOFTLOCKUP_PANIC=y
CONFIG_PANIC_ON_OOPS=y
CONFIG_PANIC_TIMEOUT=1
CONFIG_SCHEDSTATS=y
# CONFIG_DEBUG_PREEMPT is not set
CONFIG_DEBUG_SPINLOCK=y
# CONFIG_DEBUG_BUGVERBOSE is not set
# CONFIG_FTRACE is not set
# CONFIG_CRYPTO_ECHAINIV is not set
# CONFIG_CRYPTO_HW is not set
```
