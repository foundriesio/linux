## arch/arm/configs/tcc899x_linux_stb_defconfig
```kconfig
CONFIG_CROSS_COMPILE="arm-none-linux-gnueabi-"
CONFIG_LOCALVERSION="-tcc"
# CONFIG_LOCALVERSION_AUTO is not set
CONFIG_KERNEL_LZO=y
# CONFIG_SWAP is not set
CONFIG_USE_SUB_MULTI_FRAME=y
CONFIG_SYSVIPC=y
CONFIG_AUDIT=y
CONFIG_NO_HZ=y
CONFIG_HIGH_RES_TIMERS=y
CONFIG_IKCONFIG=y
CONFIG_IKCONFIG_PROC=y
CONFIG_CGROUPS=y
CONFIG_CGROUP_DEBUG=y
CONFIG_CGROUP_FREEZER=y
CONFIG_CGROUP_CPUACCT=y
CONFIG_RESOURCE_COUNTERS=y
CONFIG_CGROUP_SCHED=y
CONFIG_RT_GROUP_SCHED=y
CONFIG_BLK_DEV_INITRD=y
CONFIG_INITRAMFS_SOURCE="../ramdisk/initramfs.cpio.lzo"
CONFIG_RD_LZO=y
CONFIG_KALLSYMS_ALL=y
CONFIG_EMBEDDED=y
# CONFIG_SLUB_DEBUG is not set
CONFIG_MODULES=y
CONFIG_MODULE_UNLOAD=y
CONFIG_MODULE_FORCE_UNLOAD=y
# CONFIG_BLK_DEV_BSG is not set
CONFIG_PARTITION_ADVANCED=y
# CONFIG_IOSCHED_DEADLINE is not set
# CONFIG_IOSCHED_CFQ is not set
CONFIG_ARCH_TCC=y
CONFIG_ARCH_TCC899X=y
CONFIG_ARM_LPAE=y
CONFIG_ARM_THUMBEE=y
CONFIG_PCI=y
CONFIG_PCIE_DW_HOST=y
CONFIG_PCIE_DW_PLAT=y
CONFIG_PCI_TCC=y
CONFIG_PCI_HOST_GENERIC=y
CONFIG_SMP=y
CONFIG_SCHED_MC=y
CONFIG_NR_CPUS=8
CONFIG_ARM_PSCI=y
CONFIG_PREEMPT=y
CONFIG_HIGHMEM=y
CONFIG_KSM=y
CONFIG_DEFAULT_MMAP_MIN_ADDR=32768
CONFIG_CMA=y
CONFIG_ARM_APPENDED_DTB=y
CONFIG_ARM_ATAG_DTB_COMPAT=y
CONFIG_ARM_ATAG_DTB_COMPAT_CMDLINE_EXTEND=y
CONFIG_CMDLINE_EXTEND=y
CONFIG_KEXEC=y
CONFIG_CPU_FREQ=y
CONFIG_CPU_FREQ_DEFAULT_GOV_ONDEMAND=y
CONFIG_CPU_FREQ_GOV_INTERACTIVE=y
CONFIG_CPUFREQ_DT=y
CONFIG_CPU_IDLE=y
# CONFIG_CORE_DUMP_DEFAULT_ELF_HEADERS is not set
CONFIG_PM_AUTOSLEEP=y
# CONFIG_PM_WAKELOCKS is not set
CONFIG_PM_RUNTIME=y
CONFIG_PM_DEBUG=y
CONFIG_PM_CONSOLE_NOT_SUSPEND=y
CONFIG_PM_VERBOSE_DPM_SUSPEND=y
CONFIG_NET=y
CONFIG_PACKET=y
CONFIG_UNIX=y
CONFIG_XFRM_USER=y
CONFIG_NET_KEY=y
CONFIG_INET=y
CONFIG_IP_MULTICAST=y
CONFIG_IP_ADVANCED_ROUTER=y
CONFIG_IP_MULTIPLE_TABLES=y
CONFIG_IP_ROUTE_VERBOSE=y
CONFIG_IP_PNP=y
CONFIG_IP_PNP_DHCP=y
CONFIG_INET_AH=y
CONFIG_INET_ESP=y
CONFIG_INET_IPCOMP=y
# CONFIG_INET_LRO is not set
CONFIG_IPV6=y
CONFIG_IPV6_ROUTER_PREF=y
CONFIG_IPV6_ROUTE_INFO=y
CONFIG_IPV6_OPTIMISTIC_DAD=y
CONFIG_INET6_AH=y
CONFIG_INET6_ESP=y
CONFIG_INET6_IPCOMP=y
CONFIG_IPV6_MIP6=y
CONFIG_IPV6_TUNNEL=y
CONFIG_IPV6_MULTIPLE_TABLES=y
CONFIG_IPV6_SUBTREES=y
CONFIG_NETFILTER=y
CONFIG_NF_CONNTRACK=y
CONFIG_NF_CONNTRACK_SECMARK=y
CONFIG_NF_CONNTRACK_EVENTS=y
CONFIG_NF_CT_PROTO_DCCP=y
CONFIG_NF_CT_PROTO_SCTP=y
CONFIG_NF_CT_PROTO_UDPLITE=y
CONFIG_NF_CONNTRACK_AMANDA=y
CONFIG_NF_CONNTRACK_FTP=y
CONFIG_NF_CONNTRACK_H323=y
CONFIG_NF_CONNTRACK_IRC=y
CONFIG_NF_CONNTRACK_NETBIOS_NS=y
CONFIG_NF_CONNTRACK_PPTP=y
CONFIG_NF_CONNTRACK_SANE=y
CONFIG_NF_CONNTRACK_TFTP=y
CONFIG_NF_CT_NETLINK=y
CONFIG_NETFILTER_XT_TARGET_CLASSIFY=y
CONFIG_NETFILTER_XT_TARGET_CONNMARK=y
CONFIG_NETFILTER_XT_TARGET_CONNSECMARK=y
CONFIG_NETFILTER_XT_TARGET_IDLETIMER=y
CONFIG_NETFILTER_XT_TARGET_LOG=y
CONFIG_NETFILTER_XT_TARGET_MARK=y
CONFIG_NETFILTER_XT_TARGET_NFLOG=y
CONFIG_NETFILTER_XT_TARGET_NFQUEUE=y
CONFIG_NETFILTER_XT_TARGET_TPROXY=y
CONFIG_NETFILTER_XT_TARGET_TRACE=y
CONFIG_NETFILTER_XT_TARGET_SECMARK=y
CONFIG_NETFILTER_XT_TARGET_TCPMSS=y
CONFIG_NETFILTER_XT_MATCH_COMMENT=y
CONFIG_NETFILTER_XT_MATCH_CONNLIMIT=y
CONFIG_NETFILTER_XT_MATCH_CONNMARK=y
CONFIG_NETFILTER_XT_MATCH_CONNTRACK=y
CONFIG_NETFILTER_XT_MATCH_HASHLIMIT=y
CONFIG_NETFILTER_XT_MATCH_HELPER=y
CONFIG_NETFILTER_XT_MATCH_IPRANGE=y
CONFIG_NETFILTER_XT_MATCH_LENGTH=y
CONFIG_NETFILTER_XT_MATCH_LIMIT=y
CONFIG_NETFILTER_XT_MATCH_MAC=y
CONFIG_NETFILTER_XT_MATCH_MARK=y
CONFIG_NETFILTER_XT_MATCH_MULTIPORT=y
CONFIG_NETFILTER_XT_MATCH_POLICY=y
CONFIG_NETFILTER_XT_MATCH_PKTTYPE=y
CONFIG_NETFILTER_XT_MATCH_QTAGUID=y
CONFIG_NETFILTER_XT_MATCH_QUOTA=y
CONFIG_NETFILTER_XT_MATCH_QUOTA2=y
CONFIG_NETFILTER_XT_MATCH_SOCKET=y
CONFIG_NETFILTER_XT_MATCH_STATE=y
CONFIG_NETFILTER_XT_MATCH_STATISTIC=y
CONFIG_NETFILTER_XT_MATCH_STRING=y
CONFIG_NETFILTER_XT_MATCH_TIME=y
CONFIG_NETFILTER_XT_MATCH_U32=y
CONFIG_NF_CONNTRACK_IPV4=y
CONFIG_NF_NAT_IPV4=y
CONFIG_IP_NF_IPTABLES=y
CONFIG_IP_NF_MATCH_AH=y
CONFIG_IP_NF_MATCH_ECN=y
CONFIG_IP_NF_MATCH_TTL=y
CONFIG_IP_NF_FILTER=y
CONFIG_IP_NF_TARGET_REJECT=y
CONFIG_IP_NF_MANGLE=y
CONFIG_IP_NF_RAW=y
CONFIG_IP_NF_SECURITY=y
CONFIG_IP_NF_ARPTABLES=y
CONFIG_IP_NF_ARPFILTER=y
CONFIG_IP_NF_ARP_MANGLE=y
CONFIG_NF_CONNTRACK_IPV6=y
CONFIG_NF_NAT_IPV6=y
CONFIG_IP6_NF_IPTABLES=y
CONFIG_IP6_NF_FILTER=y
CONFIG_IP6_NF_TARGET_REJECT=y
CONFIG_IP6_NF_MANGLE=y
CONFIG_IP6_NF_RAW=y
CONFIG_BRIDGE_NF_EBTABLES=y
CONFIG_BRIDGE_EBT_BROUTE=y
CONFIG_L2TP=y
CONFIG_BRIDGE=y
CONFIG_NET_SCHED=y
CONFIG_NET_SCH_HTB=y
CONFIG_NET_SCH_PRIO=y
CONFIG_NET_CLS_FW=y
CONFIG_NET_CLS_U32=y
CONFIG_CLS_U32_MARK=y
CONFIG_NET_CLS_FLOW=y
CONFIG_NET_EMATCH=y
CONFIG_NET_EMATCH_CMP=y
CONFIG_NET_EMATCH_NBYTE=y
CONFIG_NET_EMATCH_U32=y
CONFIG_NET_EMATCH_META=y
CONFIG_NET_EMATCH_TEXT=y
CONFIG_NET_CLS_ACT=y
CONFIG_BT=y
CONFIG_BT_RFCOMM=y
CONFIG_BT_RFCOMM_TTY=y
CONFIG_BT_BNEP=y
CONFIG_BT_HIDP=y
CONFIG_BT_HCIUART=y
CONFIG_BT_HCIUART_H4=y
CONFIG_BT_HCIUART_BCSP=y
CONFIG_BT_HCIUART_ATH3K=y
CONFIG_CFG80211=y
CONFIG_NL80211_TESTMODE=y
CONFIG_CFG80211_WEXT=y
CONFIG_RFKILL=y
CONFIG_NFC=y
CONFIG_UEVENT_HELPER_PATH="/sbin/hotplug"
CONFIG_DEVTMPFS=y
CONFIG_DEVTMPFS_MOUNT=y
CONFIG_DMA_SHARED_BUFFER=y
CONFIG_DMA_CMA=y
CONFIG_CMA_SIZE_MBYTES=0
CONFIG_BLK_DEV_LOOP=y
CONFIG_UID_STAT=y
CONFIG_PL131_SC=y
CONFIG_SCSI=y
CONFIG_BLK_DEV_SD=y
CONFIG_CHR_DEV_SG=y
CONFIG_MD=y
CONFIG_BLK_DEV_DM=y
CONFIG_DM_DEBUG=y
CONFIG_DM_CRYPT=y
CONFIG_DM_UEVENT=y
CONFIG_DM_VERITY=y
CONFIG_NETDEVICES=y
CONFIG_DUMMY=y
CONFIG_TUN=y
CONFIG_ETHERNET=y
CONFIG_TCC_GMAC=y
CONFIG_TCC_GMAC_DA=y
CONFIG_PHYLIB=y
CONFIG_TCC_REALTEK_PHY=y
CONFIG_PPP=y
CONFIG_PPP_BSDCOMP=y
CONFIG_PPP_DEFLATE=y
CONFIG_PPP_MPPE=y
CONFIG_PPPOLAC=y
CONFIG_PPPOPNS=y
CONFIG_PPP_ASYNC=y
CONFIG_USB_RTL8152=y
# CONFIG_INPUT_MOUSEDEV is not set
CONFIG_INPUT_EVDEV=y
CONFIG_INPUT_KEYRESET=y
# CONFIG_KEYBOARD_ATKBD is not set
CONFIG_KEYBOARD_GPIO=y
CONFIG_KEYBOARD_GPIO_POLLED=y
# CONFIG_INPUT_MOUSE is not set
CONFIG_INPUT_TOUCHSCREEN=y
# CONFIG_TOUCHSCREEN_TCCTS is not set
CONFIG_INPUT_MISC=y
CONFIG_INPUT_KEYCHORD=y
CONFIG_INPUT_TCC_REMOTE=y
CONFIG_LINUX_KEY_TABLE=y
CONFIG_CS_2000_IR_X_CANVAS=y
CONFIG_PBUS_DIVIDE_CLOCK_WITH_XTIN=y
CONFIG_INPUT_UINPUT=y
CONFIG_INPUT_GPIO=y
# CONFIG_SERIO is not set
# CONFIG_CONSOLE_TRANSLATIONS is not set
# CONFIG_VT_CONSOLE is not set
# CONFIG_LEGACY_PTYS is not set
# CONFIG_DEVKMEM is not set
CONFIG_SERIAL_AMBA_PL011=y
CONFIG_SERIAL_AMBA_PL011_CONSOLE=y
CONFIG_TTY_PRINTK=y
# CONFIG_HW_RANDOM is not set
# CONFIG_TCC_SENSOR_DRV is not set
CONFIG_TCC_VPU_DRV=m
CONFIG_VDEC_CNT_4=y
CONFIG_TCC_DISPMG=y
# CONFIG_TCC_GRAPHIC is not set
CONFIG_I2C_CHARDEV=y
CONFIG_SPI=y
CONFIG_SPI_TCC=y
CONFIG_SPI_SPIDEV=y
CONFIG_SPI_TCCXXXX_TSIF_SLAVE=y
CONFIG_REBOOT_MODE_TCC=y
CONFIG_TCCXXXX_LINUXTV_INTERFACE=y
CONFIG_DVB_CORE=y
CONFIG_DVB_MAX_ADAPTERS=8
# CONFIG_DVB_DYNAMIC_MINORS is not set
# CONFIG_DVB_CAPTURE_DRIVERS is not set
CONFIG_GPIOLIB=y
CONFIG_GPIO_SYSFS=y
CONFIG_POWER_RESET=y
CONFIG_POWER_RESET_TCC=y
CONFIG_POWER_SUPPLY=y
# CONFIG_HWMON is not set
CONFIG_THERMAL=y
CONFIG_THERMAL_OF=y
CONFIG_THERMAL_DEFAULT_GOV_STEP_WISE=y
CONFIG_THERMAL_GOV_STEP_WISE=y
CONFIG_TCC_THERMAL=y
# CONFIG_CPU_THERMAL=y
CONFIG_WATCHDOG=y
CONFIG_TCC_WATCHDOG=y
CONFIG_ICTC=y
CONFIG_REGULATOR=y
CONFIG_REGULATOR_FIXED_VOLTAGE=y
CONFIG_REGULATOR_GPIO=y
CONFIG_MEDIA_SUPPORT=y
CONFIG_MEDIA_CAMERA_SUPPORT=y
CONFIG_MEDIA_DIGITAL_TV_SUPPORT=y
CONFIG_V4L_PLATFORM_DRIVERS=y
# CONFIG_VIDEO_TCC_VOUT is not set
CONFIG_VOUT_USE_VSYNC_INT=y
CONFIG_MALI_MIDGARD=y
CONFIG_FB=y
CONFIG_FB1_SUPPORT=y
CONFIG_FB_TCC_USE_VSYNC_INTERRUPT=y
CONFIG_FB_TCC_OVERLAY=y
CONFIG_TCC_VIDEO_DISPLAY_BY_VSYNC_INT=y
CONFIG_VIOC_FIFO_UNDER_RUN_COMPENSATION=y
CONFIG_HDMI_DISPLAY_LASTFRAME_STB_ENABLE=y
CONFIG_LCD_HDMI1920X1080=y
CONFIG_LCD_HDMI4K=y
CONFIG_TCC_HDMI_DRIVER_V2_0=y
#CONFIG_TCC_HDMI_DEBUG_SCDC_DELAY is not set
CONFIG_FB_TCC_COMPOSITE=y
CONFIG_FB_TCC_COMPONENT=y
CONFIG_FB_TCC_COMPONENT_ADV7343=y
CONFIG_TCC_OUTPUT_STARTER=y
# CONFIG_TCC_DISPLAY_MODE_USE is not set
# CONFIG_TCC_DISPLAY_MODE_DUAL_AUTO is not set
CONFIG_LOGO=y
# CONFIG_LOGO_LINUX_MONO is not set
# CONFIG_LOGO_LINUX_VGA16 is not set
# CONFIG_LOGO_LINUX_CLUT224 is not set
CONFIG_TCC_ECID=y
CONFIG_SOUND=y
CONFIG_SND=y
# CONFIG_SND_SUPPORT_OLD_API is not set
CONFIG_SND_SOC=y
CONFIG_SND_SOC_TCC=y
CONFIG_SND_SOC_WM8524=y
CONFIG_USB=y
CONFIG_USB_XHCI_HCD=y
CONFIG_USB_EHCI_HCD=y
CONFIG_USB_EHCI_TCC=y
CONFIG_USB_OHCI_HCD=y
CONFIG_USB_OHCI_TCC=y
CONFIG_USB_STORAGE=y
CONFIG_USB_DWC3=y
CONFIG_USB_DWC3_DUAL_ROLE=y
CONFIG_DWC3_DUAL_FIRST_HOST=y
CONFIG_USB_DWC2=y
CONFIG_USB_DWC2_TCC=y
CONFIG_USB_DWC2_TCC_MUX=y
CONFIG_TCC_DWC_OTG_PHY=y
CONFIG_TCC_DWC3_PHY=y
CONFIG_USB_G_ANDROID=y
CONFIG_VBUS_CTRL_DEF_ENABLE=y
CONFIG_MMC=y
CONFIG_MMC_EMBEDDED_SDIO=y
CONFIG_MMC_PARANOID_SD_INIT=y
CONFIG_MMC_BLOCK_MINORS=16
CONFIG_MMC_SDHCI=y
CONFIG_MMC_SDHCI_PLTFM=y
CONFIG_MMC_SDHCI_TCC=y
CONFIG_MMC_TCC_SDHC=y
CONFIG_NEW_LEDS=y
CONFIG_LEDS_CLASS=y
CONFIG_LEDS_GPIO=y
CONFIG_LEDS_TRIGGERS=y
CONFIG_LEDS_TRIGGER_TIMER=y
CONFIG_LEDS_TRIGGER_HEARTBEAT=y
CONFIG_SWITCH=y
CONFIG_SWITCH_GPIO=y
CONFIG_RTC_CLASS=y
CONFIG_RTC_DRV_TCC=y
#CONFIG_TCC_NSK_SC is not set
CONFIG_STAGING=y
CONFIG_MAILBOX=y
CONFIG_TCC_MAILBOX=y
CONFIG_PLATFORM_STB=y
CONFIG_TEE=y
CONFIG_OPTEE=y
CONFIG_IIO=y
CONFIG_PWM=y
CONFIG_EXT2_FS=y
CONFIG_EXT2_FS_XATTR=y
CONFIG_EXT2_FS_POSIX_ACL=y
CONFIG_EXT2_FS_SECURITY=y
CONFIG_EXT3_FS=y
CONFIG_EXT3_FS_POSIX_ACL=y
CONFIG_EXT4_FS=y
CONFIG_EXT4_FS_POSIX_ACL=y
CONFIG_EXT4_FS_SECURITY=y
# CONFIG_DNOTIFY is not set
CONFIG_FUSE_FS=y
CONFIG_VFAT_FS=y
CONFIG_TMPFS=y
CONFIG_TMPFS_POSIX_ACL=y
CONFIG_CONFIGFS_FS=y
CONFIG_PSTORE=y
CONFIG_PSTORE_CONSOLE=y
CONFIG_PSTORE_RAM=y
CONFIG_NLS_CODEPAGE_437=y
CONFIG_NLS_ASCII=y
CONFIG_NLS_ISO8859_1=y
CONFIG_NLS_UTF8=y
CONFIG_PRINTK_TIME=y
CONFIG_DYNAMIC_DEBUG=y
CONFIG_DEBUG_INFO=y
CONFIG_MAGIC_SYSRQ=y
CONFIG_DEBUG_VM=y
CONFIG_LOCKUP_DETECTOR=y
CONFIG_BOOTPARAM_HARDLOCKUP_PANIC=y
CONFIG_BOOTPARAM_SOFTLOCKUP_PANIC=y
CONFIG_PANIC_TIMEOUT=5
CONFIG_SCHEDSTATS=y
CONFIG_TIMER_STATS=y
# CONFIG_DEBUG_PREEMPT is not set
CONFIG_DEBUG_SPINLOCK=y
CONFIG_ENABLE_DEFAULT_TRACERS=y
# CONFIG_ARM_UNWIND is not set
CONFIG_DEBUG_USER=y
CONFIG_DEBUG_LL=y
CONFIG_EARLY_PRINTK=y
CONFIG_KEYS=y
CONFIG_SECURITY=y
CONFIG_SECURITY_NETWORK=y
CONFIG_SECURITY_SELINUX=y
CONFIG_DEFAULT_SECURITY_DAC=y
CONFIG_CRYPTO_TWOFISH=y
# CONFIG_CRYPTO_ANSI_CPRNG is not set
CONFIG_TCC_ADC=y
CONFIG_KERNEL_MODE_NEON=y
CONFIG_NETWORK_FILESYSTEMS=y
CONFIG_NFS_FS=y
CONFIG_NFS_V2=y
CONFIG_NFS_V3=y
CONFIG_GRACE_PERIOD=y
CONFIG_LOCKD=y
CONFIG_LOCKD_V4=y
CONFIG_NFS_COMMON=y
CONFIG_HIDRAW=y
CONFIG_USB_HIDDEV=y
CONFIG_UHID=y
CONFIG_DVB_NET=y
CONFIG_DVB_PLATFORM_DRIVERS=y
CONFIG_PLATFORM_HWDEMUX=y
CONFIG_MAILBOX=y
CONFIG_TCC_MAILBOX=y
CONFIG_HZ_1000=y
CONFIG_HZ=1000
```

## arch/arm/mach-mvf/Kconfig
```kconfig
if ARCH_MVF

config ARCH_MVFA5
	bool
	select USB_ARCH_HAS_EHCI
	select ARCH_MXC_IOMUX_V3
	select ARCH_MXC_AUDMUX_V2
	select ARM_GIC
	select ARCH_HAS_CPUFREQ
	select IMX_HAVE_PLATFORM_IMX_UART
	select IMX_HAVE_PLATFORM_FEC
	select IMX_HAVE_PLATFORM_IMX_IPUV3
	select IMX_HAVE_PLATFORM_MXC_PWM
	select IMX_HAVE_PLATFORM_LDB
	select IMX_HAVE_PLATFORM_IMX_SPDIF
	select IMX_HAVE_PLATFORM_MVF_SPI
	select IMX_HAVE_PLATFORM_MVF_DCU
	select IMX_HAVE_PLATFORM_MVF_SAI
	select HAVE_PIT

config FORCE_MAX_ZONEORDER
    int "MAX_ORDER"
    default "13"

config	SOC_MVFA5
	bool

config MACH_COLIBRI_VF50
	bool "Support Toradex Colibri VF50 module"
	select COLIBRI_VF
	help
	  Include support for Toradex Colibri VF50 module on Iris carrier board. This
	  includes specific configurations for the board and its peripherals.

config MACH_COLIBRI_VF61
	bool "Support Toradex Colibri VF61 module"
	select COLIBRI_VF
	help
	  Include support for Toradex Colibri VF61 module on Iris carrier board. This
	  includes specific configurations for the board and its peripherals.

config COLIBRI_VF
	bool
	select ARCH_MVFA5
	select SOC_MVFA5
	select IMX_HAVE_PLATFORM_IMX_UART
	select IMX_HAVE_PLATFORM_DMA
	select IMX_HAVE_PLATFORM_FEC
	select IMX_HAVE_PLATFORM_GPMI_NFC
	select IMX_HAVE_PLATFORM_SDHCI_ESDHC_IMX
	select IMX_HAVE_PLATFORM_IMX_I2C
	select IMX_HAVE_PLATFORM_VIV_GPU
	select IMX_HAVE_PLATFORM_IMX_VPU
	select IMX_HAVE_PLATFORM_IMX_SSI
	select IMX_HAVE_PLATFORM_FSL_USB2_UDC
	select IMX_HAVE_PLATFORM_MXC_EHCI
	select IMX_HAVE_PLATFORM_FSL_OTG
	select IMX_HAVE_PLATFORM_FSL_USB_WAKEUP
	select IMX_HAVE_PLATFORM_AHCI
	select IMX_HAVE_PLATFORM_IMX_OCOTP
	select IMX_HAVE_PLATFORM_IMX2_WDT
	select IMX_HAVE_PLATFORM_IMX_SNVS_RTC
	select IMX_HAVE_PLATFORM_IMX_PM
	select IMX_HAVE_PLATFORM_MXC_HDMI
	select IMX_HAVE_PLATFORM_IMX_ASRC
	select IMX_HAVE_PLATFORM_FLEXCAN
	select IMX_HAVE_PLATFORM_MVF_SPI
	select IMX_HAVE_PLATFORM_MVF_DCU
	select IMX_HAVE_PLATFORM_MVF_SAI
	select IMX_HAVE_PLATFORM_MXC_NAND
	select IMX_HAVE_PLATFORM_MVF_CAAM

config MACH_MVFA5_TWR_VF700
	bool "Support MVF CORTEX-A5 TWR-VF700 platform"
	select ARCH_MVFA5
	select SOC_MVFA5
	select IMX_HAVE_PLATFORM_IMX_UART
	select IMX_HAVE_PLATFORM_DMA
	select IMX_HAVE_PLATFORM_FEC
	select IMX_HAVE_PLATFORM_GPMI_NFC
	select IMX_HAVE_PLATFORM_SDHCI_ESDHC_IMX
	select IMX_HAVE_PLATFORM_IMX_I2C
	select IMX_HAVE_PLATFORM_VIV_GPU
	select IMX_HAVE_PLATFORM_IMX_VPU
	select IMX_HAVE_PLATFORM_IMX_SSI
	select IMX_HAVE_PLATFORM_FSL_USB2_UDC
	select IMX_HAVE_PLATFORM_MXC_EHCI
	select IMX_HAVE_PLATFORM_FSL_OTG
	select IMX_HAVE_PLATFORM_FSL_USB_WAKEUP
	select IMX_HAVE_PLATFORM_AHCI
	select IMX_HAVE_PLATFORM_IMX_OCOTP
	select IMX_HAVE_PLATFORM_IMX2_WDT
	select IMX_HAVE_PLATFORM_IMX_SNVS_RTC
	select IMX_HAVE_PLATFORM_IMX_PM
	select IMX_HAVE_PLATFORM_MXC_HDMI
	select IMX_HAVE_PLATFORM_IMX_ASRC
	select IMX_HAVE_PLATFORM_FLEXCAN
	select IMX_HAVE_PLATFORM_MVF_SPI
	select IMX_HAVE_PLATFORM_MVF_DCU
	select IMX_HAVE_PLATFORM_MVF_SAI
	select IMX_HAVE_PLATFORM_MXC_NAND
	select IMX_HAVE_PLATFORM_MVF_CAAM
	help
	  Include support for MVF TWR-VF700 platform. This includes specific
	  configurations for the board and its peripherals.

endif
```

## arch/arm/mach-tcc803x/Kconfig
```kconfig
# arch/arm/mach-tcc803x/Kconfig
#
# Configuration options for the TCC803X SoCs

menuconfig ARCH_TCC803X
	bool "TCC803x"
	select AEABI
	select CPU_V7
	select VFP
	select NEON
	select USE_OF
	select ARM_GIC
	select GENERIC_IRQ_CHIP
	select ARM_AMBA
	select HAVE_ARM_SCU if SMP && !TCC803X_CA7S
	select HAVE_SMP if !TCC803X_CA7S
	select CLKDEV_LOOKUP
	select CLKSRC_MMIO
	select CLKSRC_OF
	select COMMON_CLK
	select HAVE_ARM_ARCH_TIMER
	select ARCH_HAS_OPP
	select PM_OPP if PM
	select PM_GENERIC_DOMAINS
	select USB_ARCH_HAS_XHCI
	select PINCTRL_TCC
	select USB_ARCH_HAS_EHCI if USB_SUPPORT
	select USB_ARCH_HAS_OHCI if USB_SUPPORT
	select SOC_TCC
	select MIGHT_HAVE_PCI
	select PCI_DOMAINS if PCI
	select HAVE_TCC_SIP_SERVICE if !TCC803X_CA7S

config TCC803X_CA7S
	bool "Build for TCC803X Cortex-A7 Single Core"
	depends on ARCH_TCC803X
	select ARM_ERRATA_814220
	help
	  Select this option to build kernel for TCC803x Cortex-A7 Single
	  Core, which is used as subcore on the platform.

	  If not selected, kernel is built for TCC803x Cortex-A53 Quad Core
	  which is used as maincore on the platform.
```
