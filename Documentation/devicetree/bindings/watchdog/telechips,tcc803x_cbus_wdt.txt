## Documentation/devicetree/bindings/watchdog/telechips,tcc803x_cbus_wdt.txt
```
* Telechips Watchdog Timer for CA7s(CBUS Watchdog) on TCC803x

The watchdog timer used for reset the CA7s processor on TCC803x in the event
of software malfunction. Watchdog on CA7s uses two WDTs, CBUS WDT4, CBUS WDT5.
CBUS WDT4 is used for kick timer, and CBUS WDT5 is used for real watchdog,
which yields watchdog interrupt until it is not kicked.

Required properties:
- compatible: Must be "telechips,tcc-cb-wdt" 
- reg: Physical base address of the watchdog control register. One is used for
       watchdog kick timer, the other is used for real watchdog.
- clocks: Information about clock ID used by kernel clock driver.
       Refer 'clocks' node on Telechips device tree.
       (arch/arm/boot/dts/tcc/tcc803x.dtsi).
- clock-frequency: Set appropriate clock frequency for watchdog kick timer. 
       By default, kick timer set to 12MHz. By changing this frequency might
       cause variation on kick time interval.
- interrupts: Interrupt # for watchdog kick timer(CBUS WDT4)
- kick-interval: Kick time interval for kick watchdog counter.
- expire-timeout: Expiration time for real watchdog(CBUS WDT5).

Example:
        tcc_cb_wdt: tcc_cb_wdt@3 {
                compatible = "telechips,tcc-cb-wdt";
                reg = <0x17040000 0x10000>,	/* watchdog kick timer */
                    <0x17050000 0x10000>;	/* real watchdog */
                clocks= <&clk_peri PERI_CB_WDT>;
                clock-frequency = <12000000>;
                interrupts = <GIC_SPI 121 0>;

                kick-interval = <5>;
                expire-timeout = <20>;

                status = "okay";
        };
```

## Documentation/devicetree/bindings/watchdog/telechips,tcc805x_cbus_wdt.txt
```
* Telechips Watchdog Timer for TCC805x(CBUS Watchdog)

The watchdog timer used for reset the CA72, CA53 processor on TCC805x in the
event of software malfunction. CA72 uses CBUS WDT0, and CA53 uses CBUS WDT4
each other. 

On CA72, 
	***************  kick	*************
--------* SMU Timer 0 *-------->* CBUS WDT0 *
	***************		*************

On CA53, 
	***************  kick	*************
--------* SMU Timer 1 *-------->* CBUS WDT4 *
	***************		*************

Required properties:
- compatible: Must be "telechips,tcc-cb-wdt"
- reg: Physical base address of the watchdog control register. 
- interrupts: Interrupt # for watchdog kick timer.
- clock-names: Clock attribute name used for specifying watchdog and timer for
	kick watchdog.
- clocks: Information about clock ID used by kernel clock driver.
	Refer 'clocks' node on Telechips device tree.
	(arch/arm64/boot/dts/tcc/tcc805x.dtsi).
- clock-frequency: Set appropriate clock frequency for watchdog kick timer.
	By default, kick timer set to 12MHz. Changing this frequency might
	cause unstable result on kick time interval.
- kick-timer-id: Watchdog kick timer id for each core. 0 for CA72 kick watchdog 
	timer, 1 for CA53 watchdog kick timer.
- pretimeout-sec: Watchdog time to be kicked(=cleared).
- timeout-sec: Time until watchdog interrupt occurs.

Example:
- Main core : arch/arm64/boot/dts/tcc/tcc805x.dtsi
...
        cb_watchdog: cb_watchdog@0x17010000 {
                compatible = "telechips,tcc-cb-wdt";
                reg = <0x0 0x17010000 0x0 0x10>,
                        <0x0 0x14300000 0x0 0xC>,
                        <0x0 0x14300060 0x0 0x4>;
                interrupts = <GIC_SPI 33 0>;
                clock-names = "clk_wdt", "clk_kick";
                clocks = <&clk_peri PERI_CB_WDT>, <&clk_peri PERI_TCT>;
                clock-frequency = <24000000>;
                status = "okay";

                kick-timer-id = <0>;
                pretimeout-sec = <5>;
                timeout-sec = <20>;
        };
...
- Subcore : arch/arm64/boot/dts/tcc/tcc8050-linux-subcore-a53q_sv1.0.dts
...
        cb_watchdog: cb_watchdog4@0x17050000 {
                compatible = "telechips,tcc-cb-wdt";
                reg = <0x17050000 0x10>,
                        <0x14300010 0xC>,
                        <0x14300060 0x4>;
                interrupts = <GIC_SPI 34 0>;
                clock-names = "clk_wdt", "clk_kick";
                clocks = <&clk_peri PERI_CB_WDT>, <&clk_peri PERI_TCT>;
                clock-frequency = <24000000>;

                kick-timer-id = <1>;
                pretimeout-sec = <5>;
                timeout-sec = <20>;
        };
...
```

## Documentation/devicetree/bindings/watchdog/telechips,tcc_pmu_wdt.txt
```
* Telechips Watchdog Timer for using PMU Watchdog.

The watchdog timer used for reset the Main processor on TCC in the event
of software malfunction. Watchdog on TCC Main processor use PMU Watchdog and
SMU Timer. 

Required properties:
- compatible: Must be "telechips,wdt".
- reg: Physical base address of the watchdog control register and timer control
	register. 
- clocks: Clock id for using watchdog timer.
- clock-frequency: Clock frequency for watchdog timer.
- interrupts: Interrupt # for watchdog kick timer(SMU timer)
- have-rstcnt-reg: Chipset that has reset counter register which released after
	TCC899x

Example:
        watchdog@144000D0 {
                compatible = "telechips,wdt";
                reg = <0x144000D8 0x4>, /* wdt_ctrl */
                      <0x144000DC 0x4>, /* wdt_cnt */
                      <0x144000E4 0x4>, /* wdt_clear */
                      <0x14300070 0xC>, /* wdt_timer */
                      <0x14300060 0x4>; /* wdt_int_sts */
                clocks = <&clk_peri PERI_TCX &clk_peri PERI_TCT>;
                clock-frequency = <24000000>;
                interrupts = <GIC_SPI 39 0>;
                int-offset = <6>;
                clear-bit = <0>;

                /* indicates separated reset count register later TCC899x */
                have-rstcnt-reg;
                /* status = "disabled"; */
        };
```
