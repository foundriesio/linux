## arch/arm/mach-tcc805x/Kconfig
```kconfig
# arch/arm/mach-tcc805x/Kconfig
#
# Configuration options for the TCC805X SoCs

menuconfig ARCH_TCC805X
	bool "TCC805x"
	select AEABI
	select CPU_V7
	select VFP
	select NEON
	select USE_OF
	select ARM_GIC
	select GENERIC_IRQ_CHIP
	select ARM_AMBA
	select HAVE_ARM_SCU if SMP
	select HAVE_SMP
	select CLKDEV_LOOKUP
	select CLKSRC_MMIO
	select CLKSRC_OF
	select COMMON_CLK
	select HAVE_ARM_ARCH_TIMER
	select ARCH_HAS_OPP
	select PM_OPP if PM
	select PM_GENERIC_DOMAINS
	select USB_ARCH_HAS_XHCI
	select PINCTRL_TCC
	select USB_ARCH_HAS_EHCI if USB_SUPPORT
	select USB_ARCH_HAS_OHCI if USB_SUPPORT
	select SOC_TCC
	select MIGHT_HAVE_PCI
	select PCI_DOMAINS if PCI
	select HAVE_TCC_SIP_SERVICE

config TCC805X_CA53Q
	bool "Build for TCC805X Cortex-A53 Subcore"
	depends on ARCH_TCC805X
	help
	  Select this option building a kernel for TCC805X Cortex-A53 Subcore.

	  The TCC805x integrates the ARM® Cortex-A72 quad microprocessor with
	  4 MB unified L2 cache as well as Cortex-A53 quad/dual microprocessor
	  with 512 KB unified L2 cache, Cortex-R5 for microprocessor, SC000
	  core of HSM(Hardware Security Module) in Security sub-system for
	  automotive security, Cortex-M4 for storage management, another
	  Cortex-M4 for TSDEMUX in CM sub-system, and hardwired VPU(Video-
	  Processing Unit)/GPU(Graphics Processing Unit) to maximize multimedia
	  experience at its peak level.
```

## arch/arm/mach-tcc897x/Kconfig
```kconfig
# arch/arm/mach-tcc897x/Kconfig
#
# Configuration options for the TCC897X SoCs

menuconfig ARCH_TCC897X
	bool "TCC897x"
	select AEABI
	select CPU_V7
	select VFP
	select NEON
	select USE_OF
	select ARM_GIC
	select GENERIC_IRQ_CHIP
	select ARM_AMBA
	select HAVE_ARM_SCU if SMP
	select HAVE_SMP
	select CLKDEV_LOOKUP
	select CLKSRC_MMIO
	select CLKSRC_OF
	select COMMON_CLK
	select HAVE_ARM_ARCH_TIMER
	select ARCH_HAS_OPP
	select PM_OPP if PM
	select PM_GENERIC_DOMAINS
	select USB_ARCH_HAS_XHCI
	select PINCTRL_TCC
	select USB_ARCH_HAS_EHCI if USB_SUPPORT
	select USB_ARCH_HAS_OHCI if USB_SUPPORT
	select SOC_TCC
```

## arch/arm/mach-tcc899x/Kconfig
```kconfig
# arch/arm/mach-tcc899x/Kconfig
#
# Configuration options for the TCC899X SoCs

menuconfig ARCH_TCC899X
	bool "TCC899X"
	select AEABI
	select CPU_V7
	select VFP
	select NEON
	select USE_OF
	select ARM_GIC
	select GENERIC_IRQ_CHIP
	select ARM_AMBA
	select HAVE_ARM_SCU if SMP
	select HAVE_SMP
	select CLKDEV_LOOKUP
	select CLKSRC_MMIO
	select CLKSRC_OF
	select COMMON_CLK
	select HAVE_ARM_ARCH_TIMER
	select ARCH_HAS_OPP
	select PM_OPP if PM
	select PM_GENERIC_DOMAINS
	select PINCTRL_TCC
	select SOC_TCC
	select MIGHT_HAVE_PCI
	select PCI_DOMAINS if PCI
	select HAVE_TCC_SIP_SERVICE
```

## arch/arm/mach-tcc901x/Kconfig
```kconfig
# arch/arm/mach-tcc901x/Kconfig
#
# Configuration options for the TCC901X SoCs

menuconfig ARCH_TCC901X
	bool "TCC901X"
	select AEABI
	select CPU_V7
	select VFP
	select NEON
	select USE_OF
	select ARM_GIC
	select GENERIC_IRQ_CHIP
	select ARM_AMBA
	select HAVE_ARM_SCU if SMP
	select HAVE_SMP
	select CLKDEV_LOOKUP
	select CLKSRC_MMIO
	select CLKSRC_OF
	select COMMON_CLK
	select HAVE_ARM_ARCH_TIMER
	select ARCH_HAS_OPP
	select PM_OPP if PM
	select PM_GENERIC_DOMAINS
	select PINCTRL_TCC
	select SOC_TCC
	select MIGHT_HAVE_PCI
	select PCI_DOMAINS if PCI
```

## arch/arm/mach-tinyexpress/Kconfig
```kconfig
config ARCH_TINY_VEXPRESS
	bool "ARM Ltd. Tiny Versatile Express family"
	depends on ARM_SINGLE_ARMV7A
	select ARCH_SUPPORTS_BIG_ENDIAN
	select ARM_AMBA
	select ARM_GIC
	select ARM_GLOBAL_TIMER
	select ARM_TIMER_SP804
	select COMMON_CLK_VERSATILE
	select GPIOLIB
	select HAVE_ARM_SCU if SMP
	select HAVE_ARM_TWD if SMP
	select HAVE_PATA_PLATFORM
	select ICST
	select NO_IOPORT_MAP
	select PLAT_VERSATILE
	select POWER_RESET
	select POWER_RESET_VEXPRESS
	select POWER_SUPPLY
	select REGULATOR if MMC_ARMMMCI
	select REGULATOR_FIXED_VOLTAGE if REGULATOR
	select VEXPRESS_CONFIG
	select VEXPRESS_SYSCFG
	select MFD_VEXPRESS_SYSREG
	help
	  This option enables support for tiny linux based systems using Cortex
	  processor based ARM core and logic (FPGA) tiles on the Versatile
	  Express motherboard.
```

## arch/arm64/configs/tcc802x_linux_avn_defconfig
```kconfig
CONFIG_CROSS_COMPILE="arm-telechips-linux-gnueabi-"
CONFIG_LOCALVERSION="-tcc"
# CONFIG_LOCALVERSION_AUTO is not set
# CONFIG_SWAP is not set
CONFIG_SYSVIPC=y
CONFIG_POSIX_MQUEUE=y
CONFIG_FHANDLE=y
CONFIG_AUDIT=y
CONFIG_NO_HZ_IDLE=y
CONFIG_HIGH_RES_TIMERS=y
CONFIG_BSD_PROCESS_ACCT=y
CONFIG_BSD_PROCESS_ACCT_V3=y
CONFIG_TASKSTATS=y
CONFIG_TASK_DELAY_ACCT=y
CONFIG_TASK_XACCT=y
CONFIG_TASK_IO_ACCOUNTING=y
CONFIG_IKCONFIG=y
CONFIG_IKCONFIG_PROC=y
CONFIG_LOG_BUF_SHIFT=14
CONFIG_MEMCG=y
CONFIG_MEMCG_SWAP=y
CONFIG_CGROUP_HUGETLB=y
CONFIG_SCHED_AUTOGROUP=y
CONFIG_BLK_DEV_INITRD=y
CONFIG_INITRAMFS_SOURCE="./initramfs-telechips-image-tcc802x.cpio"
CONFIG_KALLSYMS_ALL=y
CONFIG_EMBEDDED=y
# CONFIG_PERF_EVENTS is not set
# CONFIG_COMPAT_BRK is not set
CONFIG_PROFILING=y
CONFIG_JUMP_LABEL=y
CONFIG_MODULES=y
CONFIG_MODULE_UNLOAD=y
CONFIG_MODULE_FORCE_UNLOAD=y
# CONFIG_MODVERSIONS is not set
# CONFIG_BLK_DEV_BSG is not set
# CONFIG_IOSCHED_DEADLINE is not set
CONFIG_ARM64_TCC_BUILD=y
CONFIG_ARCH_TCC=y
CONFIG_ARCH_TCC802X=y
CONFIG_SMP=y
CONFIG_PREEMPT=y
CONFIG_KSM=y
CONFIG_TRANSPARENT_HUGEPAGE=y
CONFIG_CMA=y
# CONFIG_CORE_DUMP_DEFAULT_ELF_HEADERS is not set
CONFIG_COMPAT=y
CONFIG_PM_AUTOSLEEP=y
CONFIG_PM_WAKELOCKS=y
CONFIG_CPU_IDLE=y
# CONFIG_CPU_IDLE_GOV_LADDER is not set
CONFIG_CPU_FREQ=y
CONFIG_CPU_FREQ_DEFAULT_GOV_INTERACTIVE=y
CONFIG_CPU_FREQ_GOV_PERFORMANCE=y
CONFIG_CPU_FREQ_GOV_ONDEMAND=y
CONFIG_NET=y
CONFIG_PACKET=y
CONFIG_UNIX=y
CONFIG_INET=y
CONFIG_IP_PNP=y
CONFIG_IP_PNP_DHCP=y
CONFIG_IP_PNP_BOOTP=y
# CONFIG_IPV6 is not set
CONFIG_BPF_JIT=y
CONFIG_UEVENT_HELPER_PATH="/sbin/hotplug"
CONFIG_DEVTMPFS=y
CONFIG_DEVTMPFS_MOUNT=y
CONFIG_DMADEVICES=y
CONFIG_TCC_DMA=y
CONFIG_DMA_ENGINE=y
CONFIG_DMA_OF=y
CONFIG_DMA_CMA=y
CONFIG_BLK_DEV_LOOP=y
CONFIG_VIRTIO_BLK=y
# CONFIG_SCSI_PROC_FS is not set
CONFIG_BLK_DEV_SD=y
# CONFIG_SCSI_LOWLEVEL is not set
CONFIG_NETDEVICES=y
CONFIG_VIRTIO_NET=y
CONFIG_NET_XGENE=y
CONFIG_SMC91X=y
CONFIG_SMSC911X=y
# CONFIG_WLAN is not set
CONFIG_INPUT_EVDEV=y
CONFIG_GPIOLIB=y
CONFIG_KEYBOARD_GPIO_POLLED=y
# CONFIG_INPUT_MOUSE is not set
CONFIG_INPUT_TOUCHSCREEN=y
# CONFIG_SERIO_SERPORT is not set
CONFIG_SERIO_AMBAKMI=y
CONFIG_LEGACY_PTY_COUNT=16
CONFIG_SERIAL_8250=y
CONFIG_SERIAL_8250_CONSOLE=y
CONFIG_SERIAL_AMBA_PL011=y
CONFIG_SERIAL_AMBA_PL011_CONSOLE=y
CONFIG_SERIAL_OF_PLATFORM=y
CONFIG_VIRTIO_CONSOLE=y
# CONFIG_HW_RANDOM is not set
CONFIG_I2C=y
CONFIG_SPI=y
CONFIG_SPI_TCC=y
CONFIG_SPI_SPIDEV=y
CONFIG_TCC_VPU_DRV=m
CONFIG_REBOOT_MODE_TCC=y
CONFIG_VDEC_CNT_2=y
# CONFIG_HWMON is not set
CONFIG_THERMAL=y
CONFIG_WATCHDOG=y
CONFIG_TCC_WATCHDOG=y
CONFIG_MFD_DA9062=y
CONFIG_REGULATOR=y
CONFIG_REGULATOR_FIXED_VOLTAGE=y
CONFIG_REGULATOR_DA9062=y
CONFIG_REGULATOR_GPIO=y
# CONFIG_GC_GPU is not set
CONFIG_DRM=y
CONFIG_TCC_LCD_VIDEO_DISPLAY_BY_VSYNC_INT=y
CONFIG_BACKLIGHT_LCD_SUPPORT=y
# CONFIG_LCD_CLASS_DEVICE is not set
CONFIG_BACKLIGHT_CLASS_DEVICE=y
# CONFIG_BACKLIGHT_GENERIC is not set
CONFIG_LOGO=y
# CONFIG_LOGO_LINUX_MONO is not set
# CONFIG_LOGO_LINUX_VGA16 is not set
# CONFIG_LOGO_LINUX_CLUT224 is not set
CONFIG_SOUND=y
CONFIG_SND=y
# CONFIG_SND_SUPPORT_OLD_API is not set
CONFIG_SND_SOC=y
CONFIG_SND_SOC_TCC=y
CONFIG_SND_SOC_AK4601=y
CONFIG_USB=y
CONFIG_USB_EHCI_HCD=y
CONFIG_USB_OHCI_HCD=y
CONFIG_USB_STORAGE=y
CONFIG_MMC=y
CONFIG_MMC_EMBEDDED_SDIO=y
CONFIG_MMC_PARANOID_SD_INIT=y
CONFIG_MMC_BLOCK_MINORS=16
CONFIG_MMC_TCC_SDHC=y
CONFIG_NEW_LEDS=y
CONFIG_LEDS_CLASS=y
CONFIG_LEDS_GPIO=y
CONFIG_LEDS_TRIGGERS=y
CONFIG_LEDS_TRIGGER_TIMER=y
CONFIG_LEDS_TRIGGER_HEARTBEAT=y
CONFIG_RTC_CLASS=y
CONFIG_RTC_DRV_EFI=y
CONFIG_ARCH_XGENE=y
CONFIG_RTC_DRV_XGENE=y
CONFIG_VIRTIO_BALLOON=y
CONFIG_VIRTIO_MMIO=y
CONFIG_PLATFORM_AVN=y
# CONFIG_IOMMU_SUPPORT is not set
CONFIG_PHY_XGENE=y
CONFIG_EXT4_FS=y
CONFIG_FANOTIFY=y
CONFIG_FANOTIFY_ACCESS_PERMISSIONS=y
CONFIG_FUSE_FS=y
CONFIG_CUSE=y
CONFIG_VFAT_FS=y
CONFIG_TMPFS=y
CONFIG_HUGETLBFS=y
# CONFIG_MISC_FILESYSTEMS is not set
CONFIG_NFS_FS=y
CONFIG_ROOT_NFS=y
CONFIG_9P_FS=y
CONFIG_NLS_CODEPAGE_437=y
CONFIG_NLS_ISO8859_1=y
CONFIG_VIRTUALIZATION=y
CONFIG_KVM=y
CONFIG_PRINTK_TIME=y
CONFIG_DEBUG_INFO=y
CONFIG_FRAME_WARN=2048
CONFIG_MAGIC_SYSRQ=y
CONFIG_LOCKUP_DETECTOR=y
CONFIG_EARLY_PRINTK=y
# CONFIG_SCHED_DEBUG is not set
# CONFIG_FTRACE is not set
CONFIG_SECURITY=y
CONFIG_CRYPTO_ANSI_CPRNG=y
CONFIG_ARM64_CRYPTO=y
CONFIG_CRYPTO_SHA1_ARM64_CE=y
CONFIG_CRYPTO_SHA2_ARM64_CE=y
CONFIG_CRYPTO_GHASH_ARM64_CE=y
CONFIG_CRYPTO_AES_ARM64_CE=y
CONFIG_CRYPTO_AES_ARM64_CE_CCM=y
CONFIG_CRYPTO_AES_ARM64_CE_BLK=y
CONFIG_CRYPTO_AES_ARM64_NEON_BLK=y
# CONFIG_TCC_EARLY_VIEW_CM_CONTROL is not set
# CONFIG_TCC_VIOCMG is not set
```
