## Documentation/devicetree/bindings/pci/telechips,pcie.txt
```
* Telechips Dolphin+ PCIe interface

This PCIe host controller is based on the Synopsys DesignWare PCIe IP
and thus inherits all the common properties defined in designware-pcie.txt.

Required properties:
- compatible: "telechips,pcie"
- reg: base addresses and lengths of the PCIe controller,
	the PHY controller, additional register for the PHY controller.
	- 0x11800000 : dbi register address
	- 0x11880000 : phy register address
	- 0x118a0000 : link register address
	- 0x11700000 : configuration address
- reg-names : First name should be set to "elbi".
	And use the "config" instead of getting the configuration address space
	from "ranges".
	NOTE: When using the "config" property, reg-names must be set.
	- dbi
	- phy
	- cfg
	- config
- interrupts: A list of interrupt outputs for level interrupt,
	pulse interrupt, special interrupt.
- cloks : clocks for PCI, Must include the following entries:
	- pcie_aux 	: clock for AUX 
	- pcie_apb 	: clock for Link
	- pcie_pcs 	: clock for Link
	- pcie_ref_ext 	: clock for internal ref clock
	- fbus_hsio 	: bus clock for PCI
	- pcie_phy	: clock for PHY
- using_ext_ref_clk : if it use external ref clock, it must be set to 1.
- for_si_test : for CTS mode, it use for measuring waveform of PCI.
- suspend_mode : Don's set this value, it is for STB platform.

For other common properties, refer to
	Documentation/devicetree/bindings/pci/designware-pcie.txt

Example:

SoC-specific DT Entry:

        pcie: pcie@11800000 {
                compatible = "telechips,pcie", "snps,dw-pcie";
                reg = <0x11800000 0x1000
                       0x11880000 0x1000
                       0x118a0000 0x1000
                       0x11700000 0x100000>;
                reg-names = "dbi", "phy", "cfg", "config" , "byte_cfg";
                interrupts = <GIC_SPI 138 IRQ_TYPE_LEVEL_HIGH>;
                clocks = <&clk_peri PERI_PCIE_AUX>, <&clk_peri PERI_PCIE_APB>,
                         <&clk_peri PERI_PCIE_PCS>, <&clk_peri PERI_PCIE_REF_EXT>,
                         <&clk_fbus FBUS_HSIO>, <&clk_isoip_top ISOIP_TOP_PCIE>;
                clock-names = "pcie_aux", "pcie_apb", "pcie_pcs", "pcie_ref_ext", "fbus_hsio", "pcie_phy";
                resets = <&pmu_rst RESET_PCIE>;
                #address-cells = <3>;
                #size-cells = <2>;
                device_type = "pci";
                ranges = <0x81000000 0 0          0x11600000 0 0x00100000   /* downstream I/O */
                          0x82000000 0 0x00000000 0x11000000 0 0x00600000>;   /* non-prefetchable memory */
                //ranges = <0x82000000 0 0x00000000 0x11000000 0 0x00600000>;   /* non-prefetchable memory */
                #interrupt-cells = <1>;
                interrupt-map-mask = <0 0 0 0>;
                interrupt-map = <0 0 0 0 &gic GIC_SPI 138 IRQ_TYPE_LEVEL_HIGH>;
                num-lanes = <1>;
                num-viewport = <4>;
                using_ext_ref_clk = <1>;
                for_si_test = <0>;
                suspend_mode = <0>;

                status = "disabled";
        };

Board-specific DT Entry:

        pcie@11800000 {
                reset-gpio = <&gpsd0 11 0>;
                status = "okay";
        };
```

## Documentation/devicetree/bindings/phy/phy-stm32-usbphyc.yaml
```yaml
# SPDX-License-Identifier: GPL-2.0-only OR BSD-2-Clause
%YAML 1.2
---
$id: "http://devicetree.org/schemas/phy/phy-stm32-usbphyc.yaml#"
$schema: "http://devicetree.org/meta-schemas/core.yaml#"

title: STMicroelectronics STM32 USB HS PHY controller binding

description:

  The STM32 USBPHYC block contains a dual port High Speed UTMI+ PHY and a UTMI
  switch. It controls PHY configuration and status, and the UTMI+ switch that
  selects either OTG or HOST controller for the second PHY port. It also sets
  PLL configuration.

  USBPHYC
  |_ PLL
  |
  |_ PHY port#1 _________________ HOST controller
  |                   __                 |
  |                  / 1|________________|
  |_ PHY port#2 ----|   |________________
  |                  \_0|                |
  |_ UTMI switch_______|          OTG controller

maintainers:
  - Amelie Delaunay <amelie.delaunay@st.com>

properties:
  compatible:
    enum:
      - st,stm32mp1-usbphyc

  reg:
    maxItems: 1

  clocks:
    maxItems: 1

  '#address-cells':
    const: 1

  '#size-cells':
    const: 0

  vdda1v1-supply:
    description: regulator providing 1V1 power supply to the PLL block

  vdda1v8-supply:
    description: regulator providing 1V8 power supply to the PLL block

  '#clock-cells':
    description: number of clock cells for ck_usbo_48m consumer
    const: 0

#Required child nodes:

patternProperties:
  "^usb-phy@[0|1]$":
    type: object
    description:
      Each port the controller provides must be represented as a sub-node.

    properties:
      reg:
        description: phy port index.
        maxItems: 1

      phy-supply:
        description: regulator providing 3V3 power supply to the PHY.

      st,phy-tuning:
        $ref: /schemas/types.yaml#definitions/phandle
        description:
          It can be necessary to adjust the PHY settings to compensate parasitics, which can be due
          to USB connector/receptacle, routing, ESD protection component,... Here is the list of
          all optional parameters to tune the interface of the PHY (HS for High-Speed, FS for Full-
          Speed, LS for Low-Speed)
            * st,current-boost, <1> current boosting of 1mA
                                <2> current boosting of 2mA
            * st,no-lsfs-fb-cap, disables the LS/FS feedback capacitor
            * st,hs-slew-ctrl, slows the HS driver slew rate by 10%
            * st,hs-dc-level, <0> decreases the HS driver DC level by 5 to 7mV
                              <1> increases the HS driver DC level by 5 to 7mV
                              <2> increases the HS driver DC level by 10 to 14mV
            * st,fs-rftime-tuning, enables the FS rise/fall tuning option
            * st,hs-rftime-reduction, enables the HS rise/fall reduction feature
            * st,hs-current-trim, controls HS driver current trimming for choke
            * st,hs-impedance-trim, controls HS driver impedance tuning for choke
            * st,squelch-level, adjusts the squelch DC threshold value
            * st,hs-rx-gain-eq, enables the HS Rx gain equalizer
            * st,hs-rx-offset, adjusts the HS Rx offset
            * st,no-hs-ftime-ctrl, disables the HS fall time control of single ended signals
                                   during pre-emphasis
            * st,no-lsfs-sc, disables the short circuit protection in LS/FS driver
            * st,hs-tx-staggering, enables the basic staggering in HS Tx mode

      '#phy-cells':
        enum: [ 0x0, 0x1 ]

    allOf:
      - if:
          properties:
            reg:
              const: 0
        then:
          properties:
            '#phy-cells':
              const: 0
        else:
          properties:
            '#phy-cells':
              const: 1
              description:
                The value is used to select UTMI switch output.
                0 for OTG controller and 1 for Host controller.

    required:
      - reg
      - phy-supply
      - '#phy-cells'

required:
  - compatible
  - reg
  - clocks
  - '#address-cells'
  - '#size-cells'
  - vdda1v1-supply
  - vdda1v8-supply
  - '#clock-cells'
  - usb-phy@0
  - usb-phy@1

examples:
  - |
    #include <dt-bindings/clock/stm32mp1-clks.h>
    #include <dt-bindings/reset/stm32mp1-resets.h>

    usb_phy_tuning: usb-phy-tuning {
        st,hs-dc-level = <2>;
        st,fs-rftime-tuning;
        st,hs-rftime-reduction;
        st,hs-current-trim = <15>;
        st,hs-impedance-trim = <1>;
        st,squelch-level = <3>;
        st,hs-rx-offset = <2>;
        st,no-lsfs-sc;
    };

    usbphyc: usbphyc@5a006000 {
        compatible = "st,stm32mp1-usbphyc";
        reg = <0x5a006000 0x1000>;
        clocks = <&rcc_clk USBPHY_K>;
        resets = <&rcc_rst USBPHY_R>;
        vdda1v1-supply = <&reg11>;
        vdda1v8-supply = <&reg18>;
        #address-cells = <1>;
        #size-cells = <0>;
        #clock-cells = <0>;

        usbphyc_port0: usb-phy@0 {
            reg = <0>;
            phy-supply = <&vdd_usb>;
            #phy-cells = <0>;
            st,phy-tuning = <&usb_phy_tuning>;
        };

        usbphyc_port1: usb-phy@1 {
            reg = <1>;
            phy-supply = <&vdd_usb>;
            #phy-cells = <1>;
            st,phy-tuning = <&usb_phy_tuning>;
        };
    };
...
```

## Documentation/devicetree/bindings/phy/sun4i-sata-phy.txt
```
Allwinner sun4i SATA PHY
-----------------------

Required properties:
- compatible : should be one of
  * allwinner,sun4i-a10-sata-phy
  * allwinner,sun8i-r40-sata-phy
- reg : a list of offset + length pairs
- #phy-cells : from the generic phy bindings, must be 0

Optional properties:
- phy-supply : from the generic phy bindings, a phandle to a regulator that
	       provides power to the PHY.

Example:
	sata_phy0: sata-phy@a01800 {
		compatible = "allwinner,sun8i-r40-sata-phy";
		reg = <0x00a01800 0x4>;
		#phy-cells = <0>;
	};
```

## Documentation/devicetree/bindings/phy/tcc-dwc3-phy.txt
```
Telechips USB DWC3 PHY

Required properties:
 - compatible:  must be "telechips,tcc_dwc3_phy"
 - reg:         physical base addresses of the controller and length of memory
                mapped region
 - interrupts:  interrupt should be described here
 - clocks:      phandle list of usb clocks

Optional properties:

Example:

dwc3_phy: dwc3_phy@11D90000 {
	compatible = "telechips,tcc_dwc3_phy";
	reg = <0x11D90000 0x48 0x11DA00EC 0x4>;
	interrupts = <GIC_SPI 155 IRQ_TYPE_LEVEL_HIGH>;
	clocks = <&clk_isoip_top ISOIP_TOP_U30>;
};
```

## Documentation/devicetree/bindings/phy/tcc-dwc_otg-phy.txt
```
Telechips USB DWC OTG PHY

Required properties:
 - compatible:  must be "telechips,tcc_dwc_otg_phy"
 - reg:         physical base addresses of the controller and length of memory
                mapped region
 - clocks:      phandle list of usb clocks
 - resets:      phandle to reset to phy block

Optional properties:

Example:

dwc_otg_phy: dwc_otg_phy@11DA0100 {
	compatible = "telechips,tcc_dwc_otg_phy";
	reg = <0x11DA0100 0x30>;
	clocks = <&clk_hsio HSIOBUS_USB20DH &clk_isoip_top ISOIP_TOP_U20DH>;
	resets = <&hsiobus_rst HSIOBUS_USB20DH>;
};
```

## Documentation/devicetree/bindings/phy/tcc-ehci-phy.txt
```
Telechips USB EHCI PHY

Required properties:
 - compatible:  must be "telechips,tcc_ehci_phy"
 - reg:         physical base addresses of the controller and length of memory
                mapped region
 - interrupts:  interrupt should be described here
 - clocks:      phandle list of usb clocks
 - resets:      phandle to reset to phy block

Optional properties:
 - mux_port:    MUX port feature for USB 2.0 DRD port

Example:

ehci_phy: ehci_phy@11DA0010 {
	compatible = "telechips,tcc_ehci_phy";
	reg = <0x11DA0010 0x30>;
	interrupts = <GIC_SPI 143 IRQ_TYPE_LEVEL_HIGH>;
	clocks = <&clk_hsio HSIOBUS_USB20H &clk_isoip_top ISOIP_TOP_U20H>;
	resets = <&hsiobus_rst HSIOBUS_USB20H>;
};

mhst_phy: mux_host_phy@11DA00DC {
	compatible = "telechips,tcc_ehci_phy";
	reg = <0x11DA00DC 0x20>;
	interrupts = <GIC_SPI 148 IRQ_TYPE_LEVEL_HIGH>;
	clocks = <&clk_hsio HSIOBUS_USB20DH &clk_isoip_top ISOIP_TOP_U20DH>;
	resets = <&hsiobus_rst HSIOBUS_USB20DH>;
	mux_port;
};
```

## Documentation/devicetree/bindings/pinctrl/pinctrl-tcc.txt
```
Required properties:
 - compatible:
        "telechips,tcc-pinctrl"
 - reg: The pinctrl(gpio) address range, relative to the pinctrl range
	<cell num>
        1 : gpio base address(ap)
        2 : range of gpio base address
        3 : pmgpio base address(micom)
        4 : range of pmgpio base address

Optional properties:
 - telechips,no-pull : Disable pull-up/down
 - telechips,pull-up : Select pull-up and enable pull-up
 - telechips,pull-down : Select pull-down and enable pull-down
 - telechips,input-enable : Enable input buffer, disable ouput
 - telechips,output-low : Enable output and set to low, disable input buffer
 - telechips,output-high : Enable output and set to high, disable input buffer
 - telechips,input_buffer_enable : Enable input buffer
 - telechips,input_buffer_disable : Disable input buffer
 - telechips,schmitt-input : Set to Schmitt input type
 - telechips,cmos-input : Set to CMOS input type
 - telechips,slow-slew : Select slew rate to fast
 - telechips,fast-slew : Select slew rate to low
 - telechips,eclk-sel : Select external input clock
 - telechips,drive-strength : Set port driver strength

Example:

pinctrl: pinctrl@14200000 {
    compatible = "telechips,tcc-pinctrl";
    reg = <0x14200000 0x300 0x1B937800 0x100>;  /* gpio, pmgpio */
};

&pinctrl {
    pinctrl_gpio {
    gpa {
        pin-info = <0x0 0 32>;
    };

    gpb {
        pin-info = <0x40 0 29>;
    };
...
    sd0_clk: sd0_clk {
        telechips,pins = "gpsd0-0";
        telechips,pin-function = <1>;
        telechips,drive-strength = <3>;
        telechips,input_buffer_enable;
    };
...
    uart7_data: uart7_data {
        telechips,pins = "gpa-12", "gpa-13";
        telechips,pin-function = <7>;
    };
...
    test: test {
        telechips,pins = "gpx-1", "gpx-2";
        telechips,pin-function = <2>;
		telechips,drive-strength = <3>;
		telechips,input_buffer_enable;
		telechips,pull-up;
    };
};
```

## Documentation/devicetree/bindings/power/reset/telechips,mbox-reboot.txt
```
Telechips Mailbox Reset Driver

Reset driver for TCC803x subcore (Cortex-A7 Single Core) which requests MCU
of resetting via A7-R5 mailbox interface.

Requeried properties:
- compatible: Should be "telechips,mbox-reboot"
- mboxes: List of phandle and mailbox channel specifiers.  Only the first set
  of phandle and mailbox channel is valid, and other sets are ignored.

Example:
	mbox-reset {
		compatible = "telechips,mbox-reboot";
		mboxes = <&mailbox 0>;
	};
```

## Documentation/devicetree/bindings/power/reset/telechips,reboot-mode.txt
```
Telechips reboot mode driver

The driver gets reboot mode magic value from reboot-mode driver and store it.
Then the bootloader can read it and take different action according to the magic
value stored.

Required properties:
- compatible: should be "telechips,reboot-mode"

The rest of the properties should follow the generic reboot-mode description
found in reboot-mode.txt

Example:
	reboot-mode {
		compatible = "telechips,reboot-mode";
		mode-normal = <BOOT_NORMAL>;
		mode-bootloader = <BOOT_FASTBOOT>;
		mode-recovery = <BOOT_RECOVERY>;
	};
```
