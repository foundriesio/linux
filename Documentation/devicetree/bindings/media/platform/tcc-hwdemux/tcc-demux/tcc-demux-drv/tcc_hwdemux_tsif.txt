## Documentation/devicetree/bindings/mmc/sdhci-tcc.txt
```
Telechips SDHCI Controller device tree bindings

Required properties:
These are the necessary properties to initialize the driver.

- compatible: should be one of the following
	- "telechips,tcc-sdhci" : For controllers compatible with default
	- "telechips,tcc803x-sdhci" : For controllers compatible with TCC803x SoCs
	- "telechips,tcc899x-sdhci" : For controllers compatible with TCC899x SoCs
	- "telechips,tcc901x-sdhci" : For controllers compatible with TCC901x SoCs
	- "telechips,tcc897x-sdhci" : For controllers compatible with TCC897x SoCs
	- "telechips,tcc805x-sdhci" : For controllers compatible with TCC805x SoCs
- reg : From mmc bindings : Register location and length.
- controller-id : controller index for register channel
- pinctrl-names : A pinctrl state names "default" must be defined.
- pinctrl-0 : Phandle referencing pin configuration of the SDHCI controller.
- max-frequency : From mmc bindings : maximum operating clock frequency.

- interrupts : From mmc bindings : Interrupts used by the MMC controller.
For details of interrupt, see below.
(Documentation/devicetree/bindings/interrupt-controller/interrupts.txt)

- clocks : From clock bindings : Clock consumer nodes use a phandle and clock
		specifier pair to connect clock provider outputs to clock inputs.
- clock-names : must be "mmc_fclk" and "mmc_hclk"
For details of clock, see below.
(Documentation/devicetree/bindings/clock/clock-bindings.txt)


Optional properties:
For optional properties not mentioned, refer to the documentation below.
(Documentation/devicetree/bindings/mmc/mmc.txt)

- tcc-clk-gating : Property to operate the clock auto-gating function
- tcc-mmc-reset : Property to set H/W reset pin

<Delay Tap>
It is a register that adjusts the setup/hold time by giving delay to the signal.

This property is used in the above compatible.
Also, in the case of TCC803x, the properties used are different depending on the chip version.
("telechips,tcc803x-sdhci" , "telechips,tcc899x-sdhci", "telechips,tcc901x-sdhci", "telechips,tcc897x-sdhci")
- tcc-mmc-cmd-tap  (range 0 ~ 31 default 8)
- tcc-mmc-cmd-tap  (range 0 ~ 31 default 7)
- tcc-mmc-data-tap (range 0 ~ 31 default 7)

This property is used in the above compatible.
("telechips,tcc805x-sdhci" , "telechips,tcc803x-sdhci")
- tcc-mmc-taps : < clock, command, data, otap>  (each range 0 ~ 31, default 15)
- tcc-mmc-hs400-pos-tap : This is the register value for HS 400 RX tuning. (min 0 max 15 default 0)
- tcc-mmc-hs400-neg-tap : Same as above

Examples:

- For eMMC:
vqmmc_emmc: vqmmc_emmc {

	compatible = "regulator-fixed";
	regulator-name = "vqmmc_emmc";
	regulator-min-microvolt = <1800000>;
	regulator-max-microvolt = <1800000>;
	regulator-always-on;
}
sdhc0: sdhc@16440000 {
	compatible = "telechips,tcc803x-sdhci";
	reg = <0x16440000 0x100>, <0x16470000 0x200>,
	<0x0 0> /* dummy */, <0x164700FC 0x4>;
	interrupts = <GIC_SPI 74 IRQ_TYPE_LEVEL_HIGH>;
	clocks = <&clk_peri PERI_SDMMC0 &clk_io IOBUS_SDMMC0>;
	clock-names = "mmc_fclk", "mmc_hclk";
	max-frequency = <200000000>;
	bus-width = <8>;
	controller-id = <0>;
        status = "okay";

	pinctrl-names = "default";
	pinctrl-0 = <&sd0_clk &sd0_cmd &sd0_bus8>;

	/* for rev. 0 */
	tcc-mmc-clk-out-tap = <0>;
	tcc-mmc-cmd-tap = <0>;
	tcc-mmc-data-tap = <0>;
	/* for rev. 1 */
	tcc-mmc-taps = <15 15 15 15>;

	non-removable;
	disable-wp;
	cap-mmc-hw-reset;
	mmc-ddr-1_8v;

	tcc-mmc-reset = <&gpsd0 14 0>;
        vqmmc-supply = <&vqmmc_emmc>;
};


- For SD
/* SD CARD */
sdhc1_pwrseq: sdhc1_pwrseq {
	compatible = "mmc-pwrseq-simple";
	reset-gpios = <&gpsd1 8 GPIO_ACTIVE_LOW>;
};


sdhc@16450000 {
	compatible = "telechips,tcc803x-sdhci";
	reg = <0x16450000 0x100>, <0x16470000 0x200>,
	<0x0 0> /* dummy */, <0x164700FC 0x4>;
	interrupts = <GIC_SPI 75 IRQ_TYPE_LEVEL_HIGH>;
	clocks = <&clk_peri PERI_SDMMC1 &clk_io IOBUS_SDMMC1>;
	clock-names = "mmc_fclk", "mmc_hclk";
	bus-width = <4>;
	max-frequency = <200000000>;
	controller-id = <1>;

	pinctrl-names = "default";
	pinctrl-0 = <&sd1_clk &sd1_cmd &sd1_bus4 &sd1_bus4_wp_cd>;

	/* for rev. 0*/
	tcc-mmc-clk-out-tap = <0>;
	tcc-mmc-cmd-tap = <0>;
	tcc-mmc-data-tap = <0>;
	/* for rev. 1*/
	tcc-mmc-taps = <15 15 15 15>;

	broken-cd;
	cd-inverted;

	wp-gpios = <&gpsd1 7 0>;
	cd-gpios = <&gpsd1 6 0>;

	vqmmc-supply = <&vdd_ldo3>;
};

- For SDIO
vqmmc_sdio: vqmmc_sdio {
	compatible = "regulator-fixed";
	regulator-name = "vqmmc_sdio";
	regulator-min-microvolt = <1800000>;
	regulator-max-microvolt = <1800000>;
	regulator-always-on;
};

sdhc2: sdhc@16460000 {
	compatible = "telechips,tcc803x-sdhci";
	reg = <0x16460000 0x100>, <0x164700a0 0x200>,
	<0x0 0> /* dummy */, <0x164700FC 0x4>;
	interrupts = <GIC_SPI 76 IRQ_TYPE_LEVEL_HIGH>;
	clocks = <&clk_peri PERI_SDMMC2 &clk_io IOBUS_SDMMC2>;
	clock-names = "mmc_fclk", "mmc_hclk";
	max-frequency = <200000000>;
	bus-width = <4>;
	controller-id = <2>;
	status = "okay";

	pinctrl-names = "default";
	pinctrl-0 = <&sd2_clk &sd2_cmd &sd2_bus4 &out0_clk>;
	/* for rev. 0 */
	tcc-mmc-clk-out-tap = <0>;
	tcc-mmc-cmd-tap = <0>;
	tcc-mmc-data-tap = <0>;
	/* for rev. 1 */
	tcc-mmc-taps = <15 15 15 15>;

	keep-power-in-suspend;

	tcm38xx {
		compatible = "telechips,tcm38xx";
		wifi_pwr-gpio = <&gpsd2 6 0>; /* BT_WIFI_VBAT_EN */
		wlreg_on-gpio = <&gpsd2 8 0>; /* WIFI_REG_ON */
	};
};
```

## Documentation/devicetree/bindings/mmc/tcc-sc-mmc.txt
```
Bindings for Telechips SC MMC driver

In TCC805x, CPU accesses eMMC by requesting the commands to SC(Storage Core)
which is the co-processor to manage eMMC access.
This driver requests the operation of each command through SC firmware
protocol driver.

Note: Do not bind SDHCI driver for SDMMC channel which is used by SC.

Required properties:
- compatible: Should be "telechips,tcc805x-sc-mmc".
- sc-firmware: The phandle of SC firmware protocol driver.

These properties do not affect the operation because SC F/W controls operation.
But they are needed to defines explicilty for kernel MMC driver operation.

- max-frequency: maximum operating clock frequency.
- bus-width: Number of data lines.
- vqmmc-supply: The phandle of regulator which should be "regulator-fixed".
- no-sdio: controller is limited to send sdio cmd during initialization.
- no-sd: controller is limited to send sd cmd during initialization.
- non-removable: non-removable slot (like eMMC); assume always present.
- disable-wp: When set no physical WP line is present.
- mmc-hs400-1_8v: eMMC HS400 mode(1.8V I/O) is supported.

Optional properties:
N/A

Examples:
a72_sc_mbox: mbox@0x1D200000 {
    status = "okay";
    compatible = "telechips,tcc805x-mailbox-sc";
    reg = <0x0 0x1D200000 0x0 0x80>;
    interrupts = <GIC_SPI 319 IRQ_TYPE_LEVEL_HIGH>,
               <GIC_SPI 329 IRQ_TYPE_LEVEL_HIGH>;
    #mbox-cells = <1>;
};

tcc_sc_fw: tcc_sc_fw {
    compatible = "telechips,tcc805x-sc-fw";
    status = "okay";
    mboxes = <&a72_sc_mbox 0>;
};

vqmmc_emmc: vqmmc_emmc {
    compatible = "regulator-fixed";
    regulator-name = "vqmmc_emmc";
    regulator-min-microvolt = <1800000>;
    regulator-max-microvolt = <1800000>;
    regulator-always-on;
};

tcc_sc_mmc: tcc_sc_mmc {
    compatible = "telechips,tcc805x-sc-mmc";
    status = "okay";

    max-frequency = <200000000>;
    bus-width = <8>;

    sc-firmware = <&tcc_sc_fw>;

    no-sdio;
    no-sd;
    non-removable;
    disable-wp;

    mmc-hs400-1_8v;
    vqmmc-supply = <&vqmmc_emmc>;
};
```

## Documentation/devicetree/bindings/mtd/evatronix-nand.txt
```
Evatronix NANDFLASH-CTRL NAND flash controller

Required properties:
- compatible : "evatronix,nandflash-ctrl"
- reg : specify bus address and register area size.
- interrupts : controller interrupt number and irq type.
- nand-ecc-mode : See nand.txt. Supported values "hw", "soft_bch".
- nand-ecc-strength : See nand.txt. Supported values: 4, 8, 16, 24, 32.
- nand-ecc-step-size : See nand.txt. Supported values: 256, 512, 1024.

Optional properties:
- nand-on-flash-bbt: See nand.txt.

Example:

nand: nand@40102000 {
	compatible = "evatronix,nandflash-ctrl";
	reg = <0x40102000 0x2000>;
	interrupts = <GIC_SPI 58 IRQ_TYPE_LEVEL_HIGH>;
	clocks = <&hclk_nand>, <&clk_nand>;
	clock-names = "clka", "clkb";
	#address-cells		= <1>;
	#size-cells		= <1>;
	nand-ecc-mode = "hw";
	nand-on-flash-bbt;
	nand-ecc-strength = <8>;
	nand-ecc-step-size = <512>;
};
```

## Documentation/devicetree/bindings/mtd/fsl-nfc.txt
```
* Freescale's NFC (nand flash controller)

Required properties:
- compatible : "fsl,XXX-nfc"
- reg : Address range of the mtd chip
- interrupts: Should contain the STMMAC interrupts
- nand-bus-width: see nand.txt
- nand-ecc-mode: see nand.txt
- nand-on-flash-bbt: see nand.txt
- clock-frequency : Optional clock rate to NFC in Hz
- #address-cells, #size-cells : Must be present if the device has sub-nodes
  representing partitions.

Example:

	nfc: nand@400e0000 {
		compatible = "fsl,vf610-nfc";
		#address-cells = <1>;
		#size-cells = <1>;
		reg = <0x400e0000 0x4000>;
		interrupts = <0 83 0x04>;
		clocks = <&clks VF610_CLK_NFC>;
		clock-names = "nfc";
		clock-frequency = <33000000>;
	};
```

## Documentation/devicetree/bindings/mtd/vf610-nfc.txt
```
Freescale's NAND flash controller (NFC)

This variant of the Freescale NAND flash controller (NFC) is on Vybrid (vf610),
MPC5125, MCF54418 and Kinetis K70.

Required properties:
- compatible: "fsl,vf610-nfc"
- reg: address range of the NFC
- interrupts: interrupt of the NFC
- nand-bus-width: see nand.txt
- nand-ecc-mode: see nand.txt
- nand-on-flash-bbt: see nand.txt
- assigned-clocks: main clock from the SoC, for Vybrid <&clks VF610_CLK_NFC>;
- assigned-clock-rates: The NAND bus timing is derived from this clock
    rate and should not exceed maximum timing for any NAND memory chip
    in a board stuffing. Typical NAND memory timings derived from this
    clock are found in the SoC hardware reference manual. Furthermore,
    there might be restrictions on maximum rates when using hardware ECC.

- #address-cells, #size-cells : Must be present if the device has sub-nodes
  representing partitions.

Required properties for hardware ECC:
- nand-ecc-strength: supported strengths are 24 and 32 bit (see nand.txt)
- nand-ecc-step-size: step size equals page size, currently only 2k pages are
    supported

Example:

	nfc: nand@400e0000 {
		compatible = "fsl,vf610-nfc";
		#address-cells = <1>;
		#size-cells = <1>;
		reg = <0x400e0000 0x4000>;
		interrupts = <GIC_SPI 83 IRQ_TYPE_LEVEL_HIGH>;
		clocks = <&clks VF610_CLK_NFC>;
		clock-names = "nfc";
		assigned-clocks = <&clks VF610_CLK_NFC>;
		assigned-clock-rates = <33000000>;
		nand-bus-width = <8>;
		nand-ecc-mode = "hw";
		nand-on-flash-bbt;
		nand-ecc-strength = <32>;
		nand-ecc-step-size = <2048>;
	};
```

## Documentation/devicetree/bindings/net/telechips,gmac.txt
```
This is for 'telechips gmac driver'.

Required properties for gmac:
	-compatible:
		- Legacy tcc gmac driver :
			"telechips,gmac"
		- Stmmac based tcc gmac driver for GMAC version 3.73a( ex. TCC803x ) :
			 "telechips,gmac","snps,dwmac-3.70a"
		- Stmmac based tcc gmac driver for GMAC version 5.10a( ex. TCC805x ) :
			 "telechips,gmac","snps,dwmac-4.10a"
	-reg:
		- physical base address of the GMAC core register and HSIO bus
		  base address.
	-phyrst-gpio:
	 	- If ethernet phy device's reset is required, this property is
	 	  the filed to set phy reset gpio.
	-phy-interface:
	 	- phy interface name. It is used only with lagacy
	 	  tcc gmac driver.
	-phy-mode:
	 	- phy interface name. It is used only with stmmac based
	 	  gmac driver
	-pinctrl-*
	 	- This is a properties for setting GPIO pinctrl for GMAC.


Optional properties for gmac:
	*-dly and *-inv properties are the fields to set delay tap when signal
	timing tuning between GMAC and phy interface is required.

	Example:
		-txclk-o-dly:
			- It is used to set delay tap value for TXCLK signal.
		-txclk-o-inv:
			- It is used to inverse the TXCLK signal.

-------------------------------------------------------------------------------

Example:

        gmac@11C00000 {
                status = "okay";
                compatible = "telechips,gmac","snps,dwmac-3.70a";
//              phyon-gpio      = <&gpc 27 0>;
                phyrst-gpio = <&gpa 24 0>;
                phy-interface = "rgmii";
                phy-mode = "rgmii";
                interrupt-names = "macirq";
                //ecid-mac-addr;
                txclk-o-dly = <18>;
                txclk-o-inv = <0>;
                txclk-i-dly = <0>;
                txclk-i-inv = <0>;
                txen-dly = <0>;
                txer-dly = <0>;
                txd0-dly = <0>;
                txd1-dly = <0>;
                txd2-dly = <0>;
                txd3-dly = <0>;
                txd4-dly = <0>;
                txd5-dly = <0>;
                txd6-dly = <0>;
                txd7-dly = <0>;
                rxclk-i-dly = <0>;
                rxclk-i-inv = <0>;
                rxdv-dly = <0>;
                rxer-dly = <0>;
                rxd0-dly = <0>;
                rxd1-dly = <0>;
                rxd2-dly = <0>;
                rxd3-dly = <0>;
                rxd4-dly = <0>;
                rxd5-dly = <0>;
                rxd6-dly = <0>;
                rxd7-dly = <0>;
                crs-dly = <0>;
                col-dly = <0>;
                pinctrl-names = "default", "mii", "rmii", "gmii", "rgmii";
                pinctrl-0 = <>;
                pinctrl-1 = <&gmac1_mdc &gmac1_mdio &gmac1_col
                             &gmac1_crs &gmac1_txer &gmac1_rxer
                             &gmac1_txclk &gmac1_txen &gmac1_txd0
                             &gmac1_txd1 &gmac1_txd2 &gmac1_txd3
                             &gmac1_rxclk &gmac1_rxdv &gmac1_rxd0
                             &gmac1_rxd1 &gmac1_rxd2 &gmac1_rxd3>;
                pinctrl-2 = <&gmac1_mdc &gmac1_mdio
                             &gmac1_txclk &gmac1_txen &gmac1_txd0 &gmac1_txd1
                             &gmac1_rxer &gmac1_rxdv &gmac1_rxd0 &gmac1_rxd1>;
                pinctrl-3 = <&gmac1_mdc &gmac1_mdio &gmac1_col
                             &gmac1_crs &gmac1_txer &gmac1_rxer
                             &gmac1_txclk &gmac1_txen &gmac1_txd0
                             &gmac1_txd1 &gmac1_txd2 &gmac1_txd3
                             &gmac1_txd4 &gmac1_txd5 &gmac1_txd6 &gmac1_txd7
                             &gmac1_rxclk &gmac1_rxdv &gmac1_rxd0
                             &gmac1_rxd1 &gmac1_rxd2 &gmac1_rxd3
                             &gmac1_rxd4 &gmac1_rxd5 &gmac1_rxd6 &gmac1_rxd7>;
                pinctrl-4 = <&gmac1_mdc &gmac1_mdio
                             &gmac1_txclk &gmac1_txen &gmac1_txd0
                             &gmac1_txd1 &gmac1_txd2 &gmac1_txd3
                             &gmac1_rxclk &gmac1_rxdv &gmac1_rxd0
                             &gmac1_rxd1 &gmac1_rxd2 &gmac1_rxd3>;
        };
```
