## Documentation/devicetree/bindings/media/platform/tcc-hwdemux/tcc-demux/tcc-demux-drv/tcc_hwdemux_tsif.txt
```
Telechips HWDemux TSIF driver for TCC897X

Required properties:
	-compatible:
		"telechips,tcc89xx-hwdmx-tsif"

Optional properties:
	-tsif-id:
		tsif index(max:2)
	-tsif-port:
		tsif port nunmber
	-port-mex:
		tsif port mux number
	-pinctrl-names:
		port name for status
	-pinctrl-0:
		setting of idle for pinctrl for tsif data/valid/clock/sync
	-pinctrl-1:
		 setting of active for pinctrl for tsif data/valid/clock/sync

Example:
	tcc_ex_tsif {
                compatible = "telechips,tcc89xx-hwdmx-tsif";
                tsif-id = <2>;
                tsif-port = <6>;
                port-mux = <6>;
                pinctrl-names = "idle", "active";
                pinctrl-0 = <&ts6_idle>;
                pinctrl-1 = <&ts6_active>;
        };
```

## Documentation/devicetree/bindings/media/telechips-mipi-csi2.txt
```
Telechips Random Number Generator

Required properties:

- compatible  : "telechips,tcc803x-mipi-csi2" for TCC803x
		"telechips,tcc805x-mipi-csi2" for TCC805x
- reg         : Specifies base physical address and size of the registers map.
```

## Documentation/devicetree/bindings/media/telechips-tcc-isp-iommu.txt
```
* Device Tree Bindings for ISP-IOMMU  (IOMMU Driver for Image Signal Processor)

Required properties:

- status     : disable or enable the device node
- compatible : property name that conveys the platform architecture identifiers,
               as 'maxim,max96701'
- iommu      : specifies iommu configuration

example
-------
	isp_iommu: isp_iommu {
		compatible = "telechips,tcc-isp-iommu";
		iommus = <&smmu_dbus 0x90 0x7f00>;
		status = "okay";
	};
```

## Documentation/devicetree/bindings/media/telechips-vpu.txt
```
* Telechips Video Processor Unit

Video Processor Unit is a HW video controller. It controls HW Codec including
JPEG/MPEG4/H.264/VP8/VP9/HEVC Decode, JPEG/H.264/HEVC Encode.

Required properties:
  - compatible: "telechips,hevc_dev_mgr", //HMGR_NAME
                "telechips,jpu_dev_mgr",  //JMGR_NAME
                "telechips,vp9_dev_mgr",  //VP9MGR_NAME
                "telechips,vpu_4k_d2_dev_mgr", //VPU_4K_D2_MGR_NAME
                "telechips,vpu_dev_mgr",  //MGR_NAME
                "telechips,vpu_vmem", //MEM_NAME
                "telechips,vpu_vdec",
                "telechips,vpu_vdec_ext",
                "telechips,vpu_vdec_ext2",
                "telechips,vpu_vdec_ext3",
                "telechips,vpu_vdec_ext4",
                "telechips,vpu_venc",
                "telechips,vpu_venc_ext",
                "telechips,vpu_venc_ext2",
                "telechips,vpu_venc_ext3",
                "telechips,vpu_venc_ext4",
                "telechips,vpu_venc_ext5",
                "telechips,vpu_venc_ext6",
                "telechips,vpu_venc_ext7",
                "telechips,vpu_hevc_enc_dev_mgr"

Optional properties:

Example:
```

## Documentation/devicetree/bindings/mfd/hi6552.txt
```
* Hisilicon hi6552 Power Management Integrated Circuit (PMIC)

hi6552 consists of a large and varied group of sub-devices:

Device			 Supply Names	 Description
------			 ------------	 -----------
hi6552-powerkey		:		: Powerkey
hi6552-regulator-pmic	:		: Regulators
hi6552-usbvbus		:		: USB plug detection
hi6552-pmu-rtc		:		: RTC
hi6552-coul		:		: Coulomb

Required properties:
- compatible : Should be "hisilicon,hi6552-pmic-driver"
- reg: Base address of PMIC on hi6220 soc
- #interrupt-cells: Should be 2, is the local IRQ number for hi6552.
- interrupt-controller: hi6552 has internal IRQs (has own IRQ domain).
- pmu_irq_gpio: should be &gpio_pmu_irq_n, is the IRQ gpio of hi6552.

Example:
	pmic: pmic@F8000000 {
                compatible = "hisilicon,hi6552-pmic-driver";
                reg = <0x0 0xF8000000 0x0 0x1000>;
                #interrupt-cells = <2>;
                interrupt-controller;
                pmu_irq_gpio = <&gpio_pmu_irq_n>;
                status = "ok";
                ponkey:ponkey@b1{
                        compatible = "hisilicon,hi6552-powerkey";
                        interrupt-parent = <&pmic>;
                        interrupts = <6 0>, <5 0>, <4 0>;
                        interrupt-names = "down", "up", "hold 1s";
                };
                coul: coul@1 {
                        compatible = "hisilicon,hi6552-coul";
                        interrupt-parent = <&pmic>;
                        interrupts = <24 0>, <25 0>, <26 0>, <27 0>;
                        interrupt-names = "cl_int_i", "cl_out_i", "cl_in_i", "vbat_int_i";
                        battery_product_index = <0>;
                        status = "ok";
                };
                rtc: rtc@1 {
                        compatible = "hisilicon,hi6552-pmu-rtc";
                        interrupt-parent = <&pmic>;
                        interrupts = <20 0>;
                        interrupt-names = "hi6552_pmu_rtc";
                        board_id = <1>;
                };
                usbvbus:usbvbus@b2{
                        compatible = "hisilicon,hi6552-usbvbus";
                        interrupt-parent = <&pmic>;
                        interrupts = <9 0>, <8 0>;
                        interrupt-names = "connect", "disconnect";
                };
		ldo2: regulator@a21 {
                        compatible = "hisilicon,hi6552-regulator-pmic";
                        regulator-name = "ldo2";
                        regulator-min-microvolt = <2500000>;
                        regulator-max-microvolt = <3200000>;
                        hisilicon,valid-modes-mask = <0x02>;
                        hisilicon,valid-ops-mask = <0x01d>;
                        hisilicon,initial-mode = <0x02>;
                        hisilicon,regulator-type = <0x01>;

                        hisilicon,off-on-delay = <120>;
                        hisilicon,ctrl-regs = <0x029 0x02a 0x02b>;
                        hisilicon,ctrl-data = <0x1 0x1>;
                        hisilicon,vset-regs = <0x072>;
                        hisilicon,vset-data = <0 0x3>;
                        hisilicon,regulator-n-vol = <8>;
                        hisilicon,vset-table = <2500000>,<2600000>,<2700000>,<2800000>,<2900000>,<3000000>,<3100000>,<3200000>;
                        hisilicon,num_consumer_supplies = <1>;
                        hisilicon,consumer-supplies = "sensor_analog";
                };
	};
```

## Documentation/devicetree/bindings/misc/hisilicon-hikey-usb.txt
```
Support usb hub and usb data role switch of Hisilicon HiKey960 Board.

-----------------------------

Required properties:
- compatible: "hisilicon,gpio-hubv1","hisilicon,hikey960-usb"
- typec-vbus-gpios: gpio to control the vbus of typeC port
- otg-switch-gpios: gpio to switch DP & DM between the hub and typeC port
- hub-vdd33-en-gpios: gpio to enable the power of hub
- pinctrl-names: pin configuration state name ("default")
- pinctrl-0: pinctrl config

Example
-----

	hisi_hikey_usb: hisi_hikey_usb {
		compatible = "hisilicon,hikey960-usb";
		typec-vbus-gpios = <&gpio25 2 GPIO_ACTIVE_HIGH>;
		otg-switch-gpios = <&gpio25 6 GPIO_ACTIVE_HIGH>;
		hub-vdd33-en-gpios = <&gpio5 6 GPIO_ACTIVE_HIGH>;
		pinctrl-names = "default";
		pinctrl-0 = <&usbhub5734_pmx_func>;

		port {
			#address-cells = <1>;
			#size-cells = <0>;

			hikey_usb_ep: endpoint@0 {
				reg = <0>;
				remote-endpoint = <&dwc3_role_switch_notify>;
			};
		};
	};

	hisi_hikey_usb: hisi_hikey_usb {
		compatible = "hisilicon,gpio-hubv1";
		typec-vbus-gpios = <&gpio25 2 GPIO_ACTIVE_LOW>;
		otg-switch-gpios = <&gpio25 6 GPIO_ACTIVE_HIGH>;
		hub-vdd33-en-gpios = <&gpio5 6 GPIO_ACTIVE_HIGH>;
		pinctrl-names = "default";
		pinctrl-0 = <&usbhub5734_pmx_func>;

		port {
			#address-cells = <1>;
			#size-cells = <0>;

			hikey_usb_ep: endpoint@0 {
				reg = <0>;
				remote-endpoint = <&dwc3_role_switch_notify>;
			};
		};
	};
```

## Documentation/devicetree/bindings/misc/snps,hdcp-dp.txt
```
Synopsys HDCP on Display Port Controller
-----------------------------------------------------
This binding defines the HDCP controller that are using synopsys IP.

Required properties:
- compatible : "snps,hdcp-dp"
- reg : address and length of the register for the device
- interrupts : Should contain hdcp interrupt

Example:
	hdcp-dp {
		compatible = "snps,hdcp-dp";
		reg = <0x0 0x12400000 0x0 0x10000>;
		interrupts = <GIC_SPI 294 IRQ_TYPE_LEVEL_HIGH>;
	};
```

## Documentation/devicetree/bindings/misc/snps,hld.txt
```
Synopsys HDCP Host Library Driver
-----------------------------------------------------
This binding defines the HDCP Host Library Driver that are using synopsys IP.

Required properties:
- compatible : "snps,hld"
- reg : address and length of the register for the HPI interface.
- firmware-size : code size of ESM firmware. The buffer is allocated using
                  dma_free_coherent() on the probe.
- data-size : data size of ESM firmware. The buffer is allocated using
              dma_free_coherent() on the probe.

Example:
	snps-hld {
		compatible = "snps,hld";
		reg = <0x0 0x12440000 0x0 0x80>;
		firmware-size = <0x40000>;
		data-size = <0x20000>;
	};
```

## Documentation/devicetree/bindings/misc/tcc/telechips,tcc_shmem.txt
```
Telechips Shared Memory driver

Required properties:

- compatible  : Should be "telechips,tcc_shmem".
- reg         : Specifies base physical address and size of the registers map.
- interrupts  : Describes interrupt source.
- dist-regs   : Specifies address of GIC's distributor of maincore and subcore.
- memory-region : Covers the memory area shared by maincore and subcore.
- core-num    : indicates that '0' is maincore and '1' is 'subcore'.

    tcc_shared_memory: tcc_shared_memory {
        compatible = "telechips,tcc_shmem";
        reg = <0x0 0x38000000 0x0 0x8000000>;
        reg-names = "tcc_shmem";
        interrupts = <GIC_SPI 50 0>;
        leble = "TCC shared memory";
        memory-region = <&pmap_tcc_shmem>;
        dist_regs = <0x17301000 0x1000 0x17C01000 0x1000>;
        core-num = <0>;
    };
```

## Documentation/devicetree/bindings/mmc/mmc-pwrseq-simple-ext-clk.txt
```
* The simple external clock power sequence provider

Optional properties:
- clocks : Must contain an entry for the entry in clock-names.
  See ../clocks/clock-bindings.txt for details.
- clock-names : Must include the following entry:
  "ext_clock" (External clock provided to the card).

Example:

	sdhc2_pwrseq: sdhc2_pwrseq {
		  compatible = "mmc-pwrseq-simple-ext-clock";
		  clocks = <&clk_peri PERI_OUT0>;
		  clock-names = "ext_clock";
		  ext_clock_speed = <32768>;
		  pinctrl-names = "default";
		  pinctrl-0 = <&out0_clk>;
	};
```
